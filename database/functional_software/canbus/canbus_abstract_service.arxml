AUTOSAR XML (schema 00046)
package /jmc_auto/PlatFormServices/CanbusAbstractConsumerToApp
  someip service instance to machine mapping CanbusAbstractServiceInstanceToMachine: communication-connector=Dmini0EthernetCommConnector, service-instance=CanbusAbstractSomeipServiceInstance, udp-port=5000
  service instance to port prototype mapping CanbusAbstractServiceInstanceToPort: port-prototype=CanbusAbstractRootSwComponent.CanbusAbstractRPort, process=CanbusAbstractProcess, service-instance=CanbusAbstractSomeipServiceInstance
package /jmc_auto/PlatFormServices/CanbusAbstractProviderToApp
  someip service instance to machine mapping CanbusAbstractServiceInstanceToMachine: communication-connector=Dmini0EthernetCommConnector, service-instance=CanbusAbstractSomeipServiceInstance, udp-port=6000
  service instance to port prototype mapping CanbusAbstractServiceInstanceToPort: port-prototype=CanbusAbstractRootSwComponent.CanbusAbstractPPort, process=CanbusAbstractProcess, service-instance=CanbusAbstractSomeipServiceInstance
package /jmc_auto/PlatFormServices/CanbusAbstractServiceConsumer
  required someip service instance CanbusAbstractSomeipServiceInstance: service-interface=ChassisSomeipInterfaceDeployment, required-service-instance-id=104
package /jmc_auto/PlatFormServices/CanbusAbstractServiceProvider
  provided someip service instance CanbusAbstractSomeipServiceInstance: service-interface=ChassisSomeipInterfaceDeployment, someip-event-props=ChassisEventDeployment, service-instance-id=104
