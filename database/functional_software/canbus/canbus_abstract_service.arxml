AUTOSAR XML (schema 00046)
package /HuaweiMDC/PlatFormServices/CanbusAbstractConsumerToApp
  someip service instance to machine mapping CanbusAbstractServiceInstanceToMachine: communication-connector=Dmini0EthernetCommConnector, service-instance=CanbusAbstractSomeipServiceInstance, udp-port=5000
  service instance to port prototype mapping CanbusAbstractServiceInstanceToPort: port-prototype=CanbusAbstractRootSwComponent.CanbusAbstractRPort, process=CanbusAbstractProcess, service-instance=CanbusAbstractSomeipServiceInstance
package /HuaweiMDC/PlatFormServices/CanbusAbstractProviderToApp
  someip service instance to machine mapping CanbusAbstractServiceInstanceToMachine: communication-connector=Dmini0EthernetCommConnector, service-instance=CanbusAbstractSomeipServiceInstance, udp-port=6000
  service instance to port prototype mapping CanbusAbstractServiceInstanceToPort: port-prototype=CanbusAbstractRootSwComponent.CanbusAbstractPPort, process=CanbusAbstractProcess, service-instance=CanbusAbstractSomeipServiceInstance
package /HuaweiMDC/PlatFormServices/CanbusAbstractServiceConsumer
  required someip service instance CanbusAbstractSomeipServiceInstance: service-interface=ChassisSomeipInterfaceDeployment, required-service-instance-id=1
    someip required event group CanbusAbstractEventGroup: event-group=ChassisEventGroup
package /HuaweiMDC/PlatFormServices/CanbusAbstractServiceProvider
  provided someip service instance CanbusAbstractSomeipServiceInstance: service-interface=ChassisSomeipInterfaceDeployment, service-instance-id=1
    someip provided event group CanbusAbstractEventGroup: event-group=ChassisEventGroup, multicast-threshold=0
