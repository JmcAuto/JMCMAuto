AUTOSAR XML (schema 00046)
package /jmc_auto/PlatformServices/CanbusAbstractProcess
  process CanbusAbstractProcess: executable=CanbusAbstractExecutable, mode-dependent-startup-config{function-group-mode=[MachineModeGroupPrototype, MachineModeGroupPrototype.VehicleInActive], machine-mode=MachineModeGroupPrototype.Startup, resource-group=Dmini0ResourceLimitationGroup1, startup-config=CanbusAbstractStartupConfig}
package /jmc_auto/PlatformServices/CanbusAbstractStartupConfig
  startup config set CanbusAbstractStartupConfigSet
    startup config CanbusAbstractStartupConfig: scheduling-policy=SCHEDULING-POLICY-ROUND-ROBIN, scheduling-priority=12
