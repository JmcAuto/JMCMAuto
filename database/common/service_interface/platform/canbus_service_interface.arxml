AUTOSAR XML (schema 00046)
package /jmc_auto/Platform/ChassisMsgDateType
  impl type ChassisMsg: implementation-data-type=Chassis
package /jmc_auto/Platform/ChassisServiceInterface
  service interface ChassisServiceInterface: is-service=true
    namespaces:
      symbol props jmc_auto
    events:
      data ChassisEvent: type=ChassisMsg
  someip service interface deployment ChassisSomeipInterfaceDeployment: service-interface=ChassisServiceInterface, service-interface-id=102, service-interface-version={major-version=1, minor-version=0}
    someip event deployment ChassisEventDeployment: event=ChassisEvent, event-id=1001, transport-protocol=UDP
