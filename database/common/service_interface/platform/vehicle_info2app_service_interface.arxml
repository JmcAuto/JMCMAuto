AUTOSAR XML (schema 00046)
package /HuaweiMDC/Platform/VehicleInfoToAppMsgDataType
  impl type AutonomyModeSt: category=STRUCTURE
    element gear_autonomous: implementation-data-type=Bool
    element speed_autonomous: implementation-data-type=Bool
    element steering_autonomous: implementation-data-type=Bool
  impl type VehicleInfoAppDataType: category=STRUCTURE
    22 x element, all with category=TYPE_REFERENCE:
      header: implementation-data-type=ComHeader
      gear: implementation-data-type=UInt8
      throttle: implementation-data-type=Float
      throttle_rate: implementation-data-type=Float
      engine_rpm: implementation-data-type=Float
      vehicle_speed: implementation-data-type=Float
      wheel_speed: implementation-data-type=WheelSpeedSt
      brake: implementation-data-type=Float
      steering_wheel_angle: implementation-data-type=Float
      steering_angle: implementation-data-type=Float
      steering_velocity: implementation-data-type=Float
      front_left_angle: implementation-data-type=Float
      front_right_angle: implementation-data-type=Float
      turn_light: implementation-data-type=UInt8
      hazard_lights: implementation-data-type=UInt8
      horn: implementation-data-type=UInt8
      mileage: implementation-data-type=Float
      yaw_rate: implementation-data-type=Float
      battery_voltage: implementation-data-type=Float
      interior_temperature: implementation-data-type=Float
      outside_temperature: implementation-data-type=Float
      autonomy_mode: implementation-data-type=AutonomyModeSt
  impl type WheelSpeedSt: category=STRUCTURE
    4 x element, all with category=TYPE_REFERENCE, implementation-data-type=Float:
      front_left
      front_right
      rear_left
      rear_right
package /HuaweiMDC/Platform/VehicleInfoToAppServiceInterface
  service interface VehicleInfoToApp: is-service=true
    namespaces:
      symbol props mdc
      symbol props actuator
    events:
      data CarReportEvent: type=VehicleInfoAppDataType
  dds service interface deployment VehicleInfoToAppDeployment: service-interface=VehicleInfoToApp, service-interface-id=12
    dds event deployment VehicleInfoToAppEventDeployment: event=CarReportEvent, topic-name=VehicleInfoDdsEvent
