AUTOSAR XML (schema 00046)
package /HuaweiMDC/CommonDataTypes
  impl type ComHeader: category=STRUCTURE
    element seq: implementation-data-type=UInt32
    element stamp: implementation-data-type=Time
    element frameId: implementation-data-type=String
  impl type Time: category=STRUCTURE
    element sec: implementation-data-type=UInt32
    element nsec: implementation-data-type=UInt32
