AUTOSAR XML (schema 00046)
package /jmc_auto/drive_state
  impl type Advice: compu {0=UNKNOW, 1=DISALLOW_ENGAGE, 2=READY_TO_ENGAGE, 3=KEEP_ENGAGE, 4=PREPARE_DISENGAGE}, implementation-data-type=UInt8
  impl type EngageAdvice: category=STRUCTURE
    element Advice: implementation-data-type=Advice
    element reason: implementation-data-type=String
package /jmc_auto/vehicle_signal
  impl type VehicleSignal: category=STRUCTURE
    5 x element, all with category=TYPE_REFERENCE:
      high_beam: implementation-data-type=Bool
      low_beam: implementation-data-type=Bool
      horn: implementation-data-type=Bool
      emergency_light: implementation-data-type=Bool
      turn_signal: implementation-data-type=TurnSignal
