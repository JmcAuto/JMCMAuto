AUTOSAR XML (schema 00046)
package /jmc_auto/adapters/adapter_config
  impl type AdapterConfig: category=STRUCTURE
    4 x element, all with category=TYPE_REFERENCE:
      type: implementation-data-type=MessageType
      mode: implementation-data-type=Mode
      message_history_limit: implementation-data-type=Int32
      latch: implementation-data-type=Bool
  impl type AdapterManagerConfig: category=STRUCTURE
    element config: category=VECTOR, implementation-data-type=AdapterConfig
    element is_ros: implementation-data-type=Bool
  impl type MessageType: compu {1=POINT_CLOUD, 2=GPS, 3=IMU, 4=CHASSIS, 5=LOCALIZATION, 6=PLANNING_TRAJECTORY, 7=MONITOR, 8=PAD, 9=CONTROL_COMMAND, 10=PREDICTION, 11=PERCEPTION_OBSTACLES, 12=TRAFFIC_LIGHT_DETECTION, 13=CHASSIS_DETAIL, 14=DECISION, 15=CANBUS, 16=ROUTING_REQUEST, 17=ROUTING_RESPONSE, 18=RELATIVE_ODOMETRY, 19=INS_STAT, 20=HMI_COMMAND, 21=SYSTEM_STATUS, 22=INS_STATUS, 23=GNSS_STATUS, 24=CONTI_RADAR, 25=DRIVE_EVENT, 26=GNSS_RTK_OBS, 27=GNSS_RTK_EPH, 28=GNSS_BEST_POSE, 29=LOCALIZATION_MSF_GNSS, 30=LOCALIZATION_MSF_LIDAR, 31=LOCALIZATION_MSF_SINS_PVA, 32=RAW_IMU, 33=LOCALIZATION_MSF_STATUS, 34=STATIC_INFO, 35=RELATIVE_MAP, 36=NAVIGATION, 37=ULTRASONIC_RADAR, 38=PERCEPTION_LANE_MASK, 39=GUARDIAN, 40=GNSS_RAW_DATA, 41=STREAM_STATUS, 42=GNSS_HEADING, 43=RTCM_DATA, 44=VLP16_POINT_CLOUD, 45=POINT_CLOUD_RAW, 46=VELODYNE_RAW, 47=POINT_CLOUD_FUSION, 48=REMOTE_CONTROL}, implementation-data-type=UInt16
  impl type Mode: compu {0=RECEIVE_ONLY, 1=PUBLISH_ONLY, 2=DUPLEX}, implementation-data-type=UInt16
package /jmc_auto/configs/vehicle_config
  impl type Extrinsics: category=TYPE_REFERENCE
    element tansforms: category=VECTOR, implementation-data-type=UInt64
  impl type SectionType: compu-method=SectionTypeEnum, implementation-data-type=UInt8
  compu method SectionTypeEnum: 0=SECTION_HEADER, 1000=SECTION_CHUNK_HEADER, 2=SECTION_CHUNK_BODY, 3=SECTION_INDEX, 4=SECTION_CHANNEL
  impl type Transform: category=TYPE_REFERENCE
    4 x element, all with category=TYPE_REFERENCE:
      source_frame
      target_frame: implementation-data-type=String
      translation: implementation-data-type=Point3D
      rotation: implementation-data-type=Quaternion
  impl type VehicleBrand: compu {0=LINCOLN_MKZ, 1=GEM, 2=CH, 3=TESHUN}, implementation-data-type=UInt32
  impl type VehicleConfig: category=TYPE_REFERENCE
    element header: implementation-data-type=UInt64
    element vehicle_param: implementation-data-type=VehicleParam
    element extrinsics: implementation-data-type=Extrinsics
  impl type VehicleParam: category=TYPE_REFERENCE
    18 x element, all with category=TYPE_REFERENCE:
      brand: implementation-data-type=VehicleBrand
      front_edge_to_center: implementation-data-type=Double
      back_edge_to_center: implementation-data-type=VehicleBrand
      left_edge_to_center: implementation-data-type=VehicleBrand
      right_edge_to_center: implementation-data-type=VehicleBrand
      length: implementation-data-type=VehicleBrand
      width: implementation-data-type=VehicleBrand
      height: implementation-data-type=VehicleBrand
      min_turn_radius: implementation-data-type=VehicleBrand
      max_acceleration: implementation-data-type=VehicleBrand
      max_deceleration: implementation-data-type=VehicleBrand
      max_steer_angle: implementation-data-type=VehicleBrand
      max_steer_angle_rate: implementation-data-type=VehicleBrand
      min_steer_angle_rate: implementation-data-type=VehicleBrand
      steer_ratio: implementation-data-type=VehicleBrand
      wheel_base: implementation-data-type=VehicleBrand
      wheel_rolling_radius: implementation-data-type=VehicleBrand
      max_abs_speed_when_stopped: implementation-data-type=Float
package /jmc_auto/drive_state
  impl type Advice: compu {0=UNKNOW, 1=DISALLOW_ENGAGE, 2=READY_TO_ENGAGE, 3=KEEP_ENGAGE, 4=PREPARE_DISENGAGE}, implementation-data-type=UInt8
  impl type EngageAdvice: category=STRUCTURE
    element Advice: implementation-data-type=Advice
    element reason: implementation-data-type=String
package /jmc_auto/error_code
  impl type ErrorCode: compu {0=OK, 1000=CONTROL_ERROR, 1001=CONTROL_INIT_ERROR, 1002=CONTROL_COMPUTE_ERROR, 2000=CANBUS_ERROR, 2100=CAN_CLIENT_ERROR_BASE, 2101=CAN_CLIENT_ERROR_OPEN_DEVICE_FAILED, 2102=CAN_CLIENT_ERROR_FRAME_NUM, 2103=CAN_CLIENT_ERROR_SEND_FAILED, 2104=CAN_CLIENT_ERROR_RECV_FAILED, 3000=LOCALIZATION_ERROR, 3100=LOCALIZATION_ERROR_MSG, 3200=LOCALIZATION_ERROR_LIDAR, 3300=LOCALIZATION_ERROR_INTEG, 3400=LOCALIZATION_ERROR_GNSS, 4000=PERCEPTION_ERROR, 4001=PERCEPTION_ERROR_TF, 4002=PERCEPTION_ERROR_PROCESS, 4003=PERCEPTION_FATAL, 5000=PREDICTION_ERROR, 6000=PLANNING_ERROR, 7000=HDMAP_DATA_ERROR, 8000=ROUTING_ERROR, 8001=ROUTING_ERROR_REQUEST, 8002=ROUTING_ERROR_RESPONSE, 8003=ROUTING_ERROR_NOT_READY, 9000=END_OF_INPUT, 10000=HTTP_LOGIC_ERROR, 10001=HTTP_RUNTIME_ERROR, 11000=RELATIVE_MAP_ERROR, 11001=RELATIVE_MAP_NOT_READY, 12000=DRIVER_ERROR_GNSS, 13000=DRIVER_ERROR_VELODYNE}, implementation-data-type=UInt8
  impl type StatusPb: category=TYPE_REFERENCE
    element error_code: implementation-data-type=ErrorCode
    element msg: implementation-data-type=String
package /jmc_auto/geometry
  6 x impl type, all with category=TYPE_REFERENCE:
    Point2D
      element x: implementation-data-type=Double
      element y: implementation-data-type=Double
    Point3D
      element x: implementation-data-type=Double
      element y: implementation-data-type=Double
      element z: implementation-data-type=Double
    PointENU
      element x: implementation-data-type=Double
      element y: implementation-data-type=Double
      element z: implementation-data-type=Double
    PointLLH
      element lon: implementation-data-type=Double
      element lat: implementation-data-type=Double
      element height: implementation-data-type=Double
    Polygon
      element c: category=VECTOR, implementation-data-type=Point3D
    Quaternion
      4 x element, all with category=TYPE_REFERENCE, implementation-data-type=ErrorCode:
        qx
        qy
        qz
        qw
package /jmc_auto/header
  impl type Header: category=TYPE_REFERENCE
    8 x element, all with category=TYPE_REFERENCE:
      timestamp_sec: implementation-data-type=Double
      module_name: implementation-data-type=String
      sequence_num: implementation-data-type=UInt32
      lidar_timestamp: implementation-data-type=UInt64
      camera_timestamp: implementation-data-type=UInt64
      radar_timestamp: implementation-data-type=UInt64
      version: implementation-data-type=UInt32
      status: implementation-data-type=StatusPb
package /jmc_auto/monitor_log/monitor_log
  impl type LogLevel: compu {0=INFO, 1=WARN, 2=ERROR, 3=FATAL}, implementation-data-type=UInt8
  impl type MessageSource: compu {1=UNKNOWN, 2=CANBUS, 3=CONTROL, 4=DECISION, 5=LOCALIZATION, 6=PLANNING, 7=PREDICTION, 8=SIMULATOR, 9=HWSYS, 10=ROUTING, 11=MONITOR, 12=HMI, 13=RELATIVE_MAP, 14=GNSS, 15=REMOTECONTROL}, implementation-data-type=UInt8
  impl type MonitorMessage: category=TYPE_REFERENCE
    element source: implementation-data-type=MessageSource
    element msg: implementation-data-type=String
    element log_level: implementation-data-type=LogLevel
  impl type MonitorMessageItem: category=TYPE_REFERENCE
    element header: category=TYPE_REFERENCE
    element item: implementation-data-type=MonitorMessageItem
package /jmc_auto/pnc_point
  10 x impl type, all with category=TYPE_REFERENCE:
    FrenetFramePoint
      4 x element, all with category=TYPE_REFERENCE, implementation-data-type=Double:
        s
        l
        dl
        ddl
    GaussianInfo
      7 x element, all with category=TYPE_REFERENCE, implementation-data-type=Double:
        sigma_x
        sigma_y
        correlation
        area_probability
        ellipse_a
        ellipse_b
        theta_a
    Path
      element name: implementation-data-type=String
      element path_point: category=VECTOR, implementation-data-type=Double
    PathPoint
      9 x element, all with category=TYPE_REFERENCE:
        x: implementation-data-type=Double
        y: implementation-data-type=Double
        z: implementation-data-type=Double
        theta: implementation-data-type=Double
        kappa: implementation-data-type=Double
        s: implementation-data-type=Double
        dkappa: implementation-data-type=Double
        ddkappa: implementation-data-type=Double
        lane_id: implementation-data-type=String
    SLPoint
      element s: implementation-data-type=Double
      element l: implementation-data-type=Double
    SpeedPoint
      5 x element, all with category=TYPE_REFERENCE, implementation-data-type=Double:
        s
        t
        v
        a
        da
    Trajectory
      element name: implementation-data-type=String
      element vehicle_motion_point: category=VECTOR, implementation-data-type=Vehicle_Chassis
    TrajectoryPoint
      7 x element, all with category=TYPE_REFERENCE:
        path_point: implementation-data-type=PathPoint
        v: implementation-data-type=Double
        a: implementation-data-type=Double
        relative_time: implementation-data-type=Double
        da: implementation-data-type=Double
        steer: implementation-data-type=Double
        gaussian_info: implementation-data-type=GaussianInfo
    VehicleMotion
      element name: implementation-data-type=String
      element vehicle_motion_point: category=VECTOR, implementation-data-type=VehicleMotionPoint
    VehicleMotionPoint
      element trajectory_point: implementation-data-type=TrajectoryPoint
      element steer: implementation-data-type=Double
package /jmc_auto/proto_desc
  impl type ProtoDesc: category=TYPE_REFERENCE
    element desc: implementation-data-type=BeamLampType
    element dependencies: category=VECTOR, implementation-data-type=ProtoDesc
package /jmc_auto/record
  7 x impl type, all with category=TYPE_REFERENCE:
    Channel
      element name: implementation-data-type=String
      element message_type: implementation-data-type=String
      element proto_desc: category=TYPE_REFERENCE
    ChannelCache
      4 x element, all with category=TYPE_REFERENCE:
        message_number: implementation-data-type=UInt64
        name: implementation-data-type=String
        message_type: implementation-data-type=String
        proto_desc
    ChunkBody
      element messages: category=VECTOR, implementation-data-type=SingleMessage
    ChunkBodyCache
      element message_number: implementation-data-type=UInt64
    ChunkHeader
      4 x element, all with category=TYPE_REFERENCE, implementation-data-type=UInt64:
        begin_time
        end_time
        message_number
        raw_size
    ChunkHeaderCache
      4 x element, all with category=TYPE_REFERENCE, implementation-data-type=UInt64:
        message_number
        begin_time
        end_time
        raw_size
    CompressType: compu {0=OK, 1000=CONTROL_ERROR, 1001=CONTROL_INIT_ERROR, 1002=CONTROL_COMPUTE_ERROR, 2000=CANBUS_ERROR, 2100=CAN_CLIENT_ERROR_BASE, 2101=CAN_CLIENT_ERROR_OPEN_DEVICE_FAILED, 2102=CAN_CLIENT_ERROR_FRAME_NUM, 2103=CAN_CLIENT_ERROR_SEND_FAILED, 2104=CAN_CLIENT_ERROR_RECV_FAILED, 3000=LOCALIZATION_ERROR, 3100=LOCALIZATION_ERROR_MSG, 3200=LOCALIZATION_ERROR_LIDAR, 3300=LOCALIZATION_ERROR_INTEG, 3400=LOCALIZATION_ERROR_GNSS, 4000=PERCEPTION_ERROR, 4001=PERCEPTION_ERROR_TF, 4002=PERCEPTION_ERROR_PROCESS, 4003=PERCEPTION_FATAL, 5000=PREDICTION_ERROR, 6000=PLANNING_ERROR, 7000=HDMAP_DATA_ERROR, 8000=ROUTING_ERROR, 8001=ROUTING_ERROR_REQUEST, 8002=ROUTING_ERROR_RESPONSE, 8003=ROUTING_ERROR_NOT_READY, 9000=END_OF_INPUT, 10000=HTTP_LOGIC_ERROR, 10001=HTTP_RUNTIME_ERROR, 11000=RELATIVE_MAP_ERROR, 11001=RELATIVE_MAP_NOT_READY, 12000=DRIVER_ERROR_GNSS, 13000=DRIVER_ERROR_VELODYNE}, implementation-data-type=UInt8
  impl type Header: category=TYPE_REFERENCE
    15 x element, all with category=TYPE_REFERENCE:
      major_version: implementation-data-type=UInt32
      minor_version: implementation-data-type=UInt32
      compress: implementation-data-type=CompressType
      chunk_interval: implementation-data-type=UInt64
      segment_interval: implementation-data-type=UInt64
      index_position: implementation-data-type=UInt64
      chunk_number: implementation-data-type=UInt64
      channel_number
      begin_time: implementation-data-type=UInt64
      end_time: implementation-data-type=UInt64
      message_number: implementation-data-type=UInt64
      size: implementation-data-type=UInt64
      is_complete: implementation-data-type=Bool
      chunk_raw_size: implementation-data-type=UInt64
      segment_raw_size: implementation-data-type=UInt64
  impl type Index: category=TYPE_REFERENCE
    element indexes: category=VECTOR, implementation-data-type=SingleIndex
  impl type SectionType: compu {0=SECTION_HEADER, 1000=SECTION_CHUNK_HEADER, 2=SECTION_CHUNK_BODY, 3=SECTION_INDEX, 4=SECTION_CHANNEL}, implementation-data-type=UInt8
  impl type SingleIndex: category=TYPE_REFERENCE
    element type: implementation-data-type=record/SectionType
    element position: implementation-data-type=UInt64
  impl type SingleMessage: category=TYPE_REFERENCE
    element channel_name: implementation-data-type=String
    element time: implementation-data-type=UInt64
    element content: implementation-data-type=UInt64
package /jmc_auto/vehicle_model/vehicle_model_config
  impl type ComCenteredDynamicBicycleModelConfig: category=TYPE_REFERENCE
    element dt: implementation-data-type=Double
  impl type MlpModelConfig: category=TYPE_REFERENCE
    element dt: implementation-data-type=Double
  impl type ModelType: compu {0=REAR_CENTERED_KINEMATIC_BICYCLE_MODEL, 1=COM_CENTERED_DYNAMIC_BICYCLE_MODEL, 2=MLP_MODEL}, implementation-data-type=UInt8
  impl type RearCenteredKinematicBicycleModelConfig: category=TYPE_REFERENCE
    element dt: implementation-data-type=Double
  impl type VehicleModelConfig: category=TYPE_REFERENCE
    4 x element, all with category=TYPE_REFERENCE:
      model_type: implementation-data-type=ModelType
      rc_kinematic_bicycle_model: implementation-data-type=RearCenteredKinematicBicycleModelConfig
      comc_dynamic_bicycle_model: implementation-data-type=ComCenteredDynamicBicycleModelConfig
      mlp_model: implementation-data-type=MlpModelConfig
package /jmc_auto/vehicle_signal
  impl type VehicleSignal: category=STRUCTURE
    5 x element, all with category=TYPE_REFERENCE:
      high_beam: implementation-data-type=Bool
      low_beam: implementation-data-type=Bool
      horn: implementation-data-type=Bool
      emergency_light: implementation-data-type=Bool
      turn_signal: implementation-data-type=TurnSignal
package /jmc_auto/vehicle_state/vehicle_state
  impl type VehicleState: category=TYPE_REFERENCE
    15 x element, all with category=TYPE_REFERENCE, implementation-data-type=Double:
      x
      y
      z
      timestamp
      roll
      pitch
      yaw
      heading
      kappa
      linear_velocity
      angular_velocity
      linear_acceleration
      gear
      driving_mode
      pose
