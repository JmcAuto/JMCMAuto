AUTOSAR XML (schema 00046)
package /HuaweiMDC/drive_state
  impl type Advice: display-presentation=PRESENTATION-CONTINUOUS, compu {0=UNKNOW, 1=DISALLOW_ENGAGE, 2=READY_TO_ENGAGE, 3=KEEP_ENGAGE, 4=PREPARE_DISENGAGE}, implementation-data-type=UInt32
  impl type EngageAdvice: category=STRUCT
    element advice: array-size-handling=ALL-INDICES-SAME-ARRAY-SIZE, array-size-semantics=FIXED-SIZE, implementation-data-type=Advice
    element reason: category=TYPE_REFERENCE
package /HuaweiMDC/vehicle_signal
  impl type VehicleSignal: category=STRUCT
    5 x element, all with category=TYPE_REFERENCE:
      turn_signal: implementation-data-type=TurnSignal
      high_beam: implementation-data-type=Bool
      low_beam: implementation-data-type=Bool
      horn: implementation-data-type=Bool
      emergency_light: implementation-data-type=Bool
