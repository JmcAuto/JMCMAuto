AUTOSAR XML (schema 00046)
package /jmc_auto/adapters/adapter_config
  impl type AdapterConfig: category=STRUCTURE
    4 x element, all with category=TYPE_REFERENCE:
      type: implementation-data-type=MessageType
      mode: implementation-data-type=Mode
      message_history_limit: implementation-data-type=Int32
      latch: implementation-data-type=Bool
  impl type AdapterManagerConfig: category=STRUCTURE
    element config: category=VECTOR, implementation-data-type=AdapterConfig
    element is_ros: implementation-data-type=Bool
  impl type MessageType: compu {1=POINT_CLOUD, 2=GPS, 3=IMU, 4=CHASSIS, 5=LOCALIZATION, 6=PLANNING_TRAJECTORY, 7=MONITOR, 8=PAD, 9=CONTROL_COMMAND, 10=PREDICTION, 11=PERCEPTION_OBSTACLES, 12=TRAFFIC_LIGHT_DETECTION, 13=CHASSIS_DETAIL, 14=DECISION, 15=CANBUS, 16=ROUTING_REQUEST, 17=ROUTING_RESPONSE, 18=RELATIVE_ODOMETRY, 19=INS_STAT, 20=HMI_COMMAND, 21=SYSTEM_STATUS, 22=INS_STATUS, 23=GNSS_STATUS, 24=CONTI_RADAR, 25=DRIVE_EVENT, 26=GNSS_RTK_OBS, 27=GNSS_RTK_EPH, 28=GNSS_BEST_POSE, 29=LOCALIZATION_MSF_GNSS, 30=LOCALIZATION_MSF_LIDAR, 31=LOCALIZATION_MSF_SINS_PVA, 32=RAW_IMU, 33=LOCALIZATION_MSF_STATUS, 34=STATIC_INFO, 35=RELATIVE_MAP, 36=NAVIGATION, 37=ULTRASONIC_RADAR, 38=PERCEPTION_LANE_MASK, 39=GUARDIAN, 40=GNSS_RAW_DATA, 41=STREAM_STATUS, 42=GNSS_HEADING, 43=RTCM_DATA, 44=VLP16_POINT_CLOUD, 45=POINT_CLOUD_RAW, 46=VELODYNE_RAW, 47=POINT_CLOUD_FUSION, 48=REMOTE_CONTROL}, implementation-data-type=UInt16
  impl type Mode: compu {0=RECEIVE_ONLY, 1=PUBLISH_ONLY, 2=DUPLEX}, implementation-data-type=UInt16
package /jmc_auto/drive_state
  impl type Advice: compu {0=UNKNOW, 1=DISALLOW_ENGAGE, 2=READY_TO_ENGAGE, 3=KEEP_ENGAGE, 4=PREPARE_DISENGAGE}, implementation-data-type=UInt8
  impl type EngageAdvice: category=STRUCTURE
    element Advice: implementation-data-type=Advice
    element reason: implementation-data-type=String
package /jmc_auto/error_code
  impl type ErrorCode: compu {0=OK, 1000=CONTROL_ERROR, 1001=CONTROL_INIT_ERROR, 1002=CONTROL_COMPUTE_ERROR, 2000=CANBUS_ERROR, 2100=CAN_CLIENT_ERROR_BASE, 2101=CAN_CLIENT_ERROR_OPEN_DEVICE_FAILED, 2102..=, , }, implementation-data-type=UInt32
  impl type StatusPb: category=STRUCTURE
    element error_code: implementation-data-type=ErrorCode
    element msg: implementation-data-type=String
package /jmc_auto/vehicle_signal
  impl type VehicleSignal: category=STRUCTURE
    5 x element, all with category=TYPE_REFERENCE:
      high_beam: implementation-data-type=Bool
      low_beam: implementation-data-type=Bool
      horn: implementation-data-type=Bool
      emergency_light: implementation-data-type=Bool
      turn_signal: implementation-data-type=TurnSignal
