AUTOSAR XML (schema 00046)
standard types defined: Double, Float, UInt16, UInt32, UInt64, UInt8
package /HuaweiMDC/ImplementationDataType
  8 x impl type:
    Bool: category=VALUE, base-type=std_bool
    ByteArray: category=VECTOR
      element Dim1Element: implementation-data-type=UInt8
    Enum: category=VALUE, base-type=std_uint8_t
    Int16: category=VALUE, base-type=std_int16_t
    Int32: category=VALUE, base-type=std_int32_t
    Int64: category=VALUE, base-type=std_int64_t
    Int8: category=VALUE, base-type=std_int8_t
    String: category=STRING, base-type=std_string
package /HuaweiMDC/SwBaseType
  12 x base type, all with base-type-encoding=NONE:
    std_bool: category=VALUE, base-type-size=8, byte-order=opaque, native-declaration=bool
    std_double: category=VALUE, base-type-size=64, byte-order=little-endian, native-declaration=double
    std_float: category=VALUE, base-type-size=32, byte-order=little-endian, native-declaration=float
    std_int16_t: category=VALUE, base-type-size=16, byte-order=little-endian, native-declaration=std::int16_t
    std_int32_t: category=VALUE, base-type-size=32, byte-order=little-endian, native-declaration=std::int32_t
    std_int64_t: category=VALUE, base-type-size=64, byte-order=little-endian, native-declaration=std::int64_t
    std_int8_t: category=VALUE, base-type-size=8, byte-order=little-endian, native-declaration=std::int8_t
    std_string: base-type-size=8, byte-order=little-endian, native-declaration=std::string
    std_uint16_t: category=VALUE, base-type-size=16, byte-order=little-endian, native-declaration=std::uint16_t
    std_uint32_t: category=VALUE, base-type-size=32, byte-order=little-endian, native-declaration=std::uint32_t
    std_uint64_t: category=VALUE, base-type-size=64, byte-order=little-endian, native-declaration=std::uint64_t
    std_uint8_t: category=VALUE, base-type-size=8, byte-order=little-endian, native-declaration=std::uint8_t
