AUTOSAR XML (schema 00046)
package /HuaweiMDC/canbus_conf
  impl type CanbusConf: category=TYPE_REFERENCE
    5 x element, all with category=TYPE_REFERENCE:
      vehicle_parameter: implementation-data-type=Double
      can_card_parameter: implementation-data-type=WheelSpeedType
      enable_debug_mode: implementation-data-type=Bool
      enable_receiver_log: implementation-data-type=Bool
      enable_sender_log: implementation-data-type=Bool
package /HuaweiMDC/ch
  10 x impl type, all with category=TYPE_REFERENCE:
    Brake_command_111
      79 x element, all with category=TYPE_REFERENCE:
        engine_started: implementation-data-type=Bool
        engine_rpm: implementation-data-type=Float
        speed_mps: implementation-data-type=Float
        odometer_m: implementation-data-type=Float
        fuel_range_m: implementation-data-type=Int32
        throttle_percentage: implementation-data-type=Float
        brake_percentage: implementation-data-type=Float
        brake_percentage: implementation-data-type=Float
        brake_percentage: implementation-data-type=Float
        steering_torque_nm: implementation-data-type=Float
        parking_brake: implementation-data-type=Bool
        high_beam_signal: implementation-data-type=Bool
        low_beam_signal: implementation-data-type=Bool
        left_turn_signal: implementation-data-type=Bool
        right_turn_signal: implementation-data-type=Bool
        horn: implementation-data-type=Bool
        wiper: implementation-data-type=Bool
        disengage_status: implementation-data-type=Bool
        driving_mode: implementation-data-type=DrivingMode
        error_code: implementation-data-type=ErrorCode
        gear_location: implementation-data-type=GearPosition
        steering_timestamp: implementation-data-type=Double
        header
        chassis_error_mask: implementation-data-type=Int32
        signal: implementation-data-type=Bool
        chassis_gps: implementation-data-type=CameraHeader
        engage_advice: implementation-data-type=Bool
        wheel_speed: implementation-data-type=Wheel_speed_rpt_7a
        surround: implementation-data-type=Bool
        license: implementation-data-type=Bool
        lon_acc: implementation-data-type=Float
        steer_wheel_rot_spd: implementation-data-type=Float
        abs_vehspdlgt_valid: implementation-data-type=Bool
        esp_algtstatus_valid: implementation-data-type=Bool
        sas_sasstssnsr_valid: implementation-data-type=Bool
        steerwheelrotspd_valid: implementation-data-type=Bool
        eps_lkaresponsetorque_valid: implementation-data-type=Bool
        eps_torsionbartorque: implementation-data-type=Float
        eps_tosionbartorquevalid: implementation-data-type=Bool
        abs_whlmilgfrntri: implementation-data-type=Int32
        abs_whlmilgfrntle: implementation-data-type=Int32
        abs_whlmilgrearre: implementation-data-type=Int32
        abs_whlmilgrearle: implementation-data-type=Int32
        esp_wheelpulse_fl: implementation-data-type=Int32
        esp_wheelpulse_fr: implementation-data-type=Int32
        esp_wheelpulse_rl: implementation-data-type=Int32
        esp_wheelpulse_rr: implementation-data-type=Int32
        ems_accpedalratio: implementation-data-type=Double
        brkpedalstasus: implementation-data-type=ch/Ctrl_cmdType
        abs_whlspdfrntle: implementation-data-type=Double
        abs_whlspdfrntri: implementation-data-type=Double
        abs_whlspdrele: implementation-data-type=Double
        abs_whlspdreri: implementation-data-type=Double
        acc_x: implementation-data-type=Double
        acc_y: implementation-data-type=Double
        acc_z: implementation-data-type=Double
        gyro_x: implementation-data-type=Double
        gyro_y: implementation-data-type=Double
        gyro_z: implementation-data-type=Double
        ins_pitchangle: implementation-data-type=Double
        ins_rollangle: implementation-data-type=Double
        ins_headingangle: implementation-data-type=Double
        ins_locatheight: implementation-data-type=Double
        ins_time: implementation-data-type=Double
        ins_latitude: implementation-data-type=Double
        ins_longitude: implementation-data-type=Double
        ins_northspd: implementation-data-type=Double
        ins_eastspd: implementation-data-type=Double
        ins_togroundspd: implementation-data-type=Double
        ins_gpsflag_pos: implementation-data-type=Int32
        ins_numsv: implementation-data-type=Int32
        ins_gpsflag_heading: implementation-data-type=Int32
        ins_gps_age: implementation-data-type=Int32
        ins_car_status: implementation-data-type=Int32
        ins_status: implementation-data-type=Int32
        ins_std_lat: implementation-data-type=Double
        ins_std_lon: implementation-data-type=Double
        ins_std_locat_height: implementation-data-type=Double
        ins_std_heading: implementation-data-type=Double
    Brake_status__511
      79 x element, all with category=TYPE_REFERENCE:
        engine_started: implementation-data-type=Bool
        engine_rpm: implementation-data-type=Float
        speed_mps: implementation-data-type=Float
        odometer_m: implementation-data-type=Float
        fuel_range_m: implementation-data-type=Int32
        throttle_percentage: implementation-data-type=Float
        brake_percentage: implementation-data-type=Float
        brake_percentage: implementation-data-type=Float
        brake_percentage: implementation-data-type=Float
        steering_torque_nm: implementation-data-type=Float
        parking_brake: implementation-data-type=Bool
        high_beam_signal: implementation-data-type=Bool
        low_beam_signal: implementation-data-type=Bool
        left_turn_signal: implementation-data-type=Bool
        right_turn_signal: implementation-data-type=Bool
        horn: implementation-data-type=Bool
        wiper: implementation-data-type=Bool
        disengage_status: implementation-data-type=Bool
        driving_mode: implementation-data-type=DrivingMode
        error_code: implementation-data-type=ErrorCode
        gear_location: implementation-data-type=GearPosition
        steering_timestamp: implementation-data-type=Double
        header
        chassis_error_mask: implementation-data-type=Int32
        signal: implementation-data-type=Bool
        chassis_gps: implementation-data-type=CameraHeader
        engage_advice: implementation-data-type=Bool
        wheel_speed: implementation-data-type=Wheel_speed_rpt_7a
        surround: implementation-data-type=Bool
        license: implementation-data-type=Bool
        lon_acc: implementation-data-type=Float
        steer_wheel_rot_spd: implementation-data-type=Float
        abs_vehspdlgt_valid: implementation-data-type=Bool
        esp_algtstatus_valid: implementation-data-type=Bool
        sas_sasstssnsr_valid: implementation-data-type=Bool
        steerwheelrotspd_valid: implementation-data-type=Bool
        eps_lkaresponsetorque_valid: implementation-data-type=Bool
        eps_torsionbartorque: implementation-data-type=Float
        eps_tosionbartorquevalid: implementation-data-type=Bool
        abs_whlmilgfrntri: implementation-data-type=Int32
        abs_whlmilgfrntle: implementation-data-type=Int32
        abs_whlmilgrearre: implementation-data-type=Int32
        abs_whlmilgrearle: implementation-data-type=Int32
        esp_wheelpulse_fl: implementation-data-type=Int32
        esp_wheelpulse_fr: implementation-data-type=Int32
        esp_wheelpulse_rl: implementation-data-type=Int32
        esp_wheelpulse_rr: implementation-data-type=Int32
        ems_accpedalratio: implementation-data-type=Double
        brkpedalstasus: implementation-data-type=ch/Ctrl_cmdType
        abs_whlspdfrntle: implementation-data-type=Double
        abs_whlspdfrntri: implementation-data-type=Double
        abs_whlspdrele: implementation-data-type=Double
        abs_whlspdreri: implementation-data-type=Double
        acc_x: implementation-data-type=Double
        acc_y: implementation-data-type=Double
        acc_z: implementation-data-type=Double
        gyro_x: implementation-data-type=Double
        gyro_y: implementation-data-type=Double
        gyro_z: implementation-data-type=Double
        ins_pitchangle: implementation-data-type=Double
        ins_rollangle: implementation-data-type=Double
        ins_headingangle: implementation-data-type=Double
        ins_locatheight: implementation-data-type=Double
        ins_time: implementation-data-type=Double
        ins_latitude: implementation-data-type=Double
        ins_longitude: implementation-data-type=Double
        ins_northspd: implementation-data-type=Double
        ins_eastspd: implementation-data-type=Double
        ins_togroundspd: implementation-data-type=Double
        ins_gpsflag_pos: implementation-data-type=Int32
        ins_numsv: implementation-data-type=Int32
        ins_gpsflag_heading: implementation-data-type=Int32
        ins_gps_age: implementation-data-type=Int32
        ins_car_status: implementation-data-type=Int32
        ins_status: implementation-data-type=Int32
        ins_std_lat: implementation-data-type=Double
        ins_std_lon: implementation-data-type=Double
        ins_std_locat_height: implementation-data-type=Double
        ins_std_heading: implementation-data-type=Double
    Ch
      79 x element, all with category=TYPE_REFERENCE:
        engine_started: implementation-data-type=Bool
        engine_rpm: implementation-data-type=Float
        speed_mps: implementation-data-type=Float
        odometer_m: implementation-data-type=Float
        fuel_range_m: implementation-data-type=Int32
        throttle_percentage: implementation-data-type=Float
        brake_percentage: implementation-data-type=Float
        brake_percentage: implementation-data-type=Float
        brake_percentage: implementation-data-type=Float
        steering_torque_nm: implementation-data-type=Float
        parking_brake: implementation-data-type=Bool
        high_beam_signal: implementation-data-type=Bool
        low_beam_signal: implementation-data-type=Bool
        left_turn_signal: implementation-data-type=Bool
        right_turn_signal: implementation-data-type=Bool
        horn: implementation-data-type=Bool
        wiper: implementation-data-type=Bool
        disengage_status: implementation-data-type=Bool
        driving_mode: implementation-data-type=DrivingMode
        error_code: implementation-data-type=ErrorCode
        gear_location: implementation-data-type=GearPosition
        steering_timestamp: implementation-data-type=Double
        header
        chassis_error_mask: implementation-data-type=Int32
        signal: implementation-data-type=Bool
        chassis_gps: implementation-data-type=CameraHeader
        engage_advice: implementation-data-type=Bool
        wheel_speed: implementation-data-type=Wheel_speed_rpt_7a
        surround: implementation-data-type=Bool
        license: implementation-data-type=Bool
        lon_acc: implementation-data-type=Float
        steer_wheel_rot_spd: implementation-data-type=Float
        abs_vehspdlgt_valid: implementation-data-type=Bool
        esp_algtstatus_valid: implementation-data-type=Bool
        sas_sasstssnsr_valid: implementation-data-type=Bool
        steerwheelrotspd_valid: implementation-data-type=Bool
        eps_lkaresponsetorque_valid: implementation-data-type=Bool
        eps_torsionbartorque: implementation-data-type=Float
        eps_tosionbartorquevalid: implementation-data-type=Bool
        abs_whlmilgfrntri: implementation-data-type=Int32
        abs_whlmilgfrntle: implementation-data-type=Int32
        abs_whlmilgrearre: implementation-data-type=Int32
        abs_whlmilgrearle: implementation-data-type=Int32
        esp_wheelpulse_fl: implementation-data-type=Int32
        esp_wheelpulse_fr: implementation-data-type=Int32
        esp_wheelpulse_rl: implementation-data-type=Int32
        esp_wheelpulse_rr: implementation-data-type=Int32
        ems_accpedalratio: implementation-data-type=Double
        brkpedalstasus: implementation-data-type=ch/Ctrl_cmdType
        abs_whlspdfrntle: implementation-data-type=Double
        abs_whlspdfrntri: implementation-data-type=Double
        abs_whlspdrele: implementation-data-type=Double
        abs_whlspdreri: implementation-data-type=Double
        acc_x: implementation-data-type=Double
        acc_y: implementation-data-type=Double
        acc_z: implementation-data-type=Double
        gyro_x: implementation-data-type=Double
        gyro_y: implementation-data-type=Double
        gyro_z: implementation-data-type=Double
        ins_pitchangle: implementation-data-type=Double
        ins_rollangle: implementation-data-type=Double
        ins_headingangle: implementation-data-type=Double
        ins_locatheight: implementation-data-type=Double
        ins_time: implementation-data-type=Double
        ins_latitude: implementation-data-type=Double
        ins_longitude: implementation-data-type=Double
        ins_northspd: implementation-data-type=Double
        ins_eastspd: implementation-data-type=Double
        ins_togroundspd: implementation-data-type=Double
        ins_gpsflag_pos: implementation-data-type=Int32
        ins_numsv: implementation-data-type=Int32
        ins_gpsflag_heading: implementation-data-type=Int32
        ins_gps_age: implementation-data-type=Int32
        ins_car_status: implementation-data-type=Int32
        ins_status: implementation-data-type=Int32
        ins_std_lat: implementation-data-type=Double
        ins_std_lon: implementation-data-type=Double
        ins_std_locat_height: implementation-data-type=Double
        ins_std_heading: implementation-data-type=Double
    Control_command_115
      79 x element, all with category=TYPE_REFERENCE:
        engine_started: implementation-data-type=Bool
        engine_rpm: implementation-data-type=Float
        speed_mps: implementation-data-type=Float
        odometer_m: implementation-data-type=Float
        fuel_range_m: implementation-data-type=Int32
        throttle_percentage: implementation-data-type=Float
        brake_percentage: implementation-data-type=Float
        brake_percentage: implementation-data-type=Float
        brake_percentage: implementation-data-type=Float
        steering_torque_nm: implementation-data-type=Float
        parking_brake: implementation-data-type=Bool
        high_beam_signal: implementation-data-type=Bool
        low_beam_signal: implementation-data-type=Bool
        left_turn_signal: implementation-data-type=Bool
        right_turn_signal: implementation-data-type=Bool
        horn: implementation-data-type=Bool
        wiper: implementation-data-type=Bool
        disengage_status: implementation-data-type=Bool
        driving_mode: implementation-data-type=DrivingMode
        error_code: implementation-data-type=ErrorCode
        gear_location: implementation-data-type=GearPosition
        steering_timestamp: implementation-data-type=Double
        header
        chassis_error_mask: implementation-data-type=Int32
        signal: implementation-data-type=Bool
        chassis_gps: implementation-data-type=CameraHeader
        engage_advice: implementation-data-type=Bool
        wheel_speed: implementation-data-type=Wheel_speed_rpt_7a
        surround: implementation-data-type=Bool
        license: implementation-data-type=Bool
        lon_acc: implementation-data-type=Float
        steer_wheel_rot_spd: implementation-data-type=Float
        abs_vehspdlgt_valid: implementation-data-type=Bool
        esp_algtstatus_valid: implementation-data-type=Bool
        sas_sasstssnsr_valid: implementation-data-type=Bool
        steerwheelrotspd_valid: implementation-data-type=Bool
        eps_lkaresponsetorque_valid: implementation-data-type=Bool
        eps_torsionbartorque: implementation-data-type=Float
        eps_tosionbartorquevalid: implementation-data-type=Bool
        abs_whlmilgfrntri: implementation-data-type=Int32
        abs_whlmilgfrntle: implementation-data-type=Int32
        abs_whlmilgrearre: implementation-data-type=Int32
        abs_whlmilgrearle: implementation-data-type=Int32
        esp_wheelpulse_fl: implementation-data-type=Int32
        esp_wheelpulse_fr: implementation-data-type=Int32
        esp_wheelpulse_rl: implementation-data-type=Int32
        esp_wheelpulse_rr: implementation-data-type=Int32
        ems_accpedalratio: implementation-data-type=Double
        brkpedalstasus: implementation-data-type=ch/Ctrl_cmdType
        abs_whlspdfrntle: implementation-data-type=Double
        abs_whlspdfrntri: implementation-data-type=Double
        abs_whlspdrele: implementation-data-type=Double
        abs_whlspdreri: implementation-data-type=Double
        acc_x: implementation-data-type=Double
        acc_y: implementation-data-type=Double
        acc_z: implementation-data-type=Double
        gyro_x: implementation-data-type=Double
        gyro_y: implementation-data-type=Double
        gyro_z: implementation-data-type=Double
        ins_pitchangle: implementation-data-type=Double
        ins_rollangle: implementation-data-type=Double
        ins_headingangle: implementation-data-type=Double
        ins_locatheight: implementation-data-type=Double
        ins_time: implementation-data-type=Double
        ins_latitude: implementation-data-type=Double
        ins_longitude: implementation-data-type=Double
        ins_northspd: implementation-data-type=Double
        ins_eastspd: implementation-data-type=Double
        ins_togroundspd: implementation-data-type=Double
        ins_gpsflag_pos: implementation-data-type=Int32
        ins_numsv: implementation-data-type=Int32
        ins_gpsflag_heading: implementation-data-type=Int32
        ins_gps_age: implementation-data-type=Int32
        ins_car_status: implementation-data-type=Int32
        ins_status: implementation-data-type=Int32
        ins_std_lat: implementation-data-type=Double
        ins_std_lon: implementation-data-type=Double
        ins_std_locat_height: implementation-data-type=Double
        ins_std_heading: implementation-data-type=Double
    Ctrl_cmdType: compu {0=NOT_PRESSED, 1=PRESSED, 2=RESERRVED, 3=ERROR}, implementation-data-type=UInt8
    Ctrl_cmdType: compu {0=NOT_PRESSED, 1=PRESSED, 2=RESERRVED, 3=ERROR}, implementation-data-type=UInt8
    Ctrl_cmdType: compu {0=NOT_PRESSED, 1=PRESSED, 2=RESERRVED, 3=ERROR}, implementation-data-type=UInt8
    Ctrl_cmdType: compu {0=NOT_PRESSED, 1=PRESSED, 2=RESERRVED, 3=ERROR}, implementation-data-type=UInt8
    Ctrl_cmdType: compu {0=NOT_PRESSED, 1=PRESSED, 2=RESERRVED, 3=ERROR}, implementation-data-type=UInt8
    Ctrl_cmdType: compu {0=NOT_PRESSED, 1=PRESSED, 2=RESERRVED, 3=ERROR}, implementation-data-type=UInt8
  compu method Ctrl_cmdTypeEnum: 0=NOT_PRESSED, 1=PRESSED, 2=RESERRVED, 3=ERROR
  compu method Ctrl_cmdTypeEnum: 0=NOT_PRESSED, 1=PRESSED, 2=RESERRVED, 3=ERROR
  compu method Ctrl_cmdTypeEnum: 0=NOT_PRESSED, 1=PRESSED, 2=RESERRVED, 3=ERROR
  compu method Ctrl_cmdTypeEnum: 0=NOT_PRESSED, 1=PRESSED, 2=RESERRVED, 3=ERROR
  compu method Ctrl_cmdTypeEnum: 0=NOT_PRESSED, 1=PRESSED, 2=RESERRVED, 3=ERROR
  compu method Ctrl_cmdTypeEnum: 0=NOT_PRESSED, 1=PRESSED, 2=RESERRVED, 3=ERROR
  7 x impl type, all with category=TYPE_REFERENCE:
    Ctrl_stsType: compu {0=NOT_PRESSED, 1=PRESSED, 2=RESERRVED, 3=ERROR}, implementation-data-type=UInt8
    Ecu_status_1_515
      79 x element, all with category=TYPE_REFERENCE:
        engine_started: implementation-data-type=Bool
        engine_rpm: implementation-data-type=Float
        speed_mps: implementation-data-type=Float
        odometer_m: implementation-data-type=Float
        fuel_range_m: implementation-data-type=Int32
        throttle_percentage: implementation-data-type=Float
        brake_percentage: implementation-data-type=Float
        brake_percentage: implementation-data-type=Float
        brake_percentage: implementation-data-type=Float
        steering_torque_nm: implementation-data-type=Float
        parking_brake: implementation-data-type=Bool
        high_beam_signal: implementation-data-type=Bool
        low_beam_signal: implementation-data-type=Bool
        left_turn_signal: implementation-data-type=Bool
        right_turn_signal: implementation-data-type=Bool
        horn: implementation-data-type=Bool
        wiper: implementation-data-type=Bool
        disengage_status: implementation-data-type=Bool
        driving_mode: implementation-data-type=DrivingMode
        error_code: implementation-data-type=ErrorCode
        gear_location: implementation-data-type=GearPosition
        steering_timestamp: implementation-data-type=Double
        header
        chassis_error_mask: implementation-data-type=Int32
        signal: implementation-data-type=Bool
        chassis_gps: implementation-data-type=CameraHeader
        engage_advice: implementation-data-type=Bool
        wheel_speed: implementation-data-type=Wheel_speed_rpt_7a
        surround: implementation-data-type=Bool
        license: implementation-data-type=Bool
        lon_acc: implementation-data-type=Float
        steer_wheel_rot_spd: implementation-data-type=Float
        abs_vehspdlgt_valid: implementation-data-type=Bool
        esp_algtstatus_valid: implementation-data-type=Bool
        sas_sasstssnsr_valid: implementation-data-type=Bool
        steerwheelrotspd_valid: implementation-data-type=Bool
        eps_lkaresponsetorque_valid: implementation-data-type=Bool
        eps_torsionbartorque: implementation-data-type=Float
        eps_tosionbartorquevalid: implementation-data-type=Bool
        abs_whlmilgfrntri: implementation-data-type=Int32
        abs_whlmilgfrntle: implementation-data-type=Int32
        abs_whlmilgrearre: implementation-data-type=Int32
        abs_whlmilgrearle: implementation-data-type=Int32
        esp_wheelpulse_fl: implementation-data-type=Int32
        esp_wheelpulse_fr: implementation-data-type=Int32
        esp_wheelpulse_rl: implementation-data-type=Int32
        esp_wheelpulse_rr: implementation-data-type=Int32
        ems_accpedalratio: implementation-data-type=Double
        brkpedalstasus: implementation-data-type=ch/Ctrl_cmdType
        abs_whlspdfrntle: implementation-data-type=Double
        abs_whlspdfrntri: implementation-data-type=Double
        abs_whlspdrele: implementation-data-type=Double
        abs_whlspdreri: implementation-data-type=Double
        acc_x: implementation-data-type=Double
        acc_y: implementation-data-type=Double
        acc_z: implementation-data-type=Double
        gyro_x: implementation-data-type=Double
        gyro_y: implementation-data-type=Double
        gyro_z: implementation-data-type=Double
        ins_pitchangle: implementation-data-type=Double
        ins_rollangle: implementation-data-type=Double
        ins_headingangle: implementation-data-type=Double
        ins_locatheight: implementation-data-type=Double
        ins_time: implementation-data-type=Double
        ins_latitude: implementation-data-type=Double
        ins_longitude: implementation-data-type=Double
        ins_northspd: implementation-data-type=Double
        ins_eastspd: implementation-data-type=Double
        ins_togroundspd: implementation-data-type=Double
        ins_gpsflag_pos: implementation-data-type=Int32
        ins_numsv: implementation-data-type=Int32
        ins_gpsflag_heading: implementation-data-type=Int32
        ins_gps_age: implementation-data-type=Int32
        ins_car_status: implementation-data-type=Int32
        ins_status: implementation-data-type=Int32
        ins_std_lat: implementation-data-type=Double
        ins_std_lon: implementation-data-type=Double
        ins_std_locat_height: implementation-data-type=Double
        ins_std_heading: implementation-data-type=Double
    Ecu_status_2_516
      79 x element, all with category=TYPE_REFERENCE:
        engine_started: implementation-data-type=Bool
        engine_rpm: implementation-data-type=Float
        speed_mps: implementation-data-type=Float
        odometer_m: implementation-data-type=Float
        fuel_range_m: implementation-data-type=Int32
        throttle_percentage: implementation-data-type=Float
        brake_percentage: implementation-data-type=Float
        brake_percentage: implementation-data-type=Float
        brake_percentage: implementation-data-type=Float
        steering_torque_nm: implementation-data-type=Float
        parking_brake: implementation-data-type=Bool
        high_beam_signal: implementation-data-type=Bool
        low_beam_signal: implementation-data-type=Bool
        left_turn_signal: implementation-data-type=Bool
        right_turn_signal: implementation-data-type=Bool
        horn: implementation-data-type=Bool
        wiper: implementation-data-type=Bool
        disengage_status: implementation-data-type=Bool
        driving_mode: implementation-data-type=DrivingMode
        error_code: implementation-data-type=ErrorCode
        gear_location: implementation-data-type=GearPosition
        steering_timestamp: implementation-data-type=Double
        header
        chassis_error_mask: implementation-data-type=Int32
        signal: implementation-data-type=Bool
        chassis_gps: implementation-data-type=CameraHeader
        engage_advice: implementation-data-type=Bool
        wheel_speed: implementation-data-type=Wheel_speed_rpt_7a
        surround: implementation-data-type=Bool
        license: implementation-data-type=Bool
        lon_acc: implementation-data-type=Float
        steer_wheel_rot_spd: implementation-data-type=Float
        abs_vehspdlgt_valid: implementation-data-type=Bool
        esp_algtstatus_valid: implementation-data-type=Bool
        sas_sasstssnsr_valid: implementation-data-type=Bool
        steerwheelrotspd_valid: implementation-data-type=Bool
        eps_lkaresponsetorque_valid: implementation-data-type=Bool
        eps_torsionbartorque: implementation-data-type=Float
        eps_tosionbartorquevalid: implementation-data-type=Bool
        abs_whlmilgfrntri: implementation-data-type=Int32
        abs_whlmilgfrntle: implementation-data-type=Int32
        abs_whlmilgrearre: implementation-data-type=Int32
        abs_whlmilgrearle: implementation-data-type=Int32
        esp_wheelpulse_fl: implementation-data-type=Int32
        esp_wheelpulse_fr: implementation-data-type=Int32
        esp_wheelpulse_rl: implementation-data-type=Int32
        esp_wheelpulse_rr: implementation-data-type=Int32
        ems_accpedalratio: implementation-data-type=Double
        brkpedalstasus: implementation-data-type=ch/Ctrl_cmdType
        abs_whlspdfrntle: implementation-data-type=Double
        abs_whlspdfrntri: implementation-data-type=Double
        abs_whlspdrele: implementation-data-type=Double
        abs_whlspdreri: implementation-data-type=Double
        acc_x: implementation-data-type=Double
        acc_y: implementation-data-type=Double
        acc_z: implementation-data-type=Double
        gyro_x: implementation-data-type=Double
        gyro_y: implementation-data-type=Double
        gyro_z: implementation-data-type=Double
        ins_pitchangle: implementation-data-type=Double
        ins_rollangle: implementation-data-type=Double
        ins_headingangle: implementation-data-type=Double
        ins_locatheight: implementation-data-type=Double
        ins_time: implementation-data-type=Double
        ins_latitude: implementation-data-type=Double
        ins_longitude: implementation-data-type=Double
        ins_northspd: implementation-data-type=Double
        ins_eastspd: implementation-data-type=Double
        ins_togroundspd: implementation-data-type=Double
        ins_gpsflag_pos: implementation-data-type=Int32
        ins_numsv: implementation-data-type=Int32
        ins_gpsflag_heading: implementation-data-type=Int32
        ins_gps_age: implementation-data-type=Int32
        ins_car_status: implementation-data-type=Int32
        ins_status: implementation-data-type=Int32
        ins_std_lat: implementation-data-type=Double
        ins_std_lon: implementation-data-type=Double
        ins_std_locat_height: implementation-data-type=Double
        ins_std_heading: implementation-data-type=Double
    Ecu_status_3_517
      79 x element, all with category=TYPE_REFERENCE:
        engine_started: implementation-data-type=Bool
        engine_rpm: implementation-data-type=Float
        speed_mps: implementation-data-type=Float
        odometer_m: implementation-data-type=Float
        fuel_range_m: implementation-data-type=Int32
        throttle_percentage: implementation-data-type=Float
        brake_percentage: implementation-data-type=Float
        brake_percentage: implementation-data-type=Float
        brake_percentage: implementation-data-type=Float
        steering_torque_nm: implementation-data-type=Float
        parking_brake: implementation-data-type=Bool
        high_beam_signal: implementation-data-type=Bool
        low_beam_signal: implementation-data-type=Bool
        left_turn_signal: implementation-data-type=Bool
        right_turn_signal: implementation-data-type=Bool
        horn: implementation-data-type=Bool
        wiper: implementation-data-type=Bool
        disengage_status: implementation-data-type=Bool
        driving_mode: implementation-data-type=DrivingMode
        error_code: implementation-data-type=ErrorCode
        gear_location: implementation-data-type=GearPosition
        steering_timestamp: implementation-data-type=Double
        header
        chassis_error_mask: implementation-data-type=Int32
        signal: implementation-data-type=Bool
        chassis_gps: implementation-data-type=CameraHeader
        engage_advice: implementation-data-type=Bool
        wheel_speed: implementation-data-type=Wheel_speed_rpt_7a
        surround: implementation-data-type=Bool
        license: implementation-data-type=Bool
        lon_acc: implementation-data-type=Float
        steer_wheel_rot_spd: implementation-data-type=Float
        abs_vehspdlgt_valid: implementation-data-type=Bool
        esp_algtstatus_valid: implementation-data-type=Bool
        sas_sasstssnsr_valid: implementation-data-type=Bool
        steerwheelrotspd_valid: implementation-data-type=Bool
        eps_lkaresponsetorque_valid: implementation-data-type=Bool
        eps_torsionbartorque: implementation-data-type=Float
        eps_tosionbartorquevalid: implementation-data-type=Bool
        abs_whlmilgfrntri: implementation-data-type=Int32
        abs_whlmilgfrntle: implementation-data-type=Int32
        abs_whlmilgrearre: implementation-data-type=Int32
        abs_whlmilgrearle: implementation-data-type=Int32
        esp_wheelpulse_fl: implementation-data-type=Int32
        esp_wheelpulse_fr: implementation-data-type=Int32
        esp_wheelpulse_rl: implementation-data-type=Int32
        esp_wheelpulse_rr: implementation-data-type=Int32
        ems_accpedalratio: implementation-data-type=Double
        brkpedalstasus: implementation-data-type=ch/Ctrl_cmdType
        abs_whlspdfrntle: implementation-data-type=Double
        abs_whlspdfrntri: implementation-data-type=Double
        abs_whlspdrele: implementation-data-type=Double
        abs_whlspdreri: implementation-data-type=Double
        acc_x: implementation-data-type=Double
        acc_y: implementation-data-type=Double
        acc_z: implementation-data-type=Double
        gyro_x: implementation-data-type=Double
        gyro_y: implementation-data-type=Double
        gyro_z: implementation-data-type=Double
        ins_pitchangle: implementation-data-type=Double
        ins_rollangle: implementation-data-type=Double
        ins_headingangle: implementation-data-type=Double
        ins_locatheight: implementation-data-type=Double
        ins_time: implementation-data-type=Double
        ins_latitude: implementation-data-type=Double
        ins_longitude: implementation-data-type=Double
        ins_northspd: implementation-data-type=Double
        ins_eastspd: implementation-data-type=Double
        ins_togroundspd: implementation-data-type=Double
        ins_gpsflag_pos: implementation-data-type=Int32
        ins_numsv: implementation-data-type=Int32
        ins_gpsflag_heading: implementation-data-type=Int32
        ins_gps_age: implementation-data-type=Int32
        ins_car_status: implementation-data-type=Int32
        ins_status: implementation-data-type=Int32
        ins_std_lat: implementation-data-type=Double
        ins_std_lon: implementation-data-type=Double
        ins_std_locat_height: implementation-data-type=Double
        ins_std_heading: implementation-data-type=Double
    Gear_command_114
      79 x element, all with category=TYPE_REFERENCE:
        engine_started: implementation-data-type=Bool
        engine_rpm: implementation-data-type=Float
        speed_mps: implementation-data-type=Float
        odometer_m: implementation-data-type=Float
        fuel_range_m: implementation-data-type=Int32
        throttle_percentage: implementation-data-type=Float
        brake_percentage: implementation-data-type=Float
        brake_percentage: implementation-data-type=Float
        brake_percentage: implementation-data-type=Float
        steering_torque_nm: implementation-data-type=Float
        parking_brake: implementation-data-type=Bool
        high_beam_signal: implementation-data-type=Bool
        low_beam_signal: implementation-data-type=Bool
        left_turn_signal: implementation-data-type=Bool
        right_turn_signal: implementation-data-type=Bool
        horn: implementation-data-type=Bool
        wiper: implementation-data-type=Bool
        disengage_status: implementation-data-type=Bool
        driving_mode: implementation-data-type=DrivingMode
        error_code: implementation-data-type=ErrorCode
        gear_location: implementation-data-type=GearPosition
        steering_timestamp: implementation-data-type=Double
        header
        chassis_error_mask: implementation-data-type=Int32
        signal: implementation-data-type=Bool
        chassis_gps: implementation-data-type=CameraHeader
        engage_advice: implementation-data-type=Bool
        wheel_speed: implementation-data-type=Wheel_speed_rpt_7a
        surround: implementation-data-type=Bool
        license: implementation-data-type=Bool
        lon_acc: implementation-data-type=Float
        steer_wheel_rot_spd: implementation-data-type=Float
        abs_vehspdlgt_valid: implementation-data-type=Bool
        esp_algtstatus_valid: implementation-data-type=Bool
        sas_sasstssnsr_valid: implementation-data-type=Bool
        steerwheelrotspd_valid: implementation-data-type=Bool
        eps_lkaresponsetorque_valid: implementation-data-type=Bool
        eps_torsionbartorque: implementation-data-type=Float
        eps_tosionbartorquevalid: implementation-data-type=Bool
        abs_whlmilgfrntri: implementation-data-type=Int32
        abs_whlmilgfrntle: implementation-data-type=Int32
        abs_whlmilgrearre: implementation-data-type=Int32
        abs_whlmilgrearle: implementation-data-type=Int32
        esp_wheelpulse_fl: implementation-data-type=Int32
        esp_wheelpulse_fr: implementation-data-type=Int32
        esp_wheelpulse_rl: implementation-data-type=Int32
        esp_wheelpulse_rr: implementation-data-type=Int32
        ems_accpedalratio: implementation-data-type=Double
        brkpedalstasus: implementation-data-type=ch/Ctrl_cmdType
        abs_whlspdfrntle: implementation-data-type=Double
        abs_whlspdfrntri: implementation-data-type=Double
        abs_whlspdrele: implementation-data-type=Double
        abs_whlspdreri: implementation-data-type=Double
        acc_x: implementation-data-type=Double
        acc_y: implementation-data-type=Double
        acc_z: implementation-data-type=Double
        gyro_x: implementation-data-type=Double
        gyro_y: implementation-data-type=Double
        gyro_z: implementation-data-type=Double
        ins_pitchangle: implementation-data-type=Double
        ins_rollangle: implementation-data-type=Double
        ins_headingangle: implementation-data-type=Double
        ins_locatheight: implementation-data-type=Double
        ins_time: implementation-data-type=Double
        ins_latitude: implementation-data-type=Double
        ins_longitude: implementation-data-type=Double
        ins_northspd: implementation-data-type=Double
        ins_eastspd: implementation-data-type=Double
        ins_togroundspd: implementation-data-type=Double
        ins_gpsflag_pos: implementation-data-type=Int32
        ins_numsv: implementation-data-type=Int32
        ins_gpsflag_heading: implementation-data-type=Int32
        ins_gps_age: implementation-data-type=Int32
        ins_car_status: implementation-data-type=Int32
        ins_status: implementation-data-type=Int32
        ins_std_lat: implementation-data-type=Double
        ins_std_lon: implementation-data-type=Double
        ins_std_locat_height: implementation-data-type=Double
        ins_std_heading: implementation-data-type=Double
    Gear_status_514
      79 x element, all with category=TYPE_REFERENCE:
        engine_started: implementation-data-type=Bool
        engine_rpm: implementation-data-type=Float
        speed_mps: implementation-data-type=Float
        odometer_m: implementation-data-type=Float
        fuel_range_m: implementation-data-type=Int32
        throttle_percentage: implementation-data-type=Float
        brake_percentage: implementation-data-type=Float
        brake_percentage: implementation-data-type=Float
        brake_percentage: implementation-data-type=Float
        steering_torque_nm: implementation-data-type=Float
        parking_brake: implementation-data-type=Bool
        high_beam_signal: implementation-data-type=Bool
        low_beam_signal: implementation-data-type=Bool
        left_turn_signal: implementation-data-type=Bool
        right_turn_signal: implementation-data-type=Bool
        horn: implementation-data-type=Bool
        wiper: implementation-data-type=Bool
        disengage_status: implementation-data-type=Bool
        driving_mode: implementation-data-type=DrivingMode
        error_code: implementation-data-type=ErrorCode
        gear_location: implementation-data-type=GearPosition
        steering_timestamp: implementation-data-type=Double
        header
        chassis_error_mask: implementation-data-type=Int32
        signal: implementation-data-type=Bool
        chassis_gps: implementation-data-type=CameraHeader
        engage_advice: implementation-data-type=Bool
        wheel_speed: implementation-data-type=Wheel_speed_rpt_7a
        surround: implementation-data-type=Bool
        license: implementation-data-type=Bool
        lon_acc: implementation-data-type=Float
        steer_wheel_rot_spd: implementation-data-type=Float
        abs_vehspdlgt_valid: implementation-data-type=Bool
        esp_algtstatus_valid: implementation-data-type=Bool
        sas_sasstssnsr_valid: implementation-data-type=Bool
        steerwheelrotspd_valid: implementation-data-type=Bool
        eps_lkaresponsetorque_valid: implementation-data-type=Bool
        eps_torsionbartorque: implementation-data-type=Float
        eps_tosionbartorquevalid: implementation-data-type=Bool
        abs_whlmilgfrntri: implementation-data-type=Int32
        abs_whlmilgfrntle: implementation-data-type=Int32
        abs_whlmilgrearre: implementation-data-type=Int32
        abs_whlmilgrearle: implementation-data-type=Int32
        esp_wheelpulse_fl: implementation-data-type=Int32
        esp_wheelpulse_fr: implementation-data-type=Int32
        esp_wheelpulse_rl: implementation-data-type=Int32
        esp_wheelpulse_rr: implementation-data-type=Int32
        ems_accpedalratio: implementation-data-type=Double
        brkpedalstasus: implementation-data-type=ch/Ctrl_cmdType
        abs_whlspdfrntle: implementation-data-type=Double
        abs_whlspdfrntri: implementation-data-type=Double
        abs_whlspdrele: implementation-data-type=Double
        abs_whlspdreri: implementation-data-type=Double
        acc_x: implementation-data-type=Double
        acc_y: implementation-data-type=Double
        acc_z: implementation-data-type=Double
        gyro_x: implementation-data-type=Double
        gyro_y: implementation-data-type=Double
        gyro_z: implementation-data-type=Double
        ins_pitchangle: implementation-data-type=Double
        ins_rollangle: implementation-data-type=Double
        ins_headingangle: implementation-data-type=Double
        ins_locatheight: implementation-data-type=Double
        ins_time: implementation-data-type=Double
        ins_latitude: implementation-data-type=Double
        ins_longitude: implementation-data-type=Double
        ins_northspd: implementation-data-type=Double
        ins_eastspd: implementation-data-type=Double
        ins_togroundspd: implementation-data-type=Double
        ins_gpsflag_pos: implementation-data-type=Int32
        ins_numsv: implementation-data-type=Int32
        ins_gpsflag_heading: implementation-data-type=Int32
        ins_gps_age: implementation-data-type=Int32
        ins_car_status: implementation-data-type=Int32
        ins_status: implementation-data-type=Int32
        ins_std_lat: implementation-data-type=Double
        ins_std_lon: implementation-data-type=Double
        ins_std_locat_height: implementation-data-type=Double
        ins_std_heading: implementation-data-type=Double
    Gear_stsType: compu {0=NOT_PRESSED, 1=PRESSED, 2=RESERRVED, 3=ERROR}, implementation-data-type=UInt8
  6 x impl type, all with category=TYPE_REFERENCE:
    Steer_command_112
      79 x element, all with category=TYPE_REFERENCE:
        engine_started: implementation-data-type=Bool
        engine_rpm: implementation-data-type=Float
        speed_mps: implementation-data-type=Float
        odometer_m: implementation-data-type=Float
        fuel_range_m: implementation-data-type=Int32
        throttle_percentage: implementation-data-type=Float
        brake_percentage: implementation-data-type=Float
        brake_percentage: implementation-data-type=Float
        brake_percentage: implementation-data-type=Float
        steering_torque_nm: implementation-data-type=Float
        parking_brake: implementation-data-type=Bool
        high_beam_signal: implementation-data-type=Bool
        low_beam_signal: implementation-data-type=Bool
        left_turn_signal: implementation-data-type=Bool
        right_turn_signal: implementation-data-type=Bool
        horn: implementation-data-type=Bool
        wiper: implementation-data-type=Bool
        disengage_status: implementation-data-type=Bool
        driving_mode: implementation-data-type=DrivingMode
        error_code: implementation-data-type=ErrorCode
        gear_location: implementation-data-type=GearPosition
        steering_timestamp: implementation-data-type=Double
        header
        chassis_error_mask: implementation-data-type=Int32
        signal: implementation-data-type=Bool
        chassis_gps: implementation-data-type=CameraHeader
        engage_advice: implementation-data-type=Bool
        wheel_speed: implementation-data-type=Wheel_speed_rpt_7a
        surround: implementation-data-type=Bool
        license: implementation-data-type=Bool
        lon_acc: implementation-data-type=Float
        steer_wheel_rot_spd: implementation-data-type=Float
        abs_vehspdlgt_valid: implementation-data-type=Bool
        esp_algtstatus_valid: implementation-data-type=Bool
        sas_sasstssnsr_valid: implementation-data-type=Bool
        steerwheelrotspd_valid: implementation-data-type=Bool
        eps_lkaresponsetorque_valid: implementation-data-type=Bool
        eps_torsionbartorque: implementation-data-type=Float
        eps_tosionbartorquevalid: implementation-data-type=Bool
        abs_whlmilgfrntri: implementation-data-type=Int32
        abs_whlmilgfrntle: implementation-data-type=Int32
        abs_whlmilgrearre: implementation-data-type=Int32
        abs_whlmilgrearle: implementation-data-type=Int32
        esp_wheelpulse_fl: implementation-data-type=Int32
        esp_wheelpulse_fr: implementation-data-type=Int32
        esp_wheelpulse_rl: implementation-data-type=Int32
        esp_wheelpulse_rr: implementation-data-type=Int32
        ems_accpedalratio: implementation-data-type=Double
        brkpedalstasus: implementation-data-type=ch/Ctrl_cmdType
        abs_whlspdfrntle: implementation-data-type=Double
        abs_whlspdfrntri: implementation-data-type=Double
        abs_whlspdrele: implementation-data-type=Double
        abs_whlspdreri: implementation-data-type=Double
        acc_x: implementation-data-type=Double
        acc_y: implementation-data-type=Double
        acc_z: implementation-data-type=Double
        gyro_x: implementation-data-type=Double
        gyro_y: implementation-data-type=Double
        gyro_z: implementation-data-type=Double
        ins_pitchangle: implementation-data-type=Double
        ins_rollangle: implementation-data-type=Double
        ins_headingangle: implementation-data-type=Double
        ins_locatheight: implementation-data-type=Double
        ins_time: implementation-data-type=Double
        ins_latitude: implementation-data-type=Double
        ins_longitude: implementation-data-type=Double
        ins_northspd: implementation-data-type=Double
        ins_eastspd: implementation-data-type=Double
        ins_togroundspd: implementation-data-type=Double
        ins_gpsflag_pos: implementation-data-type=Int32
        ins_numsv: implementation-data-type=Int32
        ins_gpsflag_heading: implementation-data-type=Int32
        ins_gps_age: implementation-data-type=Int32
        ins_car_status: implementation-data-type=Int32
        ins_status: implementation-data-type=Int32
        ins_std_lat: implementation-data-type=Double
        ins_std_lon: implementation-data-type=Double
        ins_std_locat_height: implementation-data-type=Double
        ins_std_heading: implementation-data-type=Double
    Steer_status__512
      79 x element, all with category=TYPE_REFERENCE:
        engine_started: implementation-data-type=Bool
        engine_rpm: implementation-data-type=Float
        speed_mps: implementation-data-type=Float
        odometer_m: implementation-data-type=Float
        fuel_range_m: implementation-data-type=Int32
        throttle_percentage: implementation-data-type=Float
        brake_percentage: implementation-data-type=Float
        brake_percentage: implementation-data-type=Float
        brake_percentage: implementation-data-type=Float
        steering_torque_nm: implementation-data-type=Float
        parking_brake: implementation-data-type=Bool
        high_beam_signal: implementation-data-type=Bool
        low_beam_signal: implementation-data-type=Bool
        left_turn_signal: implementation-data-type=Bool
        right_turn_signal: implementation-data-type=Bool
        horn: implementation-data-type=Bool
        wiper: implementation-data-type=Bool
        disengage_status: implementation-data-type=Bool
        driving_mode: implementation-data-type=DrivingMode
        error_code: implementation-data-type=ErrorCode
        gear_location: implementation-data-type=GearPosition
        steering_timestamp: implementation-data-type=Double
        header
        chassis_error_mask: implementation-data-type=Int32
        signal: implementation-data-type=Bool
        chassis_gps: implementation-data-type=CameraHeader
        engage_advice: implementation-data-type=Bool
        wheel_speed: implementation-data-type=Wheel_speed_rpt_7a
        surround: implementation-data-type=Bool
        license: implementation-data-type=Bool
        lon_acc: implementation-data-type=Float
        steer_wheel_rot_spd: implementation-data-type=Float
        abs_vehspdlgt_valid: implementation-data-type=Bool
        esp_algtstatus_valid: implementation-data-type=Bool
        sas_sasstssnsr_valid: implementation-data-type=Bool
        steerwheelrotspd_valid: implementation-data-type=Bool
        eps_lkaresponsetorque_valid: implementation-data-type=Bool
        eps_torsionbartorque: implementation-data-type=Float
        eps_tosionbartorquevalid: implementation-data-type=Bool
        abs_whlmilgfrntri: implementation-data-type=Int32
        abs_whlmilgfrntle: implementation-data-type=Int32
        abs_whlmilgrearre: implementation-data-type=Int32
        abs_whlmilgrearle: implementation-data-type=Int32
        esp_wheelpulse_fl: implementation-data-type=Int32
        esp_wheelpulse_fr: implementation-data-type=Int32
        esp_wheelpulse_rl: implementation-data-type=Int32
        esp_wheelpulse_rr: implementation-data-type=Int32
        ems_accpedalratio: implementation-data-type=Double
        brkpedalstasus: implementation-data-type=ch/Ctrl_cmdType
        abs_whlspdfrntle: implementation-data-type=Double
        abs_whlspdfrntri: implementation-data-type=Double
        abs_whlspdrele: implementation-data-type=Double
        abs_whlspdreri: implementation-data-type=Double
        acc_x: implementation-data-type=Double
        acc_y: implementation-data-type=Double
        acc_z: implementation-data-type=Double
        gyro_x: implementation-data-type=Double
        gyro_y: implementation-data-type=Double
        gyro_z: implementation-data-type=Double
        ins_pitchangle: implementation-data-type=Double
        ins_rollangle: implementation-data-type=Double
        ins_headingangle: implementation-data-type=Double
        ins_locatheight: implementation-data-type=Double
        ins_time: implementation-data-type=Double
        ins_latitude: implementation-data-type=Double
        ins_longitude: implementation-data-type=Double
        ins_northspd: implementation-data-type=Double
        ins_eastspd: implementation-data-type=Double
        ins_togroundspd: implementation-data-type=Double
        ins_gpsflag_pos: implementation-data-type=Int32
        ins_numsv: implementation-data-type=Int32
        ins_gpsflag_heading: implementation-data-type=Int32
        ins_gps_age: implementation-data-type=Int32
        ins_car_status: implementation-data-type=Int32
        ins_status: implementation-data-type=Int32
        ins_std_lat: implementation-data-type=Double
        ins_std_lon: implementation-data-type=Double
        ins_std_locat_height: implementation-data-type=Double
        ins_std_heading: implementation-data-type=Double
    Throttle_command_110
      79 x element, all with category=TYPE_REFERENCE:
        engine_started: implementation-data-type=Bool
        engine_rpm: implementation-data-type=Float
        speed_mps: implementation-data-type=Float
        odometer_m: implementation-data-type=Float
        fuel_range_m: implementation-data-type=Int32
        throttle_percentage: implementation-data-type=Float
        brake_percentage: implementation-data-type=Float
        brake_percentage: implementation-data-type=Float
        brake_percentage: implementation-data-type=Float
        steering_torque_nm: implementation-data-type=Float
        parking_brake: implementation-data-type=Bool
        high_beam_signal: implementation-data-type=Bool
        low_beam_signal: implementation-data-type=Bool
        left_turn_signal: implementation-data-type=Bool
        right_turn_signal: implementation-data-type=Bool
        horn: implementation-data-type=Bool
        wiper: implementation-data-type=Bool
        disengage_status: implementation-data-type=Bool
        driving_mode: implementation-data-type=DrivingMode
        error_code: implementation-data-type=ErrorCode
        gear_location: implementation-data-type=GearPosition
        steering_timestamp: implementation-data-type=Double
        header
        chassis_error_mask: implementation-data-type=Int32
        signal: implementation-data-type=Bool
        chassis_gps: implementation-data-type=CameraHeader
        engage_advice: implementation-data-type=Bool
        wheel_speed: implementation-data-type=Wheel_speed_rpt_7a
        surround: implementation-data-type=Bool
        license: implementation-data-type=Bool
        lon_acc: implementation-data-type=Float
        steer_wheel_rot_spd: implementation-data-type=Float
        abs_vehspdlgt_valid: implementation-data-type=Bool
        esp_algtstatus_valid: implementation-data-type=Bool
        sas_sasstssnsr_valid: implementation-data-type=Bool
        steerwheelrotspd_valid: implementation-data-type=Bool
        eps_lkaresponsetorque_valid: implementation-data-type=Bool
        eps_torsionbartorque: implementation-data-type=Float
        eps_tosionbartorquevalid: implementation-data-type=Bool
        abs_whlmilgfrntri: implementation-data-type=Int32
        abs_whlmilgfrntle: implementation-data-type=Int32
        abs_whlmilgrearre: implementation-data-type=Int32
        abs_whlmilgrearle: implementation-data-type=Int32
        esp_wheelpulse_fl: implementation-data-type=Int32
        esp_wheelpulse_fr: implementation-data-type=Int32
        esp_wheelpulse_rl: implementation-data-type=Int32
        esp_wheelpulse_rr: implementation-data-type=Int32
        ems_accpedalratio: implementation-data-type=Double
        brkpedalstasus: implementation-data-type=ch/Ctrl_cmdType
        abs_whlspdfrntle: implementation-data-type=Double
        abs_whlspdfrntri: implementation-data-type=Double
        abs_whlspdrele: implementation-data-type=Double
        abs_whlspdreri: implementation-data-type=Double
        acc_x: implementation-data-type=Double
        acc_y: implementation-data-type=Double
        acc_z: implementation-data-type=Double
        gyro_x: implementation-data-type=Double
        gyro_y: implementation-data-type=Double
        gyro_z: implementation-data-type=Double
        ins_pitchangle: implementation-data-type=Double
        ins_rollangle: implementation-data-type=Double
        ins_headingangle: implementation-data-type=Double
        ins_locatheight: implementation-data-type=Double
        ins_time: implementation-data-type=Double
        ins_latitude: implementation-data-type=Double
        ins_longitude: implementation-data-type=Double
        ins_northspd: implementation-data-type=Double
        ins_eastspd: implementation-data-type=Double
        ins_togroundspd: implementation-data-type=Double
        ins_gpsflag_pos: implementation-data-type=Int32
        ins_numsv: implementation-data-type=Int32
        ins_gpsflag_heading: implementation-data-type=Int32
        ins_gps_age: implementation-data-type=Int32
        ins_car_status: implementation-data-type=Int32
        ins_status: implementation-data-type=Int32
        ins_std_lat: implementation-data-type=Double
        ins_std_lon: implementation-data-type=Double
        ins_std_locat_height: implementation-data-type=Double
        ins_std_heading: implementation-data-type=Double
    Throttle_status__510
      79 x element, all with category=TYPE_REFERENCE:
        engine_started: implementation-data-type=Bool
        engine_rpm: implementation-data-type=Float
        speed_mps: implementation-data-type=Float
        odometer_m: implementation-data-type=Float
        fuel_range_m: implementation-data-type=Int32
        throttle_percentage: implementation-data-type=Float
        brake_percentage: implementation-data-type=Float
        brake_percentage: implementation-data-type=Float
        brake_percentage: implementation-data-type=Float
        steering_torque_nm: implementation-data-type=Float
        parking_brake: implementation-data-type=Bool
        high_beam_signal: implementation-data-type=Bool
        low_beam_signal: implementation-data-type=Bool
        left_turn_signal: implementation-data-type=Bool
        right_turn_signal: implementation-data-type=Bool
        horn: implementation-data-type=Bool
        wiper: implementation-data-type=Bool
        disengage_status: implementation-data-type=Bool
        driving_mode: implementation-data-type=DrivingMode
        error_code: implementation-data-type=ErrorCode
        gear_location: implementation-data-type=GearPosition
        steering_timestamp: implementation-data-type=Double
        header
        chassis_error_mask: implementation-data-type=Int32
        signal: implementation-data-type=Bool
        chassis_gps: implementation-data-type=CameraHeader
        engage_advice: implementation-data-type=Bool
        wheel_speed: implementation-data-type=Wheel_speed_rpt_7a
        surround: implementation-data-type=Bool
        license: implementation-data-type=Bool
        lon_acc: implementation-data-type=Float
        steer_wheel_rot_spd: implementation-data-type=Float
        abs_vehspdlgt_valid: implementation-data-type=Bool
        esp_algtstatus_valid: implementation-data-type=Bool
        sas_sasstssnsr_valid: implementation-data-type=Bool
        steerwheelrotspd_valid: implementation-data-type=Bool
        eps_lkaresponsetorque_valid: implementation-data-type=Bool
        eps_torsionbartorque: implementation-data-type=Float
        eps_tosionbartorquevalid: implementation-data-type=Bool
        abs_whlmilgfrntri: implementation-data-type=Int32
        abs_whlmilgfrntle: implementation-data-type=Int32
        abs_whlmilgrearre: implementation-data-type=Int32
        abs_whlmilgrearle: implementation-data-type=Int32
        esp_wheelpulse_fl: implementation-data-type=Int32
        esp_wheelpulse_fr: implementation-data-type=Int32
        esp_wheelpulse_rl: implementation-data-type=Int32
        esp_wheelpulse_rr: implementation-data-type=Int32
        ems_accpedalratio: implementation-data-type=Double
        brkpedalstasus: implementation-data-type=ch/Ctrl_cmdType
        abs_whlspdfrntle: implementation-data-type=Double
        abs_whlspdfrntri: implementation-data-type=Double
        abs_whlspdrele: implementation-data-type=Double
        abs_whlspdreri: implementation-data-type=Double
        acc_x: implementation-data-type=Double
        acc_y: implementation-data-type=Double
        acc_z: implementation-data-type=Double
        gyro_x: implementation-data-type=Double
        gyro_y: implementation-data-type=Double
        gyro_z: implementation-data-type=Double
        ins_pitchangle: implementation-data-type=Double
        ins_rollangle: implementation-data-type=Double
        ins_headingangle: implementation-data-type=Double
        ins_locatheight: implementation-data-type=Double
        ins_time: implementation-data-type=Double
        ins_latitude: implementation-data-type=Double
        ins_longitude: implementation-data-type=Double
        ins_northspd: implementation-data-type=Double
        ins_eastspd: implementation-data-type=Double
        ins_togroundspd: implementation-data-type=Double
        ins_gpsflag_pos: implementation-data-type=Int32
        ins_numsv: implementation-data-type=Int32
        ins_gpsflag_heading: implementation-data-type=Int32
        ins_gps_age: implementation-data-type=Int32
        ins_car_status: implementation-data-type=Int32
        ins_status: implementation-data-type=Int32
        ins_std_lat: implementation-data-type=Double
        ins_std_lon: implementation-data-type=Double
        ins_std_locat_height: implementation-data-type=Double
        ins_std_heading: implementation-data-type=Double
    Turnsignal_command_113
      79 x element, all with category=TYPE_REFERENCE:
        engine_started: implementation-data-type=Bool
        engine_rpm: implementation-data-type=Float
        speed_mps: implementation-data-type=Float
        odometer_m: implementation-data-type=Float
        fuel_range_m: implementation-data-type=Int32
        throttle_percentage: implementation-data-type=Float
        brake_percentage: implementation-data-type=Float
        brake_percentage: implementation-data-type=Float
        brake_percentage: implementation-data-type=Float
        steering_torque_nm: implementation-data-type=Float
        parking_brake: implementation-data-type=Bool
        high_beam_signal: implementation-data-type=Bool
        low_beam_signal: implementation-data-type=Bool
        left_turn_signal: implementation-data-type=Bool
        right_turn_signal: implementation-data-type=Bool
        horn: implementation-data-type=Bool
        wiper: implementation-data-type=Bool
        disengage_status: implementation-data-type=Bool
        driving_mode: implementation-data-type=DrivingMode
        error_code: implementation-data-type=ErrorCode
        gear_location: implementation-data-type=GearPosition
        steering_timestamp: implementation-data-type=Double
        header
        chassis_error_mask: implementation-data-type=Int32
        signal: implementation-data-type=Bool
        chassis_gps: implementation-data-type=CameraHeader
        engage_advice: implementation-data-type=Bool
        wheel_speed: implementation-data-type=Wheel_speed_rpt_7a
        surround: implementation-data-type=Bool
        license: implementation-data-type=Bool
        lon_acc: implementation-data-type=Float
        steer_wheel_rot_spd: implementation-data-type=Float
        abs_vehspdlgt_valid: implementation-data-type=Bool
        esp_algtstatus_valid: implementation-data-type=Bool
        sas_sasstssnsr_valid: implementation-data-type=Bool
        steerwheelrotspd_valid: implementation-data-type=Bool
        eps_lkaresponsetorque_valid: implementation-data-type=Bool
        eps_torsionbartorque: implementation-data-type=Float
        eps_tosionbartorquevalid: implementation-data-type=Bool
        abs_whlmilgfrntri: implementation-data-type=Int32
        abs_whlmilgfrntle: implementation-data-type=Int32
        abs_whlmilgrearre: implementation-data-type=Int32
        abs_whlmilgrearle: implementation-data-type=Int32
        esp_wheelpulse_fl: implementation-data-type=Int32
        esp_wheelpulse_fr: implementation-data-type=Int32
        esp_wheelpulse_rl: implementation-data-type=Int32
        esp_wheelpulse_rr: implementation-data-type=Int32
        ems_accpedalratio: implementation-data-type=Double
        brkpedalstasus: implementation-data-type=ch/Ctrl_cmdType
        abs_whlspdfrntle: implementation-data-type=Double
        abs_whlspdfrntri: implementation-data-type=Double
        abs_whlspdrele: implementation-data-type=Double
        abs_whlspdreri: implementation-data-type=Double
        acc_x: implementation-data-type=Double
        acc_y: implementation-data-type=Double
        acc_z: implementation-data-type=Double
        gyro_x: implementation-data-type=Double
        gyro_y: implementation-data-type=Double
        gyro_z: implementation-data-type=Double
        ins_pitchangle: implementation-data-type=Double
        ins_rollangle: implementation-data-type=Double
        ins_headingangle: implementation-data-type=Double
        ins_locatheight: implementation-data-type=Double
        ins_time: implementation-data-type=Double
        ins_latitude: implementation-data-type=Double
        ins_longitude: implementation-data-type=Double
        ins_northspd: implementation-data-type=Double
        ins_eastspd: implementation-data-type=Double
        ins_togroundspd: implementation-data-type=Double
        ins_gpsflag_pos: implementation-data-type=Int32
        ins_numsv: implementation-data-type=Int32
        ins_gpsflag_heading: implementation-data-type=Int32
        ins_gps_age: implementation-data-type=Int32
        ins_car_status: implementation-data-type=Int32
        ins_status: implementation-data-type=Int32
        ins_std_lat: implementation-data-type=Double
        ins_std_lon: implementation-data-type=Double
        ins_std_locat_height: implementation-data-type=Double
        ins_std_heading: implementation-data-type=Double
    Turnsignal_status__513
      79 x element, all with category=TYPE_REFERENCE:
        engine_started: implementation-data-type=Bool
        engine_rpm: implementation-data-type=Float
        speed_mps: implementation-data-type=Float
        odometer_m: implementation-data-type=Float
        fuel_range_m: implementation-data-type=Int32
        throttle_percentage: implementation-data-type=Float
        brake_percentage: implementation-data-type=Float
        brake_percentage: implementation-data-type=Float
        brake_percentage: implementation-data-type=Float
        steering_torque_nm: implementation-data-type=Float
        parking_brake: implementation-data-type=Bool
        high_beam_signal: implementation-data-type=Bool
        low_beam_signal: implementation-data-type=Bool
        left_turn_signal: implementation-data-type=Bool
        right_turn_signal: implementation-data-type=Bool
        horn: implementation-data-type=Bool
        wiper: implementation-data-type=Bool
        disengage_status: implementation-data-type=Bool
        driving_mode: implementation-data-type=DrivingMode
        error_code: implementation-data-type=ErrorCode
        gear_location: implementation-data-type=GearPosition
        steering_timestamp: implementation-data-type=Double
        header
        chassis_error_mask: implementation-data-type=Int32
        signal: implementation-data-type=Bool
        chassis_gps: implementation-data-type=CameraHeader
        engage_advice: implementation-data-type=Bool
        wheel_speed: implementation-data-type=Wheel_speed_rpt_7a
        surround: implementation-data-type=Bool
        license: implementation-data-type=Bool
        lon_acc: implementation-data-type=Float
        steer_wheel_rot_spd: implementation-data-type=Float
        abs_vehspdlgt_valid: implementation-data-type=Bool
        esp_algtstatus_valid: implementation-data-type=Bool
        sas_sasstssnsr_valid: implementation-data-type=Bool
        steerwheelrotspd_valid: implementation-data-type=Bool
        eps_lkaresponsetorque_valid: implementation-data-type=Bool
        eps_torsionbartorque: implementation-data-type=Float
        eps_tosionbartorquevalid: implementation-data-type=Bool
        abs_whlmilgfrntri: implementation-data-type=Int32
        abs_whlmilgfrntle: implementation-data-type=Int32
        abs_whlmilgrearre: implementation-data-type=Int32
        abs_whlmilgrearle: implementation-data-type=Int32
        esp_wheelpulse_fl: implementation-data-type=Int32
        esp_wheelpulse_fr: implementation-data-type=Int32
        esp_wheelpulse_rl: implementation-data-type=Int32
        esp_wheelpulse_rr: implementation-data-type=Int32
        ems_accpedalratio: implementation-data-type=Double
        brkpedalstasus: implementation-data-type=ch/Ctrl_cmdType
        abs_whlspdfrntle: implementation-data-type=Double
        abs_whlspdfrntri: implementation-data-type=Double
        abs_whlspdrele: implementation-data-type=Double
        abs_whlspdreri: implementation-data-type=Double
        acc_x: implementation-data-type=Double
        acc_y: implementation-data-type=Double
        acc_z: implementation-data-type=Double
        gyro_x: implementation-data-type=Double
        gyro_y: implementation-data-type=Double
        gyro_z: implementation-data-type=Double
        ins_pitchangle: implementation-data-type=Double
        ins_rollangle: implementation-data-type=Double
        ins_headingangle: implementation-data-type=Double
        ins_locatheight: implementation-data-type=Double
        ins_time: implementation-data-type=Double
        ins_latitude: implementation-data-type=Double
        ins_longitude: implementation-data-type=Double
        ins_northspd: implementation-data-type=Double
        ins_eastspd: implementation-data-type=Double
        ins_togroundspd: implementation-data-type=Double
        ins_gpsflag_pos: implementation-data-type=Int32
        ins_numsv: implementation-data-type=Int32
        ins_gpsflag_heading: implementation-data-type=Int32
        ins_gps_age: implementation-data-type=Int32
        ins_car_status: implementation-data-type=Int32
        ins_status: implementation-data-type=Int32
        ins_std_lat: implementation-data-type=Double
        ins_std_lon: implementation-data-type=Double
        ins_std_locat_height: implementation-data-type=Double
        ins_std_heading: implementation-data-type=Double
package /HuaweiMDC/chassis
  impl type BrkPedalStasus: compu {0=NOT_PRESSED, 1=PRESSED, 2=RESERRVED, 3=ERROR}, implementation-data-type=UInt8
  impl type Chassis: category=TYPE_REFERENCE
    78 x element, all with category=TYPE_REFERENCE:
      engine_started: implementation-data-type=Bool
      engine_rpm: implementation-data-type=Float
      speed_mps: implementation-data-type=Float
      odometer_m: implementation-data-type=Float
      fuel_range_m: implementation-data-type=Int32
      throttle_percentage: implementation-data-type=Float
      brake_percentage: implementation-data-type=Float
      steering_percentage: implementation-data-type=Float
      steering_torque_nm: implementation-data-type=Float
      parking_brake: implementation-data-type=Bool
      high_beam_signal: implementation-data-type=Bool
      low_beam_signal: implementation-data-type=Bool
      left_turn_signal: implementation-data-type=Bool
      right_turn_signal: implementation-data-type=Bool
      horn: implementation-data-type=Bool
      wiper: implementation-data-type=Bool
      disengage_status: implementation-data-type=Bool
      driving_mode: implementation-data-type=chassis/DrivingMode
      error_code: implementation-data-type=chassis/ErrorCode
      gear_location: implementation-data-type=chassis/GearPosition
      steering_timestamp: implementation-data-type=Double
      header
      chassis_error_mask: implementation-data-type=Int32
      signal: implementation-data-type=Bool
      chassis_gps: implementation-data-type=CameraHeader
      engage_advice: implementation-data-type=Bool
      wheel_speed: implementation-data-type=Wheel_speed_rpt_7a
      surround: implementation-data-type=Bool
      license: implementation-data-type=Bool
      lon_acc: implementation-data-type=Float
      steer_wheel_rot_spd: implementation-data-type=Float
      abs_vehspdlgt_valid: implementation-data-type=Bool
      esp_algtstatus_valid: implementation-data-type=Bool
      sas_sasstssnsr_valid: implementation-data-type=Bool
      steerwheelrotspd_valid: implementation-data-type=Bool
      eps_lkaresponsetorque_valid: implementation-data-type=Bool
      eps_torsionbartorque: implementation-data-type=Float
      eps_tosionbartorquevalid: implementation-data-type=Bool
      abs_whlmilgfrntri: implementation-data-type=Int32
      abs_whlmilgfrntle: implementation-data-type=Int32
      abs_whlmilgrearre: implementation-data-type=Int32
      abs_whlmilgrearle: implementation-data-type=Int32
      esp_wheelpulse_fl: implementation-data-type=Int32
      esp_wheelpulse_fr: implementation-data-type=Int32
      esp_wheelpulse_rl: implementation-data-type=Int32
      esp_wheelpulse_rr: implementation-data-type=Int32
      ems_accpedalratio: implementation-data-type=Double
      brkpedalstasus: implementation-data-type=BrkPedalStasus
      abs_whlspdfrntle: implementation-data-type=Double
      abs_whlspdfrntri: implementation-data-type=Double
      abs_whlspdrele: implementation-data-type=Double
      abs_whlspdreri: implementation-data-type=Double
      acc_x: implementation-data-type=Double
      acc_y: implementation-data-type=Double
      acc_z: implementation-data-type=Double
      gyro_x: implementation-data-type=Double
      gyro_y: implementation-data-type=Double
      gyro_z: implementation-data-type=Double
      ins_pitchangle: implementation-data-type=Double
      ins_rollangle: implementation-data-type=Double
      ins_headingangle: implementation-data-type=Double
      ins_locatheight: implementation-data-type=Double
      ins_time: implementation-data-type=Double
      ins_latitude: implementation-data-type=Double
      ins_longitude: implementation-data-type=Double
      ins_northspd: implementation-data-type=Double
      ins_eastspd: implementation-data-type=Double
      ins_togroundspd: implementation-data-type=Double
      ins_gpsflag_pos: implementation-data-type=Int32
      ins_numsv: implementation-data-type=Int32
      ins_gpsflag_heading: implementation-data-type=Int32
      ins_gps_age: implementation-data-type=Int32
      ins_car_status: implementation-data-type=Int32
      ins_status: implementation-data-type=Int32
      ins_std_lat: implementation-data-type=Double
      ins_std_lon: implementation-data-type=Double
      ins_std_locat_height: implementation-data-type=Double
      ins_std_heading: implementation-data-type=Double
  impl type ChassisGPS: category=TYPE_REFERENCE
    20 x element, all with category=TYPE_REFERENCE:
      latitude: implementation-data-type=Double
      longitude: implementation-data-type=Double
      gps_valid: implementation-data-type=Bool
      year: implementation-data-type=Int32
      month: implementation-data-type=Int32
      day: implementation-data-type=Int32
      hours: implementation-data-type=Int32
      minutes: implementation-data-type=Int32
      seconds: implementation-data-type=Int32
      compass_direction: implementation-data-type=Double
      pdop: implementation-data-type=Double
      is_gps_fault: implementation-data-type=Bool
      is_inferred: implementation-data-type=Bool
      altitude: implementation-data-type=Double
      heading: implementation-data-type=Double
      hdop: implementation-data-type=Double
      vdop: implementation-data-type=Double
      quality: implementation-data-type=GpsQuality
      num_satellites: implementation-data-type=Int32
      gps_speed: implementation-data-type=Double
  impl type DrivingMode: compu {0=COMPLETE_MANUAL, 1=COMPLETE_AUTO_DRIVE, 2=AUTO_STEER_ONLY, 3=AUTO_SPEED_ONLY, 4=EMERGENCY_MODE, 5=REMOTE_MODE, 6=APA_MODE}, implementation-data-type=UInt8
  impl type ErrorCode: compu {0=NO_ERROR, 1=CMD_NOT_IN_PERIOD, 2=CHASSIS_ERROR, 3=MANUAL_INTERVENTION, 4=CHASSIS_CAN_NOT_IN_PERIOD, 5=UNKNOWN_ERROR}, implementation-data-type=UInt8
  impl type GearPosition: compu {0=GEAR_NEUTRAL, 1=GEAR_DRIVE, 2=GEAR_REVERSE, 3=GEAR_PARKING, 4=GEAR_LOW, 5=GEAR_INVALID, 6=GEAR_NONE}, implementation-data-type=UInt8
  impl type GpsQuality: compu {0=FIX_NO, 1=FIX_2D, 2=FIX_3D, 3=FIX_INVALID}, implementation-data-type=UInt8
  impl type INS_Car_Status: compu {0=INS_Status_NONE, 1=NO_RECEIVE}, implementation-data-type=UInt8
  impl type INS_GpsFlag: compu {0=NONE, 1=FIXEDPOS, 2=FIXEDHEIGHT, 8=DOPPLER_VELOCITY, 16=SINGLE, 17=PSRDIFF, 18=SBAS, 32=L1_FLOAT, 33=IONOFREE_FLOAT, 34=NARROW_FLOAT, 48=L1_INT, 49=WIDE_INT, 50=NARROW_INT}, implementation-data-type=UInt8
  impl type INS_Status: compu {0=INS_Status_NONE, 1=ATTITUDE_INITI_ALIZATION, 2=INS_STATUS_NAVIGATION}, implementation-data-type=UInt8
  5 x impl type, all with category=TYPE_REFERENCE:
    License
      element vin: implementation-data-type=String
    Signal
      5 x element, all with category=TYPE_REFERENCE:
        turn_signal: implementation-data-type=TurnSignal
        high_beam: implementation-data-type=Bool
        low_beam: implementation-data-type=Bool
        horn: implementation-data-type=Bool
        emergency_light: implementation-data-type=Bool
    Sonar
      element range: implementation-data-type=Double
      element translation: implementation-data-type=WheelSpeedType
      element rotation: implementation-data-type=Double
    Surround
      24 x element, all with category=TYPE_REFERENCE:
        cross_traffic_alert_left: implementation-data-type=Bool
        cross_traffic_alert_left_enabled: implementation-data-type=Bool
        blind_spot_left_alert: implementation-data-type=Bool
        blind_spot_left_alert_enabled: implementation-data-type=Bool
        cross_traffic_alert_right: implementation-data-type=Bool
        cross_traffic_alert_right_enabled: implementation-data-type=Bool
        blind_spot_right_alert: implementation-data-type=Bool
        blind_spot_right_alert_enabled: implementation-data-type=Bool
        sonar{00..11}: implementation-data-type=Double
        sonar_enabled: implementation-data-type=Bool
        sonar_fault: implementation-data-type=Bool
        sonar_range: implementation-data-type=Double
        sonar: implementation-data-type=Sonar
    TurnSignal: compu {0=FIX_NO, 1=FIX_2D, 2=FIX_3D, 3=FIX_INVALID}, implementation-data-type=UInt8
  compu method TurnSignalEnum: 0=TURN_NONE, 1=TURN_LEFT, 2=TURN_RIGHT
  impl type WheelSpeed: category=TYPE_REFERENCE
    12 x element, all with category=TYPE_REFERENCE:
      is_wheel_spd_rr_valid: implementation-data-type=Bool
      wheel_direction_rr: implementation-data-type=WheelSpeedType
      wheel_spd_rr: implementation-data-type=Double
      is_wheel_spd_rl_valid: implementation-data-type=Bool
      wheel_direction_rl: implementation-data-type=WheelSpeedType
      wheel_spd_rl: implementation-data-type=Double
      is_wheel_spd_fr_valid: implementation-data-type=Bool
      wheel_direction_fr: implementation-data-type=WheelSpeedType
      wheel_spd_fr: implementation-data-type=Double
      is_wheel_spd_fl_valid: implementation-data-type=Bool
      wheel_direction_fl: implementation-data-type=WheelSpeedType
      wheel_spd_fl: implementation-data-type=Double
  impl type WheelSpeedType: compu {0=FORWARD, 1=BACKWARD, 2=STANDSTILL, 3=INVALID}, implementation-data-type=UInt8
package /HuaweiMDC/chassis_detail
  4 x impl type, all with category=TYPE_REFERENCE:
    Accel_cmd_67
      element accel_cmd: implementation-data-type=Double
    Accel_rpt_68
      element manual_input: implementation-data-type=Double
      element commanded_value: implementation-data-type=Double
      element output_value: implementation-data-type=Double
    BasicInfo
      38 x element, all with category=TYPE_REFERENCE:
        is_auto_mode: implementation-data-type=Bool
        power_state: implementation-data-type=BasicInfo  Type
        is_air_bag_deployed: implementation-data-type=Bool
        odo_meter: implementation-data-type=Double
        drive_range: implementation-data-type=Double
        is_system_error: implementation-data-type=Bool
        is_human_interrupt: implementation-data-type=Bool
        acc_on_button: implementation-data-type=Bool
        acc_res_button: implementation-data-type=Bool
        acc_cancel_button: implementation-data-type=Bool
        acc_on_off_button: implementation-data-type=Bool
        acc_res_cancel_button: implementation-data-type=Bool
        acc_inc_spd_button: implementation-data-type=Bool
        acc_dec_spd_button: implementation-data-type=Bool
        acc_inc_gap_button: implementation-data-type=Bool
        acc_dec_gap_button: implementation-data-type=Bool
        lka_button: implementation-data-type=Bool
        canbus_fault: implementation-data-type=Bool
        latitude: implementation-data-type=Double
        longitude: implementation-data-type=Double
        gps_valid: implementation-data-type=Bool
        year: implementation-data-type=Int32
        month: implementation-data-type=Int32
        day: implementation-data-type=Int32
        hours: implementation-data-type=Int32
        minutes: implementation-data-type=Int32
        seconds: implementation-data-type=Int32
        compass_direction: implementation-data-type=Double
        pdop: implementation-data-type=Double
        is_gps_fault: implementation-data-type=Bool
        is_inferred: implementation-data-type=Bool
        altitude: implementation-data-type=Double
        heading: implementation-data-type=Double
        hdop: implementation-data-type=Double
        vdop: implementation-data-type=Double
        quality: implementation-data-type=Gas
        num_satellites: implementation-data-type=Int32
        gps_speed: implementation-data-type=Double
    BasicInfo  Type: compu {0=OFF, 1=ACC, 2=ON, 3=START, 4=INVALID}, implementation-data-type=UInt8
  impl type Battery: category=TYPE_REFERENCE
    element battery_percent: implementation-data-type=Double
    element fuel_level: implementation-data-type=Double
  impl type BeamLampType: compu {0=BEAM_OFF, 1=HIGH_BEAM_ON, 2=LOW_BEAM_ON}, implementation-data-type=UInt8
  6 x impl type, all with category=TYPE_REFERENCE:
    Brake
      30 x element, all with category=TYPE_REFERENCE:
        is_brake_pedal_pressed: implementation-data-type=Bool
        is_brake_force_exist: implementation-data-type=Bool
        is_brake_over_heat: implementation-data-type=Bool
        is_hand_brake_on: implementation-data-type=Bool
        brake_pedal_position: implementation-data-type=Double
        is_brake_valid: implementation-data-type=Bool
        brake_input: implementation-data-type=Double
        brake_cmd: implementation-data-type=Double
        brake_output: implementation-data-type=Double
        boo_input: implementation-data-type=Bool
        boo_cmd: implementation-data-type=Bool
        boo_output: implementation-data-type=Bool
        watchdog_applying_brakes: implementation-data-type=Bool
        watchdog_source: implementation-data-type=Int32
        brake_enabled: implementation-data-type=Bool
        driver_override: implementation-data-type=Bool
        driver_activity: implementation-data-type=Bool
        watchdog_fault: implementation-data-type=Bool
        channel_1_fault: implementation-data-type=Bool
        channel_2_fault: implementation-data-type=Bool
        boo_fault: implementation-data-type=Bool
        connector_fault: implementation-data-type=Bool
        brake_torque_req: implementation-data-type=Double
        hsa_status: implementation-data-type=HSAStatusType
        brake_torque_act: implementation-data-type=Double
        hsa_mode: implementation-data-type=HSAModeType
        wheel_torque_act: implementation-data-type=Double
        major_version: implementation-data-type=Int32
        minor_version: implementation-data-type=Int32
        build_number: implementation-data-type=Int32
    Brake_cmd_6b
      element brake_cmd: implementation-data-type=Double
    Brake_motor_rpt_1_70
      element motor_current: implementation-data-type=Double
      element shaft_position: implementation-data-type=Double
    Brake_motor_rpt_2_71
      element encoder_temperature: implementation-data-type=Int32
      element motor_temperature: implementation-data-type=Int32
      element angular_speed: implementation-data-type=Double
    Brake_motor_rpt_3_72
      element torque_output: implementation-data-type=Double
      element torque_input: implementation-data-type=Double
    Brake_on_offType: compu {0=BRAKE_ON_OFF_OFF, 1=BRAKE_ON_OFF_ON}, implementation-data-type=UInt8
  impl type Brake_rpt_6c: category=TYPE_REFERENCE
    4 x element, all with category=TYPE_REFERENCE:
      manual_input: implementation-data-type=Double
      commanded_value: implementation-data-type=Double
      output_value: implementation-data-type=Double
      brake_on_off: implementation-data-type=Brake_on_offType
  impl type Brk_can_timeoutType: compu {0=BRK_CAN_TIMEOUT_NO_ACTIVE_CAN_TIMEOUT, 1=BRK_CAN_TIMEOUT_ACTIVE_CAN_TIMEOUT}, implementation-data-type=UInt8
  impl type ChassisDetail: category=TYPE_REFERENCE
    21 x element, all with category=TYPE_REFERENCE:
      car_type: implementation-data-type=ChassisDetail  Type
      basic: implementation-data-type=BasicInfo
      safety: implementation-data-type=Safety
      gear: implementation-data-type=Gear
      ems: implementation-data-type=Ems
      esp: implementation-data-type=Esp
      gas: implementation-data-type=Gas
      epb: implementation-data-type=Epb
      brake: implementation-data-type=Brake
      deceleration: implementation-data-type=Deceleration
      vehicle_spd: implementation-data-type=VehicleSpd
      eps: implementation-data-type=Eps  Type
      light: implementation-data-type=Light
      battery: implementation-data-type=Battery
      check_response: implementation-data-type=CheckResponseSignal
      license: implementation-data-type=Lat_lon_heading_rpt_82
      surround: implementation-data-type=Safety
      gem: implementation-data-type=Gem
      ch: implementation-data-type=CameraHeader
      teshun: implementation-data-type=Bool
      cx75: implementation-data-type=Bool
  impl type ChassisDetail  Type: compu {0=QIRUI_EQ_15, 1=CHANGAN_RUICHEN}, implementation-data-type=UInt8
  impl type CheckResponseSignal: category=TYPE_REFERENCE
    7 x element, all with category=TYPE_REFERENCE, implementation-data-type=Bool:
      is_eps_online
      is_epb_online
      is_esp_online
      is_vtog_online
      is_scu_online
      is_switch_online
      is_vcu_online
  impl type Clear_overrideType: compu {0=CLEAR_OVERRIDE_DON_T_CLEAR_ACTIVE_OVERRIDES, 1=CLEAR_OVERRIDE_CLEAR_ACTIVE_OVERRIDES}, implementation-data-type=UInt8
  4 x impl type, all with category=TYPE_REFERENCE:
    Date_time_rpt_83
      6 x element, all with category=TYPE_REFERENCE, implementation-data-type=Int32:
        time_second
        time_minute
        time_hour
        date_day
        date_month
        date_year
    Deceleration
      7 x element, all with category=TYPE_REFERENCE:
        is_deceleration_available: implementation-data-type=Bool
        is_deceleration_active: implementation-data-type=Bool
        deceleration: implementation-data-type=Double
        is_evb_fail: implementation-data-type=Double
        evb_pressure: implementation-data-type=Double
        brake_pressure: implementation-data-type=Double
        brake_pressure_spd: implementation-data-type=Double
    Ems
      11 x element, all with category=TYPE_REFERENCE:
        is_engine_acc_available: implementation-data-type=Bool
        is_engine_acc_error: implementation-data-type=Bool
        engine_state: implementation-data-type=Ems  Type
        max_engine_torq_percent: implementation-data-type=Double
        min_engine_torq_percent: implementation-data-type=Double
        base_engine_torq_constant: implementation-data-type=Int32
        is_engine_speed_error: implementation-data-type=Bool
        engine_speed: implementation-data-type=Double
        engine_torque: implementation-data-type=Int32
        is_over_engine_torque: implementation-data-type=Bool
        engine_rpm: implementation-data-type=Double
    Ems  Type: compu {0=STOP, 1=CRANK, 2=RUNNING, 3=INVALID}, implementation-data-type=UInt8
  impl type Epb: category=TYPE_REFERENCE
    4 x element, all with category=TYPE_REFERENCE:
      is_epb_error: implementation-data-type=Bool
      is_epb_released: implementation-data-type=Bool
      epb_status: implementation-data-type=Int32
      parking_brake_status: implementation-data-type=PBrakeType
  impl type Eps: category=TYPE_REFERENCE
    25 x element, all with category=TYPE_REFERENCE:
      is_eps_fail: implementation-data-type=Bool
      eps_control_state: implementation-data-type=Eps  Type
      eps_driver_hand_torq: implementation-data-type=Double
      is_steering_angle_valid: implementation-data-type=Bool
      steering_angle: implementation-data-type=Double
      steering_angle_spd: implementation-data-type=Double
      is_trimming_status: implementation-data-type=Bool
      is_calibration_status: implementation-data-type=Bool
      is_failure_status: implementation-data-type=Bool
      allow_enter_autonomous_mode: implementation-data-type=Int32
      current_driving_mode: implementation-data-type=Int32
      steering_angle_cmd: implementation-data-type=Double
      vehicle_speed: implementation-data-type=Double
      epas_torque: implementation-data-type=Double
      steering_enabled: implementation-data-type=Bool
      driver_activity: implementation-data-type=Bool
      watchdog_fault: implementation-data-type=Bool
      channel_1_fault: implementation-data-type=Bool
      channel_2_fault: implementation-data-type=Bool
      calibration_fault: implementation-data-type=Bool
      connector_fault: implementation-data-type=Bool
      timestamp_65: implementation-data-type=Double
      major_version: implementation-data-type=Int32
      minor_version: implementation-data-type=Int32
      build_number: implementation-data-type=Int32
  impl type Eps  Type: compu {0=QIRUI_EQ_15, 1=CHANGAN_RUICHEN}, implementation-data-type=UInt8
  compu method Eps  TypeEnum: 0=NOT_AVAILABLE, 1=READY, 2=ACTIVE, 3=INVALID
  4 x impl type, all with category=TYPE_REFERENCE:
    Esp
      10 x element, all with category=TYPE_REFERENCE, implementation-data-type=Bool:
        is_esp_acc_error
        is_esp_on
        is_esp_active
        is_abs_error
        is_tcsvdc_fail
        is_abs_enabled
        is_stab_active
        is_stab_enabled
        is_trac_active
        is_trac_enabled
    Gas
      20 x element, all with category=TYPE_REFERENCE:
        is_gas_pedal_error: implementation-data-type=Bool
        is_gas_pedal_pressed_more: implementation-data-type=Bool
        gas_pedal_position: implementation-data-type=Double
        is_gas_valid: implementation-data-type=Bool
        throttle_input: implementation-data-type=Double
        throttle_cmd: implementation-data-type=Double
        throttle_output: implementation-data-type=Double
        watchdog_source: implementation-data-type=Int32
        throttle_enabled: implementation-data-type=Bool
        driver_override: implementation-data-type=Bool
        driver_activity: implementation-data-type=Bool
        watchdog_fault: implementation-data-type=Bool
        channel_1_fault: implementation-data-type=Bool
        channel_2_fault: implementation-data-type=Bool
        connector_fault: implementation-data-type=Bool
        accelerator_pedal: implementation-data-type=Double
        accelerator_pedal_rate: implementation-data-type=Double
        major_version: implementation-data-type=Int32
        minor_version: implementation-data-type=Int32
        build_number: implementation-data-type=Int32
    Gear
      5 x element, all with category=TYPE_REFERENCE:
        is_shift_position_valid: implementation-data-type=Bool
        gear_state: implementation-data-type=CameraHeader
        driver_override: implementation-data-type=Bool
        gear_cmd: implementation-data-type=Bool
        canbus_fault: implementation-data-type=Bool
    GearPosition: compu {0=GEAR_NEUTRAL, 1=GEAR_DRIVE, 2=GEAR_REVERSE, 3=GEAR_PARKING, 4=GEAR_LOW, 5=GEAR_INVALID, 6=GEAR_NONE}, implementation-data-type=UInt8
  4 x impl type, all with category=TYPE_REFERENCE:
    Gem
      29 x element, all with category=TYPE_REFERENCE:
        global_rpt_6a: implementation-data-type=Global_rpt_6a
        brake_cmd_6b: implementation-data-type=Brake_cmd_6b
        brake_rpt_6c: implementation-data-type=Brake_rpt_6c
        steering_cmd_6d: implementation-data-type=Steering_cmd_6d
        steering_rpt_1_6e: implementation-data-type=Steering_rpt_1_6e
        wheel_speed_rpt_7a: implementation-data-type=Wheel_speed_rpt_7a
        date_time_rpt_83: implementation-data-type=Date_time_rpt_83
        brake_motor_rpt_1_70: implementation-data-type=Brake_motor_rpt_1_70
        headlight_rpt_77: implementation-data-type=Headlight_rpt_77
        steering_motor_rpt_3_75: implementation-data-type=Steering_motor_rpt_3_75
        turn_cmd_63: implementation-data-type=Turn_cmd_63
        turn_rpt_64: implementation-data-type=Turn_rpt_64
        shift_cmd_65: implementation-data-type=Shift_cmd_65
        shift_rpt_66: implementation-data-type=Shift_rpt_66
        accel_cmd_67: implementation-data-type=Accel_cmd_67
        lat_lon_heading_rpt_82: implementation-data-type=Lat_lon_heading_rpt_82
        global_cmd_69: implementation-data-type=Global_cmd_69
        parking_brake_status_rpt_80: implementation-data-type=Parking_brake_status_rpt_80
        yaw_rate_rpt_81: implementation-data-type=Yaw_rate_rpt_81
        horn_rpt_79: implementation-data-type=Horn_rpt_79
        horn_cmd_78: implementation-data-type=Horn_cmd_78
        wiper_rpt_91: implementation-data-type=Wiper_rpt_91
        vehicle_speed_rpt_6f: implementation-data-type=Vehicle_speed_rpt_6f
        headlight_cmd_76: implementation-data-type=Headlight_cmd_76
        steering_motor_rpt_2_74: implementation-data-type=Steering_motor_rpt_2_74
        brake_motor_rpt_2_71: implementation-data-type=Brake_motor_rpt_2_71
        steering_motor_rpt_1_73: implementation-data-type=Steering_motor_rpt_1_73
        wiper_cmd_90: implementation-data-type=Wiper_cmd_90
        brake_motor_rpt_3_72: implementation-data-type=Brake_motor_rpt_3_72
    Global_cmd_69
      element pacmod_enable: implementation-data-type=Pacmod_enableType
      element clear_override: implementation-data-type=Clear_overrideType
      element ignore_override: implementation-data-type=Ignore_overrideType
    Global_rpt_6a
      7 x element, all with category=TYPE_REFERENCE:
        pacmod_status: implementation-data-type=Pacmod_statusType
        override_status: implementation-data-type=Override_statusType
        veh_can_timeout: implementation-data-type=Bool
        str_can_timeout: implementation-data-type=Bool
        usr_can_timeout: implementation-data-type=Bool
        brk_can_timeout: implementation-data-type=Brk_can_timeoutType
        usr_can_read_errors: implementation-data-type=Int32
    HSAModeType: compu {0=HSA_OFF, 1=HSA_AUTO, 2=HSA_MANUAL, 3=HSA_MODE_UNDEFINED}, implementation-data-type=UInt8
  impl type HSAStatusType: compu {0=HSA_INACTIVE, 1=HSA_FINDING_GRADIENT, 2=HSA_ACTIVE_PRESSED, 3=HSA_ACTIVE_RELEASED, 4=HSA_FAST_RELEASE, 5=HSA_SLOW_RELEASE, 6=HSA_FAILED, 7=HSA_UNDEFINED}, implementation-data-type=UInt8
  impl type Headlight_cmdType: compu {0=HEADLIGHT_CMD_HEADLIGHTS_OFF, 1=HEADLIGHT_CMD_LOW_BEAMS, 2=HEADLIGHT_CMD_HIGH_BEAMS}, implementation-data-type=UInt8
  impl type Headlight_cmd_76: category=TYPE_REFERENCE
    element headlight_cmd: implementation-data-type=Bool
  impl type Headlight_rpt_77: category=TYPE_REFERENCE
    element output_value: implementation-data-type=Headlight_rpt_77  Output_valueType
    element manual_input: implementation-data-type=Headlight_rpt_77  Manual_inputType
    element commanded_value: implementation-data-type=Headlight_rpt_77  Commanded_valueType
  impl type Headlight_rpt_77  Commanded_valueType: compu {0=COMMANDED_VALUE_HEADLIGHTS_OFF, 1=COMMANDED_VALUE_LOW_BEAMS, 2=COMMANDED_VALUE_HIGH_BEAMS}, implementation-data-type=UInt8
  impl type Headlight_rpt_77  Manual_inputType: compu {0=MANUAL_INPUT_HEADLIGHTS_OFF, 1=MANUAL_INPUT_LOW_BEAMS, 2=MANUAL_INPUT_HIGH_BEAMS}, implementation-data-type=UInt8
  impl type Headlight_rpt_77  Output_valueType: compu {0=OUTPUT_VALUE_HEADLIGHTS_OFF, 1=OUTPUT_VALUE_LOW_BEAMS, 2=OUTPUT_VALUE_HIGH_BEAMS}, implementation-data-type=UInt8
  impl type Horn_cmdType: compu {0=HORN_CMD_OFF, 1=HORN_CMD_ON}, implementation-data-type=UInt8
  impl type Horn_cmd_78: category=TYPE_REFERENCE
    element horn_cmd: implementation-data-type=Horn_cmdType
  impl type Horn_rpt_79: category=TYPE_REFERENCE
    element output_value: implementation-data-type=OperationCycleStateType
    element commanded_value: implementation-data-type=Float
    element manual_input: implementation-data-type=Float
  impl type Horn_rpt_79  Commanded_valueType: compu {0=COMMANDED_VALUE_OFF, 1=COMMANDED_VALUE_ON}, implementation-data-type=UInt8
  impl type Horn_rpt_79 Output_valueType: compu {0=OUTPUT_VALUE_OFF, 1=OUTPUT_VALUE_ON}, implementation-data-type=UInt8
  impl type Ignore_overrideType: compu {0=IGNORE_OVERRIDE_DON_T_IGNORE_USER_OVERRIDES, 1=IGNORE_OVERRIDE_IGNORE_USER_OVERRIDES}, implementation-data-type=UInt8
  impl type Lat_lon_heading_rpt_82: category=TYPE_REFERENCE
    7 x element, all with category=TYPE_REFERENCE:
      heading: implementation-data-type=Double
      longitude_seconds: implementation-data-type=Int32
      longitude_minutes: implementation-data-type=Int32
      longitude_degrees: implementation-data-type=Int32
      latitude_seconds: implementation-data-type=Int32
      latitude_minutes: implementation-data-type=Int32
      latitude_degrees: implementation-data-type=Int32
  impl type Light: category=TYPE_REFERENCE
    9 x element, all with category=TYPE_REFERENCE:
      SOC: implementation-data-type=Float
      speed_mps: implementation-data-type=Float
      ACC_Speed: implementation-data-type=Float
      throttle_percentage: implementation-data-type=Float
      brake_percentage: implementation-data-type=Float
      steering_percentage: implementation-data-type=Float
      steering_percentage: implementation-data-type=Float
      header: implementation-data-type=Header
      engine_started: implementation-data-type=Bool
  impl type LincolnAmbientType: compu {0=BEAM_NULL, 1=BEAM_FLASH_TO_PASS, 0=QIRUI_EQ_15, 0=QIRUI_EQ_15}, implementation-data-type=UInt8
  impl type LincolnLampType: compu {0=BEAM_NULL, 1=BEAM_FLASH_TO_PASS, 2=BEAM_HIGH, 3=BEAM_INVALID}, implementation-data-type=UInt8
  impl type LincolnWiperType: compu {0=WIPER_OFF, 1=WIPER_AUTO_OFF, 2=WIPER_OFF_MOVING, 3=WIPER_MANUAL_OFF, 4=WIPER_MANUAL_ON, 5=WIPER_MANUAL_LOW, 6=WIPER_MANUAL_HIGH, 7=WIPER_MIST_FLICK, 8=WIPER_WASH, 9=WIPER_AUTO_LOW, 10=WIPER_AUTO_HIGH, 11=WIPER_COURTESY_WIPE, 12=WIPER_AUTO_ADJUST, 13=WIPER_RESERVED, 14=WIPER_STALLED, 15=WIPER_NO_DATA}, implementation-data-type=UInt8
  impl type Manual_inputType: compu {0=BEAM_NULL, 1=BEAM_FLASH_TO_PASS, 2=BEAM_HIGH, 3=BEAM_INVALID}, implementation-data-type=UInt8
  compu method Manual_inputTypeEnum: 0=QIRUI_EQ_15, 1=CHANGAN_RUICHENG
  impl type Override_statusType: compu {0=OVERRIDE_STATUS_NOT_OVERRIDDEN, 1=OVERRIDE_STATUS_OVERRIDDEN}, implementation-data-type=UInt8
  impl type PBrakeType: compu {0=PBRAKE_OFF, 1=PBRAKE_TRANSITION, 2=PBRAKE_ON, 3=PBRAKE_FAULT}, implementation-data-type=UInt8
  impl type Pacmod_enableType: compu {0=PACMOD_STATUS_CONTROL_DISABLED, 1=PACMOD_STATUS_CONTROL_ENABLED}, implementation-data-type=UInt8
  impl type Pacmod_statusType: compu {0=BEAM_NULL, 1=BEAM_FLASH_TO_PASS, 2=BEAM_HIGH, 3=BEAM_INVALID}, implementation-data-type=UInt8
  compu method Pacmod_statusTypeEnum: 0=QIRUI_EQ_15, 1=CHANGAN_RUICHENG
  impl type Parking_brake_enabledType: compu {0=PARKING_BRAKE_ENABLED_OFF, 1=PARKING_BRAKE_ENABLED_ON}, implementation-data-type=UInt8
  impl type Parking_brake_status_rpt_80: category=TYPE_REFERENCE
    element parking_brake_enabled: implementation-data-type=Parking_brake_enabledType
  impl type Safety: category=TYPE_REFERENCE
    23 x element, all with category=TYPE_REFERENCE:
      is_driver_car_door_close: implementation-data-type=Bool
      is_driver_buckled: implementation-data-type=Bool
      emergency_button: implementation-data-type=Int32
      has_error: implementation-data-type=Bool
      is_motor_invertor_fault: implementation-data-type=Bool
      is_system_fault: implementation-data-type=Bool
      is_power_battery_fault: implementation-data-type=Bool
      is_motor_invertor_over_temperature: implementation-data-type=Bool
      is_small_battery_charge_discharge_fault: implementation-data-type=Bool
      driving_mode: implementation-data-type=Int32
      is_passenger_door_open: implementation-data-type=Bool
      is_rearleft_door_open: implementation-data-type=Bool
      is_rearright_door_open: implementation-data-type=Bool
      is_hood_open: implementation-data-type=Bool
      is_trunk_open: implementation-data-type=Bool
      is_passenger_detected: implementation-data-type=Bool
      is_passenger_airbag_enabled: implementation-data-type=Bool
      is_passenger_buckled: implementation-data-type=Bool
      front_left_tire_press: implementation-data-type=Int32
      front_right_tire_press: implementation-data-type=Int32
      rear_left_tire_press: implementation-data-type=Int32
      rear_right_tire_press: implementation-data-type=Int32
      car_driving_mode: implementation-data-type=CameraHeader
  impl type Shift_cmdType: compu {0=SHIFT_CMD_PARK, 1=SHIFT_CMD_REVERSE, 2=SHIFT_CMD_NEUTRAL, 3=SHIFT_CMD_FORWARD, 4=SHIFT_CMD_LOW}, implementation-data-type=UInt8
  impl type Shift_cmd_65: category=TYPE_REFERENCE
    9 x element, all with category=TYPE_REFERENCE:
      SOC: implementation-data-type=Float
      speed_mps: implementation-data-type=Float
      ACC_Speed: implementation-data-type=Float
      throttle_percentage: implementation-data-type=Float
      brake_percentage: implementation-data-type=Float
      steering_percentage: implementation-data-type=Float
      steering_percentage: implementation-data-type=Float
      header: implementation-data-type=Header
      engine_started: implementation-data-type=Bool
  impl type Shift_rpt_66: category=TYPE_REFERENCE
    4 x element, all with category=TYPE_REFERENCE:
      manual_input: implementation-data-type=Shift_rpt_66  Manual_inputType
      commanded_value: implementation-data-type=Shift_rpt_66  Commanded_valueType
      output_value: implementation-data-type=Shift_rpt_66  Output_valueType
      engine_started: implementation-data-type=Bool
  impl type Shift_rpt_66  Commanded_valueType: compu {0=COMMANDED_VALUE_PARK, 1=COMMANDED_VALUE_REVERSE, 2=COMMANDED_VALUE_NEUTRAL, 3=COMMANDED_VALUE_FORWARD, 4=COMMANDED_VALUE_HIGH}, implementation-data-type=UInt8
  impl type Shift_rpt_66  Manual_inputType: compu {0=MANUAL_INPUT_PARK, 1=MANUAL_INPUT_REVERSE, 2=MANUAL_INPUT_NEUTRAL, 3=MANUAL_INPUT_FORWARD, 4=MANUAL_INPUT_HIGH}, implementation-data-type=UInt8
  impl type Shift_rpt_66  Output_valueType: compu {0=OUTPUT_VALUE_PARK, 1=OUTPUT_VALUE_REVERSE, 3=OUTPUT_VALUE_NEUTRAL, 3=OUTPUT_VALUE_FORWARD, 4=OUTPUT_VALUE_HIGH}, implementation-data-type=UInt8
  6 x impl type, all with category=TYPE_REFERENCE:
    Steering_cmd_6d
      element position_value: implementation-data-type=Double
      element speed_limit: implementation-data-type=Double
    Steering_motor_rpt_1_73
      element motor_current: implementation-data-type=Double
      element shaft_position: implementation-data-type=Double
    Steering_motor_rpt_2_74
      element encoder_temperature: implementation-data-type=Int32
      element motor_temperature: implementation-data-type=Header
      element angular_speed: implementation-data-type=Double
    Steering_motor_rpt_3_75
      element torque_output: implementation-data-type=Double
      element torque_input: implementation-data-type=Double
      element engine_started: implementation-data-type=Bool
    Steering_rpt_1_6e
      element manual_input: implementation-data-type=Double
      element commanded_value: implementation-data-type=Double
      element output_value: implementation-data-type=Double
    TurnLightType: compu {0=TURN_LIGHT_OFF, 1=TURN_LEFT_ON, 2=TURN_RIGHT_ON, 3=TURN_LIGHT_ON}, implementation-data-type=UInt8
  impl type Turn_cmd_63: category=TYPE_REFERENCE
    element turn_signal_cmd: implementation-data-type=Turn_signal_cmdType
  impl type Turn_rpt_64: category=TYPE_REFERENCE
    element manual_input: implementation-data-type=Turn_rpt_64  Manual_inputType
    element commanded_value: implementation-data-type=Turn_rpt_64  Commanded_valueType
    element output_value: implementation-data-type=Turn_rpt_64  Output_valueType
  impl type Turn_rpt_64  Commanded_valueType: compu {0=COMMANDED_VALUE_RIGHT, 1=COMMANDED_VALUE_NONE, 2=COMMANDED_VALUE_LEFT, 3=COMMANDED_VALUE_HAZARD}, implementation-data-type=UInt8
  impl type Turn_rpt_64  Manual_inputType: compu {0=TURN_SIGNAL_CMD_RIGHT, 1=MANUAL_INPUT_NONE, 2=MANUAL_INPUT_LEFT, 3=MANUAL_INPUT_HAZARD}, implementation-data-type=UInt8
  impl type Turn_rpt_64  Output_valueType: compu {0=OUTPUT_VALUE_RIGHT, 1=OUTPUT_VALUE_NONE, 2=OUTPUT_VALUE_LEFT, 3=OUTPUT_VALUE_HAZARD}, implementation-data-type=UInt8
  impl type Turn_signal_cmdType: compu {0=TURN_SIGNAL_CMD_RIGHT, 1=TURN_SIGNAL_CMD_NONE, 2=TURN_SIGNAL_CMD_LEFT, 3=TURN_SIGNAL_CMD_HAZARD}, implementation-data-type=UInt8
  impl type VehicleSpd: category=TYPE_REFERENCE
    30 x element, all with category=TYPE_REFERENCE:
      is_vehicle_standstill: implementation-data-type=Bool
      is_vehicle_spd_valid: implementation-data-type=Bool
      vehicle_spd: implementation-data-type=Double
      is_wheel_spd_rr_valid: implementation-data-type=Bool
      wheel_direction_rr: implementation-data-type=Wheel_speed_rpt_7a
      wheel_spd_rr: implementation-data-type=Double
      is_wheel_spd_rl_valid: implementation-data-type=Bool
      wheel_direction_rl: implementation-data-type=Bool
      wheel_spd_rl: implementation-data-type=Double
      is_wheel_spd_fr_valid: implementation-data-type=Bool
      wheel_direction_fr: implementation-data-type=Bool
      wheel_spd_fr: implementation-data-type=Double
      is_wheel_spd_fl_valid: implementation-data-type=Bool
      wheel_direction_fl: implementation-data-type=Bool
      wheel_spd_fl: implementation-data-type=Double
      is_yaw_rate_valid: implementation-data-type=Bool
      yaw_rate: implementation-data-type=Double
      yaw_rate_offset: implementation-data-type=Double
      is_ax_valid: implementation-data-type=Bool
      ax: implementation-data-type=Double
      ax_offset: implementation-data-type=Double
      lat_acc: implementation-data-type=Bool
      long_acc: implementation-data-type=Bool
      vert_acc: implementation-data-type=Bool
      roll_rate: implementation-data-type=Bool
      acc_est: implementation-data-type=Bool
      timestamp_sec: implementation-data-type=Bool
      is_ay_valid: implementation-data-type=Bool
      ay: implementation-data-type=Double
      ay_offset: implementation-data-type=Double
  impl type Vehicle_speed_rpt_6f: category=TYPE_REFERENCE
    element vehicle_speed: implementation-data-type=Double
    element vehicle_speed_valid: implementation-data-type=Vehicle_speed_validType
  impl type Vehicle_speed_validType: compu {0=VEHICLE_SPEED_VALID_INVALID, 1=VEHICLE_SPEED_VALID_VALID}, implementation-data-type=UInt8
  impl type Wheel_speed_rpt_7a: category=TYPE_REFERENCE
    4 x element, all with category=TYPE_REFERENCE, implementation-data-type=Int32:
      wheel_spd_rear_right
      wheel_spd_rear_left
      wheel_spd_front_right
      wheel_spd_front_left
  impl type Wiper_cmdType: compu {0=WIPER_CMD_WIPERS_OFF, 1=WIPER_CMD_INTERMITTENT_1, 2=WIPER_CMD_INTERMITTENT_2, 3=WIPER_CMD_INTERMITTENT_3, 4..1=WIPER_CMD_INTERMITTENT_4, 5=WIPER_CMD_INTERMITTENT_5, 6=WIPER_CMD_LOW, 7=WIPER_CMD_HIGH}, implementation-data-type=UInt8
  impl type Wiper_cmd_90: category=TYPE_REFERENCE
    element wiper_cmd: implementation-data-type=Wiper_cmdType
  impl type Wiper_rpt_91: category=TYPE_REFERENCE
    element output_value: implementation-data-type=Wiper_rpt_91 Output_valueType
    element commanded_value: implementation-data-type=Wiper_rpt_91 Commanded_valueType
    element manual_input: implementation-data-type=Wiper_rpt_91 Manual_inputType
  compu method Wiper_rpt_91  Manual_inputTypeEnum: 0=MANUAL_INPUT_WIPERS_OFF, 1..4=OUTPUT_VALUE_INTERMITTENT_1..OUTPUT_VALUE_INTERMITTENT_4, 5=OUTPUT_VALUE_INTERMITTENT_15, 6=MANUAL_INPUT_LOW, 7=MANUAL_INPUT_HIGH
  impl type Wiper_rpt_91 Commanded_valueType: compu {0=BEAM_NULL, 1=BEAM_FLASH_TO_PASS, 2=BEAM_HIGH, 3=BEAM_INVALID}, implementation-data-type=UInt8
  compu method Wiper_rpt_91 Commanded_valueTypeEnum: 0=COMMANDED_VALUE_WIPERS_OFF, 1..5=COMMANDED_VALUE_INTERMITTENT_1..COMMANDED_VALUE_INTERMITTENT_5, 6=COMMANDED_VALUE_LOW, 7=COMMANDED_VALUE_HIGH
  impl type Wiper_rpt_91 Manual_inputType: compu {0=BEAM_NULL, 1=BEAM_FLASH_TO_PASS, 2=BEAM_HIGH, 3=BEAM_INVALID}, implementation-data-type=UInt8
  impl type Wiper_rpt_91 Output_valueType: compu {0=BEAM_NULL, 1=BEAM_FLASH_TO_PASS, 2=BEAM_HIGH, 3=BEAM_INVALID}, implementation-data-type=UInt8
  compu method Wiper_rpt_91 Output_valueTypeEnum: 0=OUTPUT_VALUE_WIPERS_OFF, 1..5=OUTPUT_VALUE_INTERMITTENT_1..OUTPUT_VALUE_INTERMITTENT_5, 6=OUTPUT_VALUE_LOW, 7=OUTPUT_VALUE_HIGH
  impl type Yaw_rate_rpt_81: category=TYPE_REFERENCE
    element yaw_rate: implementation-data-type=Double
package /HuaweiMDC/vehicle_chassis
  impl type DrivingMode: compu-method=vehicle_chassis/GearPositionEnum, implementation-data-type=UInt8
  compu method DrivingModeEnum: 0=COMPLETE_MANUAL, 1=COMPLETE_AUTO_DRIVE, 2=AUTO_STEER_ONLY, 3=AUTO_SPEED_ONLY, 4=REMOTE_DRIVE, 5=EMERGENCY_MODE
  impl type ErrorCode: compu {0=NO_ERROR, 1=CMD_NOT_IN_PERIOD, 2=CHASSIS_ERROR, 3=MANUAL_INTERVENTION, 4=CHASSIS_CAN_NOT_IN_PERIOD, 5=UNKNOWN_ERROR}, implementation-data-type=UInt8
  impl type GearPosition: compu-method=vehicle_chassis/GearPositionEnum, implementation-data-type=UInt8
  compu method GearPositionEnum: 0=GEAR_NEUTRAL, 1=GEAR_DRIVE, 2=GEAR_REVERSE, 3=GEAR_PARKING, 4=GEAR_LOW, 5=GEAR_INVALID, 6=GEAR_NONE
  impl type Vehicle_Chassis: category=TYPE_REFERENCE
    9 x element, all with category=TYPE_REFERENCE:
      SOC: implementation-data-type=Float
      speed_mps: implementation-data-type=Float
      ACC_Speed: implementation-data-type=Float
      throttle_percentage: implementation-data-type=Float
      brake_percentage: implementation-data-type=Float
      steering_percentage: implementation-data-type=Float
      steering_percentage: implementation-data-type=Float
      header: implementation-data-type=Header
      engine_started: implementation-data-type=Bool
package /HuaweiMDC/vehicle_parameter
  impl type VehicleBrand: compu {0=LINCOLN_MKZ, 1=GEM, 2=CH, 3=TESHUN, 4=CX75}, implementation-data-type=UInt8
  impl type VehicleParameter: category=TYPE_REFERENCE
    4 x element, all with category=TYPE_REFERENCE:
      brand: implementation-data-type=Double
      max_engine_pedal: implementation-data-type=Double
      max_enable_fail_attempt: implementation-data-type=Int32
      driving_mode: implementation-data-type=CameraHeader
