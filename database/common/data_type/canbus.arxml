AUTOSAR XML (schema 00046)
package /jmc_auto/canbus_conf
  impl type CanbusConf: category=STRUCTURE
    4 x element, all with category=TYPE_REFERENCE:
      vehicle_parameter: implementation-data-type=VehicleParameter
      enable_debug_mode: implementation-data-type=Bool
      enable_receiver_log: implementation-data-type=Bool
      enable_sender_log: implementation-data-type=Bool
package /jmc_auto/chassis
  impl type BrkPedalStasus: compu {0=NOT_PRESSED, 1=PRESSED, 2=RESERRVED, 3=ERROR}, implementation-data-type=UInt8
  4 x impl type:
    Chassis: category=STRUCTURE
      78 x element, all with category=TYPE_REFERENCE:
        engine_started: implementation-data-type=Bool
        engine_rpm: implementation-data-type=Float
        speed_mps: implementation-data-type=Float
        odometer_m: implementation-data-type=Float
        fuel_range_m: implementation-data-type=Int32
        throttle_percentage: implementation-data-type=Float
        brake_percentage: implementation-data-type=Float
        steering_percentage: implementation-data-type=Float
        steering_torque_nm: implementation-data-type=Float
        parking_brake: implementation-data-type=Bool
        high_beam_signal: implementation-data-type=Bool
        low_beam_signal: implementation-data-type=Bool
        left_turn_signal: implementation-data-type=Bool
        right_turn_signal: implementation-data-type=Bool
        horn: implementation-data-type=Bool
        wiper: implementation-data-type=Bool
        disengage_status: implementation-data-type=Bool
        driving_mode: implementation-data-type=DrivingMode
        error_code: implementation-data-type=ChassisErrorCode
        gear_location: implementation-data-type=GearPosition
        steering_timestamp: implementation-data-type=Double
        header
        chassis_error_mask: implementation-data-type=Int32
        signal: implementation-data-type=Bool
        chassis_gps: implementation-data-type=ChassisGPS
        engage_advice: implementation-data-type=Bool
        wheel_speed: implementation-data-type=Wheel_speed_rpt_7a
        surround: implementation-data-type=Bool
        license: implementation-data-type=Bool
        lon_acc: implementation-data-type=Float
        steer_wheel_rot_spd: implementation-data-type=Float
        abs_vehspdlgt_valid: implementation-data-type=Bool
        esp_algtstatus_valid: implementation-data-type=Bool
        sas_sasstssnsr_valid: implementation-data-type=Bool
        steerwheelrotspd_valid: implementation-data-type=Bool
        eps_lkaresponsetorque_valid: implementation-data-type=Bool
        eps_torsionbartorque: implementation-data-type=Float
        eps_tosionbartorquevalid: implementation-data-type=Bool
        abs_whlmilgfrntri: implementation-data-type=Int32
        abs_whlmilgfrntle: implementation-data-type=Int32
        abs_whlmilgrearre: implementation-data-type=Int32
        abs_whlmilgrearle: implementation-data-type=Int32
        esp_wheelpulse_fl: implementation-data-type=Int32
        esp_wheelpulse_fr: implementation-data-type=Int32
        esp_wheelpulse_rl: implementation-data-type=Int32
        esp_wheelpulse_rr: implementation-data-type=Int32
        ems_accpedalratio: implementation-data-type=Double
        brkpedalstasus: implementation-data-type=BrkPedalStasus
        abs_whlspdfrntle: implementation-data-type=Double
        abs_whlspdfrntri: implementation-data-type=Double
        abs_whlspdrele: implementation-data-type=Double
        abs_whlspdreri: implementation-data-type=Double
        acc_x: implementation-data-type=Double
        acc_y: implementation-data-type=Double
        acc_z: implementation-data-type=Double
        gyro_x: implementation-data-type=Double
        gyro_y: implementation-data-type=Double
        gyro_z: implementation-data-type=Double
        ins_pitchangle: implementation-data-type=Double
        ins_rollangle: implementation-data-type=Double
        ins_headingangle: implementation-data-type=Double
        ins_locatheight: implementation-data-type=Double
        ins_time: implementation-data-type=Double
        ins_latitude: implementation-data-type=Double
        ins_longitude: implementation-data-type=Double
        ins_northspd: implementation-data-type=Double
        ins_eastspd: implementation-data-type=Double
        ins_togroundspd: implementation-data-type=Double
        ins_gpsflag_pos: implementation-data-type=Int32
        ins_numsv: implementation-data-type=Int32
        ins_gpsflag_heading: implementation-data-type=Int32
        ins_gps_age: implementation-data-type=Int32
        ins_car_status: implementation-data-type=Int32
        ins_status: implementation-data-type=Int32
        ins_std_lat: implementation-data-type=Double
        ins_std_lon: implementation-data-type=Double
        ins_std_locat_height: implementation-data-type=Double
        ins_std_heading: implementation-data-type=Double
    ChassisErrorCode: compu {0=NO_ERROR, 1=CMD_NOT_IN_PERIOD, 2=CHASSIS_ERROR, 3=MANUAL_INTERVENTION, 4=CHASSIS_CAN_NOT_IN_PERIOD, 5=UNKNOWN_ERROR}, implementation-data-type=UInt8
    ChassisGPS: category=STRUCTURE
      20 x element, all with category=TYPE_REFERENCE:
        latitude: implementation-data-type=Double
        longitude: implementation-data-type=Double
        gps_valid: implementation-data-type=Bool
        year: implementation-data-type=Int32
        month: implementation-data-type=Int32
        day: implementation-data-type=Int32
        hours: implementation-data-type=Int32
        minutes: implementation-data-type=Int32
        seconds: implementation-data-type=Int32
        compass_direction: implementation-data-type=Double
        pdop: implementation-data-type=Double
        is_gps_fault: implementation-data-type=Bool
        is_inferred: implementation-data-type=Bool
        altitude: implementation-data-type=Double
        heading: implementation-data-type=Double
        hdop: implementation-data-type=Double
        vdop: implementation-data-type=Double
        quality: implementation-data-type=GpsQuality
        num_satellites: implementation-data-type=Int32
        gps_speed: implementation-data-type=Double
    DrivingMode: compu {0=COMPLETE_MANUAL, 1=COMPLETE_AUTO_DRIVE, 2=AUTO_STEER_ONLY, 3=AUTO_SPEED_ONLY, 4=EMERGENCY_MODE, 5=REMOTE_MODE, 6=APA_MODE}, implementation-data-type=UInt8
  impl type GearPosition: compu {0=GEAR_NEUTRAL, 1=GEAR_DRIVE, 2=GEAR_REVERSE, 3=GEAR_PARKING, 4=GEAR_LOW, 5=GEAR_INVALID, 6=GEAR_NONE}, implementation-data-type=UInt8
  impl type GpsQuality: compu {0=FIX_NO, 1=FIX_2D, 2=FIX_3D, 3=FIX_INVALID}, implementation-data-type=UInt8
  impl type INS_Car_Status: compu {0=INS_Status_NONE, 1=NO_RECEIVE}, implementation-data-type=UInt8
  impl type INS_GpsFlag: compu {0=NONE, 1=FIXEDPOS, 2=FIXEDHEIGHT, 8=DOPPLER_VELOCITY, 16=SINGLE, 17=PSRDIFF, 18=SBAS, 32=L1_FLOAT, 33=IONOFREE_FLOAT, 34=NARROW_FLOAT, 48=L1_INT, 49=WIDE_INT, 50=NARROW_INT}, implementation-data-type=UInt8
  impl type INS_Status: compu {0=INS_Status_NONE, 1=ATTITUDE_INITI_ALIZATION, 2=INS_STATUS_NAVIGATION}, implementation-data-type=UInt8
  6 x impl type:
    License: category=STRUCTURE
      element vin: implementation-data-type=String
    Signal: category=STRUCTURE
      5 x element, all with category=TYPE_REFERENCE:
        turn_signal: implementation-data-type=TurnSignal
        high_beam: implementation-data-type=Bool
        low_beam: implementation-data-type=Bool
        horn: implementation-data-type=Bool
        emergency_light: implementation-data-type=Bool
    Sonar: category=STRUCTURE
      element range: implementation-data-type=Double
      element translation: implementation-data-type=WheelSpeedType
      element rotation: implementation-data-type=Double
    Surround: category=STRUCTURE
      24 x element:
        cross_traffic_alert_left: implementation-data-type=Bool
        cross_traffic_alert_left_enabled: implementation-data-type=Bool
        blind_spot_left_alert: implementation-data-type=Bool
        blind_spot_left_alert_enabled: implementation-data-type=Bool
        cross_traffic_alert_right: implementation-data-type=Bool
        cross_traffic_alert_right_enabled: implementation-data-type=Bool
        blind_spot_right_alert: implementation-data-type=Bool
        blind_spot_right_alert_enabled: implementation-data-type=Bool
        sonar{00..11}: implementation-data-type=Double
        sonar_enabled: implementation-data-type=Bool
        sonar_fault: implementation-data-type=Bool
        sonar_range: category=VECTOR, implementation-data-type=Double
        sonar: category=VECTOR, implementation-data-type=Sonar
    WheelSpeed: category=STRUCTURE
      12 x element, all with category=TYPE_REFERENCE:
        is_wheel_spd_rr_valid: implementation-data-type=Bool
        wheel_direction_rr: implementation-data-type=WheelSpeedType
        wheel_spd_rr: implementation-data-type=Double
        is_wheel_spd_rl_valid: implementation-data-type=Bool
        wheel_direction_rl: implementation-data-type=WheelSpeedType
        wheel_spd_rl: implementation-data-type=Double
        is_wheel_spd_fr_valid: implementation-data-type=Bool
        wheel_direction_fr: implementation-data-type=WheelSpeedType
        wheel_spd_fr: implementation-data-type=Double
        is_wheel_spd_fl_valid: implementation-data-type=Bool
        wheel_direction_fl: implementation-data-type=WheelSpeedType
        wheel_spd_fl: implementation-data-type=Double
    WheelSpeedType: compu {0=FORWARD, 1=BACKWARD, 2=STANDSTILL, 3=INVALID}, implementation-data-type=UInt8
package /jmc_auto/chassis_detail
  4 x impl type:
    Accel_cmd_67: category=STRUCTURE
      element accel_cmd: implementation-data-type=Double
    Accel_rpt_68: category=STRUCTURE
      element manual_input: implementation-data-type=Double
      element commanded_value: implementation-data-type=Double
      element output_value: implementation-data-type=Double
    BasicInfo: category=STRUCTURE
      38 x element, all with category=TYPE_REFERENCE:
        is_auto_mode: implementation-data-type=Bool
        power_state: implementation-data-type=BasicInfoType
        is_air_bag_deployed: implementation-data-type=Bool
        odo_meter: implementation-data-type=Double
        drive_range: implementation-data-type=Double
        is_system_error: implementation-data-type=Bool
        is_human_interrupt: implementation-data-type=Bool
        acc_on_button: implementation-data-type=Bool
        acc_res_button: implementation-data-type=Bool
        acc_cancel_button: implementation-data-type=Bool
        acc_on_off_button: implementation-data-type=Bool
        acc_res_cancel_button: implementation-data-type=Bool
        acc_inc_spd_button: implementation-data-type=Bool
        acc_dec_spd_button: implementation-data-type=Bool
        acc_inc_gap_button: implementation-data-type=Bool
        acc_dec_gap_button: implementation-data-type=Bool
        lka_button: implementation-data-type=Bool
        canbus_fault: implementation-data-type=Bool
        latitude: implementation-data-type=Double
        longitude: implementation-data-type=Double
        gps_valid: implementation-data-type=Bool
        year: implementation-data-type=Int32
        month: implementation-data-type=Int32
        day: implementation-data-type=Int32
        hours: implementation-data-type=Int32
        minutes: implementation-data-type=Int32
        seconds: implementation-data-type=Int32
        compass_direction: implementation-data-type=Double
        pdop: implementation-data-type=Double
        is_gps_fault: implementation-data-type=Bool
        is_inferred: implementation-data-type=Bool
        altitude: implementation-data-type=Double
        heading: implementation-data-type=Double
        hdop: implementation-data-type=Double
        vdop: implementation-data-type=Double
        quality: implementation-data-type=Gas
        num_satellites: implementation-data-type=Int32
        gps_speed: implementation-data-type=Double
    BasicInfoType: compu {0=OFF, 1=ACC, 2=ON, 3=START, 4=INVALID}, implementation-data-type=UInt8
  impl type Battery: category=STRUCTURE
    element battery_percent: implementation-data-type=Double
    element fuel_level: implementation-data-type=Double
  impl type BeamLampType: compu {0=BEAM_OFF, 1=HIGH_BEAM_ON, 2=LOW_BEAM_ON}, implementation-data-type=UInt8
  6 x impl type:
    Brake: category=STRUCTURE
      30 x element, all with category=TYPE_REFERENCE:
        is_brake_pedal_pressed: implementation-data-type=Bool
        is_brake_force_exist: implementation-data-type=Bool
        is_brake_over_heat: implementation-data-type=Bool
        is_hand_brake_on: implementation-data-type=Bool
        brake_pedal_position: implementation-data-type=Double
        is_brake_valid: implementation-data-type=Bool
        brake_input: implementation-data-type=Double
        brake_cmd: implementation-data-type=Double
        brake_output: implementation-data-type=Double
        boo_input: implementation-data-type=Bool
        boo_cmd: implementation-data-type=Bool
        boo_output: implementation-data-type=Bool
        watchdog_applying_brakes: implementation-data-type=Bool
        watchdog_source: implementation-data-type=Int32
        brake_enabled: implementation-data-type=Bool
        driver_override: implementation-data-type=Bool
        driver_activity: implementation-data-type=Bool
        watchdog_fault: implementation-data-type=Bool
        channel_1_fault: implementation-data-type=Bool
        channel_2_fault: implementation-data-type=Bool
        boo_fault: implementation-data-type=Bool
        connector_fault: implementation-data-type=Bool
        brake_torque_req: implementation-data-type=Double
        hsa_status: implementation-data-type=HSAStatusType
        brake_torque_act: implementation-data-type=Double
        hsa_mode: implementation-data-type=HSAModeType
        wheel_torque_act: implementation-data-type=Double
        major_version: implementation-data-type=Int32
        minor_version: implementation-data-type=Int32
        build_number: implementation-data-type=Int32
    Brake_cmd_6b: category=STRUCTURE
      element brake_cmd: implementation-data-type=Double
    Brake_motor_rpt_1_70: category=STRUCTURE
      element motor_current: implementation-data-type=Double
      element shaft_position: implementation-data-type=Double
    Brake_motor_rpt_2_71: category=STRUCTURE
      element encoder_temperature: implementation-data-type=Int32
      element motor_temperature: implementation-data-type=Int32
      element angular_speed: implementation-data-type=Double
    Brake_motor_rpt_3_72: category=STRUCTURE
      element torque_output: implementation-data-type=Double
      element torque_input: implementation-data-type=Double
    Brake_on_offType: compu {0=BRAKE_ON_OFF_OFF, 1=BRAKE_ON_OFF_ON}, implementation-data-type=UInt8
  impl type Brake_rpt_6c: category=STRUCTURE
    4 x element, all with category=TYPE_REFERENCE:
      manual_input: implementation-data-type=Double
      commanded_value: implementation-data-type=Double
      output_value: implementation-data-type=Double
      brake_on_off: implementation-data-type=Brake_on_offType
  impl type Brk_can_timeoutType: compu {0=BRK_CAN_TIMEOUT_NO_ACTIVE_CAN_TIMEOUT, 1=BRK_CAN_TIMEOUT_ACTIVE_CAN_TIMEOUT}, implementation-data-type=UInt8
  impl type ChassisDetail: category=STRUCTURE
    19 x element, all with category=TYPE_REFERENCE:
      car_type: implementation-data-type=ChassisDetailType
      basic: implementation-data-type=BasicInfo
      safety: implementation-data-type=Safety
      gear: implementation-data-type=Gear
      ems: implementation-data-type=Ems
      esp: implementation-data-type=Esp
      gas: implementation-data-type=Gas
      epb: implementation-data-type=Epb
      brake: implementation-data-type=Brake
      deceleration: implementation-data-type=Deceleration
      vehicle_spd: implementation-data-type=VehicleSpd
      eps: implementation-data-type=EpsType
      light: implementation-data-type=Light
      battery: implementation-data-type=Battery
      check_response: implementation-data-type=CheckResponseSignal
      license: implementation-data-type=Lat_lon_heading_rpt_82
      surround: implementation-data-type=Safety
      gem: implementation-data-type=Gem
      cx75: implementation-data-type=Cx75
  impl type ChassisDetailType: compu {0=QIRUI_EQ_15, 1=CHANGAN_RUICHEN}, implementation-data-type=UInt8
  impl type CheckResponseSignal: category=STRUCTURE
    7 x element, all with category=TYPE_REFERENCE, implementation-data-type=Bool:
      is_eps_online
      is_epb_online
      is_esp_online
      is_vtog_online
      is_scu_online
      is_switch_online
      is_vcu_online
  impl type Clear_overrideType: compu {0=CLEAR_OVERRIDE_DON_T_CLEAR_ACTIVE_OVERRIDES, 1=CLEAR_OVERRIDE_CLEAR_ACTIVE_OVERRIDES}, implementation-data-type=UInt8
  4 x impl type:
    Date_time_rpt_83: category=STRUCTURE
      6 x element, all with category=TYPE_REFERENCE, implementation-data-type=Int32:
        time_second
        time_minute
        time_hour
        date_day
        date_month
        date_year
    Deceleration: category=STRUCTURE
      7 x element, all with category=TYPE_REFERENCE:
        is_deceleration_available: implementation-data-type=Bool
        is_deceleration_active: implementation-data-type=Bool
        deceleration: implementation-data-type=Double
        is_evb_fail: implementation-data-type=Double
        evb_pressure: implementation-data-type=Double
        brake_pressure: implementation-data-type=Double
        brake_pressure_spd: implementation-data-type=Double
    Ems: category=STRUCTURE
      11 x element, all with category=TYPE_REFERENCE:
        is_engine_acc_available: implementation-data-type=Bool
        is_engine_acc_error: implementation-data-type=Bool
        engine_state: implementation-data-type=EmsType
        max_engine_torq_percent: implementation-data-type=Double
        min_engine_torq_percent: implementation-data-type=Double
        base_engine_torq_constant: implementation-data-type=Int32
        is_engine_speed_error: implementation-data-type=Bool
        engine_speed: implementation-data-type=Double
        engine_torque: implementation-data-type=Int32
        is_over_engine_torque: implementation-data-type=Bool
        engine_rpm: implementation-data-type=Double
    EmsType: compu {0=STOP, 1=CRANK, 2=RUNNING, 3=INVALID}, implementation-data-type=UInt8
  impl type Epb: category=STRUCTURE
    4 x element, all with category=TYPE_REFERENCE:
      is_epb_error: implementation-data-type=Bool
      is_epb_released: implementation-data-type=Bool
      epb_status: implementation-data-type=Int32
      parking_brake_status: implementation-data-type=PBrakeType
  impl type Eps: category=STRUCTURE
    25 x element, all with category=TYPE_REFERENCE:
      is_eps_fail: implementation-data-type=Bool
      eps_control_state: implementation-data-type=EpsType
      eps_driver_hand_torq: implementation-data-type=Double
      is_steering_angle_valid: implementation-data-type=Bool
      steering_angle: implementation-data-type=Double
      steering_angle_spd: implementation-data-type=Double
      is_trimming_status: implementation-data-type=Bool
      is_calibration_status: implementation-data-type=Bool
      is_failure_status: implementation-data-type=Bool
      allow_enter_autonomous_mode: implementation-data-type=Int32
      current_driving_mode: implementation-data-type=Int32
      steering_angle_cmd: implementation-data-type=Double
      vehicle_speed: implementation-data-type=Double
      epas_torque: implementation-data-type=Double
      steering_enabled: implementation-data-type=Bool
      driver_activity: implementation-data-type=Bool
      watchdog_fault: implementation-data-type=Bool
      channel_1_fault: implementation-data-type=Bool
      channel_2_fault: implementation-data-type=Bool
      calibration_fault: implementation-data-type=Bool
      connector_fault: implementation-data-type=Bool
      timestamp_65: implementation-data-type=Double
      major_version: implementation-data-type=Int32
      minor_version: implementation-data-type=Int32
      build_number: implementation-data-type=Int32
  impl type EpsType: compu {0=QIRUI_EQ_15, 1=CHANGAN_RUICHEN}, implementation-data-type=UInt8
  compu method EpsTypeEnum: 0=NOT_AVAILABLE, 1=READY, 2=ACTIVE, 3=INVALID
  7 x impl type:
    Esp: category=STRUCTURE
      10 x element, all with category=TYPE_REFERENCE, implementation-data-type=Bool:
        is_esp_acc_error
        is_esp_on
        is_esp_active
        is_abs_error
        is_tcsvdc_fail
        is_abs_enabled
        is_stab_active
        is_stab_enabled
        is_trac_active
        is_trac_enabled
    Gas: category=STRUCTURE
      20 x element, all with category=TYPE_REFERENCE:
        is_gas_pedal_error: implementation-data-type=Bool
        is_gas_pedal_pressed_more: implementation-data-type=Bool
        gas_pedal_position: implementation-data-type=Double
        is_gas_valid: implementation-data-type=Bool
        throttle_input: implementation-data-type=Double
        throttle_cmd: implementation-data-type=Double
        throttle_output: implementation-data-type=Double
        watchdog_source: implementation-data-type=Int32
        throttle_enabled: implementation-data-type=Bool
        driver_override: implementation-data-type=Bool
        driver_activity: implementation-data-type=Bool
        watchdog_fault: implementation-data-type=Bool
        channel_1_fault: implementation-data-type=Bool
        channel_2_fault: implementation-data-type=Bool
        connector_fault: implementation-data-type=Bool
        accelerator_pedal: implementation-data-type=Double
        accelerator_pedal_rate: implementation-data-type=Double
        major_version: implementation-data-type=Int32
        minor_version: implementation-data-type=Int32
        build_number: implementation-data-type=Int32
    Gear: category=STRUCTURE
      5 x element, all with category=TYPE_REFERENCE:
        is_shift_position_valid: implementation-data-type=Bool
        gear_state: implementation-data-type=GearPosition
        driver_override: implementation-data-type=Bool
        gear_cmd: implementation-data-type=GearPosition
        canbus_fault: implementation-data-type=Bool
    Gem: category=STRUCTURE
      29 x element, all with category=TYPE_REFERENCE:
        global_rpt_6a: implementation-data-type=Global_rpt_6a
        brake_cmd_6b: implementation-data-type=Brake_cmd_6b
        brake_rpt_6c: implementation-data-type=Brake_rpt_6c
        steering_cmd_6d: implementation-data-type=Steering_cmd_6d
        steering_rpt_1_6e: implementation-data-type=Steering_rpt_1_6e
        wheel_speed_rpt_7a: implementation-data-type=Wheel_speed_rpt_7a
        date_time_rpt_83: implementation-data-type=Date_time_rpt_83
        brake_motor_rpt_1_70: implementation-data-type=Brake_motor_rpt_1_70
        headlight_rpt_77: implementation-data-type=Headlight_rpt_77
        steering_motor_rpt_3_75: implementation-data-type=Steering_motor_rpt_3_75
        turn_cmd_63: implementation-data-type=Turn_cmd_63
        turn_rpt_64: implementation-data-type=Turn_rpt_64
        shift_cmd_65: implementation-data-type=Shift_cmd_65
        shift_rpt_66: implementation-data-type=Shift_rpt_66
        accel_cmd_67: implementation-data-type=Accel_cmd_67
        lat_lon_heading_rpt_82: implementation-data-type=Lat_lon_heading_rpt_82
        global_cmd_69: implementation-data-type=Global_cmd_69
        parking_brake_status_rpt_80: implementation-data-type=Parking_brake_status_rpt_80
        yaw_rate_rpt_81: implementation-data-type=Yaw_rate_rpt_81
        horn_rpt_79: implementation-data-type=Horn_rpt_79
        horn_cmd_78: implementation-data-type=Horn_cmd_78
        wiper_rpt_91: implementation-data-type=Wiper_rpt_91
        vehicle_speed_rpt_6f: implementation-data-type=Vehicle_speed_rpt_6f
        headlight_cmd_76: implementation-data-type=Headlight_cmd_76
        steering_motor_rpt_2_74: implementation-data-type=Steering_motor_rpt_2_74
        brake_motor_rpt_2_71: implementation-data-type=Brake_motor_rpt_2_71
        steering_motor_rpt_1_73: implementation-data-type=Steering_motor_rpt_1_73
        wiper_cmd_90: implementation-data-type=Wiper_cmd_90
        brake_motor_rpt_3_72: implementation-data-type=Brake_motor_rpt_3_72
    Global_cmd_69: category=STRUCTURE
      element pacmod_enable: implementation-data-type=Pacmod_enableType
      element clear_override: implementation-data-type=Clear_overrideType
      element ignore_override: implementation-data-type=Ignore_overrideType
    Global_rpt_6a: category=STRUCTURE
      7 x element, all with category=TYPE_REFERENCE:
        pacmod_status: implementation-data-type=Pacmod_statusType
        override_status: implementation-data-type=Override_statusType
        veh_can_timeout: implementation-data-type=Bool
        str_can_timeout: implementation-data-type=Bool
        usr_can_timeout: implementation-data-type=Bool
        brk_can_timeout: implementation-data-type=Brk_can_timeoutType
        usr_can_read_errors: implementation-data-type=Int32
    HSAModeType: compu {0=HSA_OFF, 1=HSA_AUTO, 2=HSA_MANUAL, 3=HSA_MODE_UNDEFINED}, implementation-data-type=UInt8
  impl type HSAStatusType: compu {0=HSA_INACTIVE, 1=HSA_FINDING_GRADIENT, 2=HSA_ACTIVE_PRESSED, 3=HSA_ACTIVE_RELEASED, 4=HSA_FAST_RELEASE, 5=HSA_SLOW_RELEASE, 6=HSA_FAILED, 7=HSA_UNDEFINED}, implementation-data-type=UInt8
  impl type Headlight_cmdType: compu {0=HEADLIGHT_CMD_HEADLIGHTS_OFF, 1=HEADLIGHT_CMD_LOW_BEAMS, 2=HEADLIGHT_CMD_HIGH_BEAMS}, implementation-data-type=UInt8
  impl type Headlight_cmd_76: category=STRUCTURE
    element headlight_cmd: implementation-data-type=Bool
  impl type Headlight_rpt_77: category=STRUCTURE
    element output_value: implementation-data-type=Headlight_rpt_77Output_valueType
    element manual_input: implementation-data-type=Headlight_rpt_77Manual_inputType
    element commanded_value: implementation-data-type=Headlight_rpt_77Commanded_valueType
  impl type Headlight_rpt_77Commanded_valueType: compu {0=COMMANDED_VALUE_HEADLIGHTS_OFF, 1=COMMANDED_VALUE_LOW_BEAMS, 2=COMMANDED_VALUE_HIGH_BEAMS}, implementation-data-type=UInt8
  impl type Headlight_rpt_77Manual_inputType: compu {0=MANUAL_INPUT_HEADLIGHTS_OFF, 1=MANUAL_INPUT_LOW_BEAMS, 2=MANUAL_INPUT_HIGH_BEAMS}, implementation-data-type=UInt8
  impl type Headlight_rpt_77Output_valueType: compu {0=OUTPUT_VALUE_HEADLIGHTS_OFF, 1=OUTPUT_VALUE_LOW_BEAMS, 2=OUTPUT_VALUE_HIGH_BEAMS}, implementation-data-type=UInt8
  impl type Horn_cmdType: compu {0=HORN_CMD_OFF, 1=HORN_CMD_ON}, implementation-data-type=UInt8
  impl type Horn_cmd_78: category=STRUCTURE
    element horn_cmd: implementation-data-type=Horn_cmdType
  impl type Horn_rpt_79: category=STRUCTURE
    element output_value: implementation-data-type=Horn_rpt_79Output_valueType
    element commanded_value: implementation-data-type=Horn_rpt_79Commanded_valueType
    element manual_input: implementation-data-type=Horn_cmd_78
  impl type Horn_rpt_79Commanded_valueType: compu {0=COMMANDED_VALUE_OFF, 1=COMMANDED_VALUE_ON}, implementation-data-type=UInt8
  impl type Horn_rpt_79Output_valueType: compu {0=OUTPUT_VALUE_OFF, 1=OUTPUT_VALUE_ON}, implementation-data-type=UInt8
  impl type Ignore_overrideType: compu {0=IGNORE_OVERRIDE_DON_T_IGNORE_USER_OVERRIDES, 1=IGNORE_OVERRIDE_IGNORE_USER_OVERRIDES}, implementation-data-type=UInt8
  impl type Lat_lon_heading_rpt_82: category=STRUCTURE
    7 x element, all with category=TYPE_REFERENCE:
      heading: implementation-data-type=Double
      longitude_seconds: implementation-data-type=Int32
      longitude_minutes: implementation-data-type=Int32
      longitude_degrees: implementation-data-type=Int32
      latitude_seconds: implementation-data-type=Int32
      latitude_minutes: implementation-data-type=Int32
      latitude_degrees: implementation-data-type=Int32
  impl type Light: category=STRUCTURE
    8 x element, all with category=TYPE_REFERENCE:
      SOC: implementation-data-type=Float
      speed_mps: implementation-data-type=Float
      ACC_Speed: implementation-data-type=Float
      throttle_percentage: implementation-data-type=Float
      brake_percentage: implementation-data-type=Float
      steering_percentage: implementation-data-type=Float
      header: implementation-data-type=ComHeader
      engine_started: implementation-data-type=Bool
  impl type LincolnAmbientType: compu {0=BEAM_NULL, 1=BEAM_FLASH_TO_PASS, 0=QIRUI_EQ_15, 0=QIRUI_EQ_15}, implementation-data-type=UInt8
  impl type LincolnLampType: compu {0=BEAM_NULL, 1=BEAM_FLASH_TO_PASS, 2=BEAM_HIGH, 3=BEAM_INVALID}, implementation-data-type=UInt8
  impl type LincolnWiperType: compu {0=WIPER_OFF, 1=WIPER_AUTO_OFF, 2=WIPER_OFF_MOVING, 3=WIPER_MANUAL_OFF, 4=WIPER_MANUAL_ON, 5=WIPER_MANUAL_LOW, 6=WIPER_MANUAL_HIGH, 7=WIPER_MIST_FLICK, 8=WIPER_WASH, 9=WIPER_AUTO_LOW, 10=WIPER_AUTO_HIGH, 11=WIPER_COURTESY_WIPE, 12=WIPER_AUTO_ADJUST, 13=WIPER_RESERVED, 14=WIPER_STALLED, 15=WIPER_NO_DATA}, implementation-data-type=UInt8
  impl type Manual_inputType: compu {0=BEAM_NULL, 1=BEAM_FLASH_TO_PASS, 2=BEAM_HIGH, 3=BEAM_INVALID}, implementation-data-type=UInt8
  compu method Manual_inputTypeEnum: 0=QIRUI_EQ_15, 1=CHANGAN_RUICHENG
  impl type Override_statusType: compu {0=OVERRIDE_STATUS_NOT_OVERRIDDEN, 1=OVERRIDE_STATUS_OVERRIDDEN}, implementation-data-type=UInt8
  impl type PBrakeType: compu {0=PBRAKE_OFF, 1=PBRAKE_TRANSITION, 2=PBRAKE_ON, 3=PBRAKE_FAULT}, implementation-data-type=UInt8
  impl type Pacmod_enableType: compu {0=PACMOD_STATUS_CONTROL_DISABLED, 1=PACMOD_STATUS_CONTROL_ENABLED}, implementation-data-type=UInt8
  impl type Pacmod_statusType: compu {0=BEAM_NULL, 1=BEAM_FLASH_TO_PASS, 2=BEAM_HIGH, 3=BEAM_INVALID}, implementation-data-type=UInt8
  compu method Pacmod_statusTypeEnum: 0=QIRUI_EQ_15, 1=CHANGAN_RUICHENG
  impl type Parking_brake_enabledType: compu {0=PARKING_BRAKE_ENABLED_OFF, 1=PARKING_BRAKE_ENABLED_ON}, implementation-data-type=UInt8
  impl type Parking_brake_status_rpt_80: category=STRUCTURE
    element parking_brake_enabled: implementation-data-type=Parking_brake_enabledType
  impl type Safety: category=STRUCTURE
    23 x element, all with category=TYPE_REFERENCE:
      is_driver_car_door_close: implementation-data-type=Bool
      is_driver_buckled: implementation-data-type=Bool
      emergency_button: implementation-data-type=Int32
      has_error: implementation-data-type=Bool
      is_motor_invertor_fault: implementation-data-type=Bool
      is_system_fault: implementation-data-type=Bool
      is_power_battery_fault: implementation-data-type=Bool
      is_motor_invertor_over_temperature: implementation-data-type=Bool
      is_small_battery_charge_discharge_fault: implementation-data-type=Bool
      driving_mode: implementation-data-type=Int32
      is_passenger_door_open: implementation-data-type=Bool
      is_rearleft_door_open: implementation-data-type=Bool
      is_rearright_door_open: implementation-data-type=Bool
      is_hood_open: implementation-data-type=Bool
      is_trunk_open: implementation-data-type=Bool
      is_passenger_detected: implementation-data-type=Bool
      is_passenger_airbag_enabled: implementation-data-type=Bool
      is_passenger_buckled: implementation-data-type=Bool
      front_left_tire_press: implementation-data-type=Int32
      front_right_tire_press: implementation-data-type=Int32
      rear_left_tire_press: implementation-data-type=Int32
      rear_right_tire_press: implementation-data-type=Int32
      car_driving_mode: implementation-data-type=DrivingMode
  impl type Shift_cmdType: compu {0=SHIFT_CMD_PARK, 1=SHIFT_CMD_REVERSE, 2=SHIFT_CMD_NEUTRAL, 3=SHIFT_CMD_FORWARD, 4=SHIFT_CMD_LOW}, implementation-data-type=UInt8
  impl type Shift_cmd_65: category=STRUCTURE
    element shift_cmd: implementation-data-type=Shift_cmdType
  impl type Shift_rpt_66: category=STRUCTURE
    4 x element, all with category=TYPE_REFERENCE:
      manual_input: implementation-data-type=Shift_rpt_66Manual_inputType
      commanded_value: implementation-data-type=Shift_rpt_66Commanded_valueType
      output_value: implementation-data-type=Shift_rpt_66Output_valueType
      engine_started: implementation-data-type=Bool
  impl type Shift_rpt_66Commanded_valueType: compu {0=COMMANDED_VALUE_PARK, 1=COMMANDED_VALUE_REVERSE, 2=COMMANDED_VALUE_NEUTRAL, 3=COMMANDED_VALUE_FORWARD, 4=COMMANDED_VALUE_HIGH}, implementation-data-type=UInt8
  impl type Shift_rpt_66Manual_inputType: compu {0=MANUAL_INPUT_PARK, 1=MANUAL_INPUT_REVERSE, 2=MANUAL_INPUT_NEUTRAL, 3=MANUAL_INPUT_FORWARD, 4=MANUAL_INPUT_HIGH}, implementation-data-type=UInt8
  impl type Shift_rpt_66Output_valueType: compu {0=OUTPUT_VALUE_PARK, 1=OUTPUT_VALUE_REVERSE, 3=OUTPUT_VALUE_NEUTRAL, 3=OUTPUT_VALUE_FORWARD, 4=OUTPUT_VALUE_HIGH}, implementation-data-type=UInt8
  6 x impl type:
    Steering_cmd_6d: category=STRUCTURE
      element position_value: implementation-data-type=Double
      element speed_limit: implementation-data-type=Double
    Steering_motor_rpt_1_73: category=STRUCTURE
      element motor_current: implementation-data-type=Double
      element shaft_position: implementation-data-type=Double
    Steering_motor_rpt_2_74: category=STRUCTURE
      element encoder_temperature: implementation-data-type=Int32
      element motor_temperature: implementation-data-type=ComHeader
      element angular_speed: implementation-data-type=Double
    Steering_motor_rpt_3_75: category=STRUCTURE
      element torque_output: implementation-data-type=Double
      element torque_input: implementation-data-type=Double
      element engine_started: implementation-data-type=Bool
    Steering_rpt_1_6e: category=STRUCTURE
      element manual_input: implementation-data-type=Double
      element commanded_value: implementation-data-type=Double
      element output_value: implementation-data-type=Double
    TurnLightType: compu {0=TURN_LIGHT_OFF, 1=TURN_LEFT_ON, 2=TURN_RIGHT_ON, 3=TURN_LIGHT_ON}, implementation-data-type=UInt8
  impl type Turn_cmd_63: category=STRUCTURE
    element turn_signal_cmd: implementation-data-type=Turn_signal_cmdType
  impl type Turn_rpt_64: category=STRUCTURE
    element manual_input: implementation-data-type=Turn_rpt_64Manual_inputType
    element commanded_value: implementation-data-type=Turn_rpt_64Commanded_valueType
    element output_value: implementation-data-type=Turn_rpt_64Output_valueType
  impl type Turn_rpt_64Commanded_valueType: compu {0=COMMANDED_VALUE_RIGHT, 1=COMMANDED_VALUE_NONE, 2=COMMANDED_VALUE_LEFT, 3=COMMANDED_VALUE_HAZARD}, implementation-data-type=UInt8
  impl type Turn_rpt_64Manual_inputType: compu {0=TURN_SIGNAL_CMD_RIGHT, 1=MANUAL_INPUT_NONE, 2=MANUAL_INPUT_LEFT, 3=MANUAL_INPUT_HAZARD}, implementation-data-type=UInt8
  impl type Turn_rpt_64Output_valueType: compu {0=OUTPUT_VALUE_RIGHT, 1=OUTPUT_VALUE_NONE, 2=OUTPUT_VALUE_LEFT, 3=OUTPUT_VALUE_HAZARD}, implementation-data-type=UInt8
  impl type Turn_signal_cmdType: compu {0=TURN_SIGNAL_CMD_RIGHT, 1=TURN_SIGNAL_CMD_NONE, 2=TURN_SIGNAL_CMD_LEFT, 3=TURN_SIGNAL_CMD_HAZARD}, implementation-data-type=UInt8
  impl type VehicleSpd: category=STRUCTURE
    30 x element, all with category=TYPE_REFERENCE:
      is_vehicle_standstill: implementation-data-type=Bool
      is_vehicle_spd_valid: implementation-data-type=Bool
      vehicle_spd: implementation-data-type=Double
      is_wheel_spd_rr_valid: implementation-data-type=Bool
      wheel_direction_rr: implementation-data-type=Wheel_speed_rpt_7a
      wheel_spd_rr: implementation-data-type=Double
      is_wheel_spd_rl_valid: implementation-data-type=Bool
      wheel_direction_rl: implementation-data-type=Bool
      wheel_spd_rl: implementation-data-type=Double
      is_wheel_spd_fr_valid: implementation-data-type=Bool
      wheel_direction_fr: implementation-data-type=Bool
      wheel_spd_fr: implementation-data-type=Double
      is_wheel_spd_fl_valid: implementation-data-type=Bool
      wheel_direction_fl: implementation-data-type=Bool
      wheel_spd_fl: implementation-data-type=Double
      is_yaw_rate_valid: implementation-data-type=Bool
      yaw_rate: implementation-data-type=Double
      yaw_rate_offset: implementation-data-type=Double
      is_ax_valid: implementation-data-type=Bool
      ax: implementation-data-type=Double
      ax_offset: implementation-data-type=Double
      lat_acc: implementation-data-type=Bool
      long_acc: implementation-data-type=Bool
      vert_acc: implementation-data-type=Bool
      roll_rate: implementation-data-type=Bool
      acc_est: implementation-data-type=Bool
      timestamp_sec: implementation-data-type=Bool
      is_ay_valid: implementation-data-type=Bool
      ay: implementation-data-type=Double
      ay_offset: implementation-data-type=Double
  impl type Vehicle_speed_rpt_6f: category=STRUCTURE
    element vehicle_speed: implementation-data-type=Double
    element vehicle_speed_valid: implementation-data-type=Vehicle_speed_validType
  impl type Vehicle_speed_validType: compu {0=VEHICLE_SPEED_VALID_INVALID, 1=VEHICLE_SPEED_VALID_VALID}, implementation-data-type=UInt8
  impl type Wheel_speed_rpt_7a: category=STRUCTURE
    4 x element, all with category=TYPE_REFERENCE, implementation-data-type=Int32:
      wheel_spd_rear_right
      wheel_spd_rear_left
      wheel_spd_front_right
      wheel_spd_front_left
  impl type Wiper_cmdType: compu {0=WIPER_CMD_WIPERS_OFF, 1=WIPER_CMD_INTERMITTENT_1, 2=WIPER_CMD_INTERMITTENT_2, 3=WIPER_CMD_INTERMITTENT_3, 4..1=WIPER_CMD_INTERMITTENT_4, 5=WIPER_CMD_INTERMITTENT_5, 6=WIPER_CMD_LOW, 7=WIPER_CMD_HIGH}, implementation-data-type=UInt8
  impl type Wiper_cmd_90: category=STRUCTURE
    element wiper_cmd: implementation-data-type=Wiper_cmdType
  impl type Wiper_rpt_91: category=STRUCTURE
    element output_value: implementation-data-type=Wiper_rpt_91Output_valueType
    element commanded_value: implementation-data-type=Wiper_rpt_9Commanded_valueType
    element manual_input: implementation-data-type=Wiper_rpt_91Manual_inputType
  compu method Wiper_rpt_91Commanded_valueTypeEnum: 0=COMMANDED_VALUE_WIPERS_OFF, 1..5=COMMANDED_VALUE_INTERMITTENT_1..COMMANDED_VALUE_INTERMITTENT_5, 6=COMMANDED_VALUE_LOW, 7=COMMANDED_VALUE_HIGH
  impl type Wiper_rpt_91Manual_inputType: compu {0=BEAM_NULL, 1=BEAM_FLASH_TO_PASS, 2=BEAM_HIGH, 3=BEAM_INVALID}, implementation-data-type=UInt8
  compu method Wiper_rpt_91Manual_inputTypeEnum: 0=MANUAL_INPUT_WIPERS_OFF, 1..4=OUTPUT_VALUE_INTERMITTENT_1..OUTPUT_VALUE_INTERMITTENT_4, 5=OUTPUT_VALUE_INTERMITTENT_15, 6=MANUAL_INPUT_LOW, 7=MANUAL_INPUT_HIGH
  impl type Wiper_rpt_91Output_valueType: compu {0=BEAM_NULL, 1=BEAM_FLASH_TO_PASS, 2=BEAM_HIGH, 3=BEAM_INVALID}, implementation-data-type=UInt8
  compu method Wiper_rpt_91Output_valueTypeEnum: 0=OUTPUT_VALUE_WIPERS_OFF, 1..5=OUTPUT_VALUE_INTERMITTENT_1..OUTPUT_VALUE_INTERMITTENT_5, 6=OUTPUT_VALUE_LOW, 7=OUTPUT_VALUE_HIGH
  impl type Wiper_rpt_9Commanded_valueType: compu {0=BEAM_NULL, 1=BEAM_FLASH_TO_PASS, 2=BEAM_HIGH, 3=BEAM_INVALID}, implementation-data-type=UInt8
  impl type Yaw_rate_rpt_81: category=STRUCTURE
    element yaw_rate: implementation-data-type=Double
package /jmc_auto/cx75
  impl type Abs_absctrlactvType: compu {0=ABS_ABSCTRLACTV_NOT_ACTIVE, 1=ABS_ABSCTRLACTV_ACTIVE}, implementation-data-type=UInt32
  impl type Abs_absflgfltType: compu {0=ABS_ABSFLGFLT_NO_FAILURE, 1=ABS_ABSFLGFLT_FAILURE}, implementation-data-type=UInt32
  impl type Abs_ebdflgfltType: compu {0=ABS_EBDFLGFLT_NO_FAILURE, 1=ABS_EBDFLGFLT_FAILURE}, implementation-data-type=UInt32
  impl type Abs_sts_0x221_221: category=STRUCTURE
    12 x element, all with category=TYPE_REFERENCE:
      abs_whlmilgfrntri: implementation-data-type=Int32
      abs_vehspdlgt: implementation-data-type=Double
      abs_vehspddirection: implementation-data-type=Abs_vehspddirectionType
      abs_ebdflgflt: implementation-data-type=Abs_ebdflgfltType
      abs_absflgflt: implementation-data-type=Abs_absflgfltType
      abs_absctrlactv: implementation-data-type=Abs_absctrlactvType
      rollingcounter_0x221: implementation-data-type=Int32
      abs_whlmilgfrntlestatus: implementation-data-type=Abs_whlmilgfrntlestatusType
      abs_whlmilgfrntristatus: implementation-data-type=Abs_whlmilgfrntristatusType
      abs_vehspdlgtstatus: implementation-data-type=Abs_vehspdlgtstatusType
      checksum_0x221: implementation-data-type=Int32
      abs_whlmilgfrntle: implementation-data-type=Int32
  impl type Abs_vehspddirectionType: compu {0=ABS_VEHSPDDIRECTION_FORWARD, 1=ABS_VEHSPDDIRECTION_BACKWARD}, implementation-data-type=UInt32
  impl type Abs_vehspdlgtstatusType: compu {0=ABS_VEHSPDLGTSTATUS_VALID, 1=ABS_VEHSPDLGTSTATUS_INVALID, 2=ABS_VEHSPDLGTSTATUS_INIT}, implementation-data-type=UInt32
  impl type Abs_whlmilgfrntlestatusType: compu {0=ABS_WHLMILGFRNTLESTATUS_VALID, 1=ABS_WHLMILGFRNTLESTATUS_INVALID}, implementation-data-type=UInt32
  impl type Abs_whlmilgfrntristatusType: compu {0=ABS_WHLMILGFRNTRISTATUS_VALID, 1=ABS_WHLMILGFRNTRISTATUS_INVALID}, implementation-data-type=UInt32
  impl type Abs_whlspd_0x211_211: category=STRUCTURE
    10 x element, all with category=TYPE_REFERENCE:
      abs_whlspdfrntri: implementation-data-type=Double
      abs_whlspdrele: implementation-data-type=Double
      abs_whlspdreri: implementation-data-type=Double
      rollingcounter_0x211: implementation-data-type=Int32
      abs_whlspdreristatus: implementation-data-type=Abs_whlspdfrntristatusType
      abs_whlspdrelestatus: implementation-data-type=Abs_whlspdfrntlestatusType
      abs_whlspdfrntristatus: implementation-data-type=Abs_whlspdfrntristatusType
      abs_whlspdfrntlestatus: implementation-data-type=Abs_whlspdfrntlestatusType
      checksum_0x211: implementation-data-type=Int32
      abs_whlspdfrntle: implementation-data-type=Double
  impl type Abs_whlspdfrntlestatusType: compu {0=ABS_WHLSPDFRNTLESTATUS_VALID, 1=ABS_WHLSPDFRNTLESTATUS_INVALID}, implementation-data-type=UInt32
  impl type Abs_whlspdfrntristatusType: compu {0=ABS_WHLSPDFRNTRISTATUS_VALID, 1=ABS_WHLSPDFRNTRISTATUS_INVALID}, implementation-data-type=UInt32
  impl type Abs_whlspdrelestatusType: compu {0=ABS_WHLSPDRELESTATUS_VALID, 1=ABS_WHLSPDRELESTATUS_INVALID}, implementation-data-type=UInt32
  impl type Abs_whlspdreristatusType: compu {0=ABS_WHLSPDRERISTATUS_VALID, 1=ABS_WHLSPDRERISTATUS_INVALID}, implementation-data-type=UInt32
  impl type Acc_brakepreferredType: compu {0=ACC_BRAKEPREFERRED_NO_DEMAND, 1=ACC_BRAKEPREFERRED_DEMAND}, implementation-data-type=UInt32
  impl type Acc_driveoffType: compu {0=ACC_DRIVEOFF_NO_DEMAND, 1=ACC_DRIVEOFF_DEMAND}, implementation-data-type=UInt32
  impl type Acc_standstillreqType: compu {0=ACC_STANDSTILLREQ_NO_DEMAND, 1=ACC_STANDSTILLREQ_DEMAND}, implementation-data-type=UInt32
  impl type Acc_startstop_inforType: compu {0=ACC_STARTSTOP_INFOR_ACC_STOPALLOWED, 1=ACC_STARTSTOP_INFOR_ACC_STOPFORBIDDEN, 2=ACC_STARTSTOP_INFOR_ACC_STARTREQUEST, 3=ACC_STARTSTOP_INFOR_ACC_SYSTEMFAILURE}, implementation-data-type=UInt32
  impl type Acc_uppercomftbandreqType: compu {0=ACC_UPPERCOMFTBANDREQ_NO_DEMAND, 1=ACC_UPPERCOMFTBANDREQ_DEMAND}, implementation-data-type=UInt32
  impl type AccfailinfoType: compu {0=ACCFAILINFO_NO_ERROR, 1=ACCFAILINFO_ERROR}, implementation-data-type=UInt32
  impl type Acchmi_modeType: compu {0=ACCHMI_MODE_OFF_MODE, 1=ACCHMI_MODE_PASSIVE_MODE, 2=ACCHMI_MODE_STAND_BY_MODE, 3=ACCHMI_MODE_ACTIVE_CONTROL_MODE, 4=ACCHMI_MODE_BRAKE_ONLY_MODE, 5=ACCHMI_MODE_OVERRIDE, 6=ACCHMI_MODE_STANDSTILL, 7=ACCHMI_MODE_FAILURE_MODE}, implementation-data-type=UInt32
  impl type Aeb_reqType: compu {0=AEB_REQ_NO_DEMAND, 1=AEB_REQ_DEMAND}, implementation-data-type=UInt32
  impl type Aeb_stateType: compu {0=AEB_STATE_UNAVAILABLE, 1=AEB_STATE_OFF, 2=AEB_STATE_STANDBY, 3=AEB_STATE_ACTIVE_NO_INTERVENTION, 4=AEB_STATE_ACTIVE, 5=AEB_STATE_RESERVED}, implementation-data-type=UInt32
  impl type Afs_0x5a0_5a0: category=STRUCTURE
    element afs_work_sts: implementation-data-type=Afs_work_stsType
  impl type Afs_work_stsType: compu {0=AFS_WORK_STS_OFF, 1=AFS_WORK_STS_ON, 2=AFS_WORK_STS_ERROR, 3=ABS_WHLSPDFRNTLESTATUS_VALID}, implementation-data-type=UInt32
  impl type Apa_indicationType: compu {0=ACC_BRAKEPREFERRED_NO_DEMAND, 1=ACC_BRAKEPREFERRED_DEMAND}, implementation-data-type=UInt32
  compu method Apa_indicationTypeEnum: 0=APA_INDICATION_NO_ACTIVE, 1=APA_INDICATION_PPSC_ACTIVE, 2=APA_INDICATION_CPSC_ACTIVE, 3=APA_INDICATION_POC_ACTIVE, 4=APA_INDICATION_RESERVED
  impl type Apa_parkslot_stateType: compu-method=Apa_quit_indicationTypeEnum, implementation-data-type=UInt32
  compu method Apa_parkslot_stateTypeEnum: 0=APA_PARKSLOT_STATE_NO_SLOT, 1=APA_PARKSLOT_STATE_SLOT_LEFT, 2=APA_PARKSLOT_STATE_SLOT_RIGHT, 3=APA_PARKSLOT_STATE_INVALID
  impl type Apa_quit_indicationType: compu-method=Apa_quit_indicationTypeEnum, implementation-data-type=UInt32
  compu method Apa_quit_indicationTypeEnum: 0=APA_QUIT_INDICATION_NO_REQUEST, 1=APA_QUIT_INDICATION_REQ_QUIT_EXTERNAL_ECU_FAILURE, 2=APA_QUIT_INDICATION_REQ_QUIT_APA_FAILURE, 3=APA_QUIT_INDICATION_REQ_QUIT_SPEED_HIGH, 4=APA_QUIT_INDICATION_REQ_QUIT_TIMING_OVERFLOW, 5=APA_QUIT_INDICATION_REQ_QUIT_MOVE_TIMES_OVERFLOW, 6=APA_QUIT_INDICATION_REQ_QUIT_RECOVER_INT_TIMS_OVERFLOW, 7=APA_QUIT_INDICATION_REQ_QUIT_GAS_PEDAL, 8=APA_QUIT_INDICATION_REQ_QUIT_GEAR_INTERVENTION, 9=APA_QUIT_INDICATION_REQ_QUIT_EXTERNAL_ECU_ACTVIE, 10=APA_QUIT_INDICATION_REQ_QUIT_TIMING_OAPA_QUIT_INDICATION_REQ_QUIT_ACCVERFLOW, 11=APA_QUIT_INDICATION_REQ_QUIT_TRAJECTORY, 12=APA_QUIT_INDICATION_REQ_QUIT_SPACE_LIMIT, 13=APA_QUIT_INDICATION_REQ_QUIT_NO_OBJECT_IN_FRONT, 14=APA_QUIT_INDICATION_REQ_QUIT_SEAT_BELT_UNBUCKLE, 15=APA_QUIT_INDICATION_REQ_QUIT_DRIVER_DOOR, 16=APA_QUIT_INDICATION_REQ_QUIT_EPB_APPLY, 17=APA_QUIT_INDICATION_REQ_QUIT_VEHICLE_BLOCK, 18=APA_QUIT_INDICATION_REQ_QUIT_GEAR_INTERRUPT, 19=APA_QUIT_INDICATION_REQ_QUIT_STEERING_WHEEL_HANDS_ON, 20=APA_QUIT_INDICATION_REQ_QUIT_ABOVE_SLOPE_LIMT, 21=APA_QUIT_INDICATION_RESERVED
  impl type Apa_recover_int_indicationType: compu-method=Apa_recover_int_indicationTypeEnum, implementation-data-type=UInt32
  compu method Apa_recover_int_indicationTypeEnum: 0=APA_RECOVER_INT_INDICATION_NO_REQUEST, 1=APA_RECOVER_INT_INDICATION_REQ_RECOVER_DEAD_MAN_SWITCH_RELEASE, 2=APA_RECOVER_INT_INDICATION_REQ_RECOVER_FOUND_OBSTACLE_IN_TRAJECTORY, 3=APA_RECOVER_INT_INDICATION_REQ_RECOVER_NON_DRIVER_DOOR_OPEN, 4=APA_RECOVER_INT_INDICATION_REQ_RECOVER_BRAKE_PEDAL_RELEASE, 5=APA_RECOVER_INT_INDICATION_RESERVED
  impl type Apa_selectedsideType: compu-method=Apa_recover_int_indicationTypeEnum, implementation-data-type=UInt32
  compu method Apa_selectedsideTypeEnum: 0=APA_SELECTEDSIDE_NONE, 1=APA_SELECTEDSIDE_LEFT, 2=APA_SELECTEDSIDE_RIGHT, 3=APA_SELECTEDSIDE_RESERVED
  impl type Awb_levelType: compu {0=AWB_LEVEL_NO_LEVEL, 1..4=AWB_LEVEL_LEVEL_1..AWB_LEVEL_LEVEL_4}, implementation-data-type=UInt32
  impl type Bcm_antitheftstsType: compu {0=BCM_ANTITHEFTSTS_FORTIFY, 1=BCM_ANTITHEFTSTS_LIFT_THE_FORTIFICATION, 2=BCM_ANTITHEFTSTS_WARNING, 3=BCM_ANTITHEFTSTS_ABNORMAL_FORTIFICATION}, implementation-data-type=UInt32
  impl type Bcm_autolampstsType: compu {0=BCM_AUTOLAMPSTS_INVALID, 1=BCM_AUTOLAMPSTS_INACTIVE, 2=BCM_AUTOLAMPSTS_ACTIVE, 3=BCM_AUTOLAMPSTS_RESERVED}, implementation-data-type=UInt32
  impl type Bcm_bgllumlvlsettingType: compu-method=Bcm_bgllumlvlsettingTypeEnum, implementation-data-type=UInt32
  compu method Bcm_bgllumlvlsettingTypeEnum: 0=BCM_BGLLUMLVLSETTING_0PERCENT, 1=BCM_BGLLUMLVLSETTING_1PERCENT, 2=BCM_BGLLUMLVLSETTING_2PERCENT, 3=BCM_BGLLUMLVLSETTING_3PERCENT, 4=BCM_BGLLUMLVLSETTING_4PERCENT, 5=BCM_BGLLUMLVLSETTING_5PERCENT, 6=BCM_BGLLUMLVLSETTING_6PERCENT, 7=BCM_BGLLUMLVLSETTING_7PERCENT, 8=BCM_BGLLUMLVLSETTING_8PERCENT, 9=BCM_BGLLUMLVLSETTING_9PERCENT, 10=BCM_BGLLUMLVLSETTING_10PERCENT, 11=BCM_BGLLUMLVLSETTING_11PERCENT, 12=BCM_BGLLUMLVLSETTING_12PERCENT, 13=BCM_BGLLUMLVLSETTING_13PERCENT, 14=BCM_BGLLUMLVLSETTING_14PERCENT, 15=BCM_BGLLUMLVLSETTING_15PERCENT, 16=BCM_BGLLUMLVLSETTING_16PERCENT, 17=BCM_BGLLUMLVLSETTING_17PERCENT, 18=BCM_BGLLUMLVLSETTING_18PERCENT, 19=BCM_BGLLUMLVLSETTING_19PERCENT, 20=BCM_BGLLUMLVLSETTING_20PERCENT, 21=BCM_BGLLUMLVLSETTING_21PERCENT, 22=BCM_BGLLUMLVLSETTING_22PERCENT, 23=BCM_BGLLUMLVLSETTING_23PERCENT, 24=BCM_BGLLUMLVLSETTING_24PERCENT, 25=BCM_BGLLUMLVLSETTING_25PERCENT, 26=BCM_BGLLUMLVLSETTING_26PERCENT, 27=BCM_BGLLUMLVLSETTING_27PERCENT, 28=BCM_BGLLUMLVLSETTING_28PERCENT, 29=BCM_BGLLUMLVLSETTING_29PERCENT, 30=BCM_BGLLUMLVLSETTING_30PERCENT, 31=BCM_BGLLUMLVLSETTING_31PERCENT, 32=BCM_BGLLUMLVLSETTING_32PERCENT, 33=BCM_BGLLUMLVLSETTING_33PERCENT, 34=BCM_BGLLUMLVLSETTING_34PERCENT, 35=BCM_BGLLUMLVLSETTING_35PERCENT, 36=BCM_BGLLUMLVLSETTING_36PERCENT, 37=BCM_BGLLUMLVLSETTING_37PERCENT, 38=BCM_BGLLUMLVLSETTING_38PERCENT, 39=BCM_BGLLUMLVLSETTING_39PERCENT, 40=BCM_BGLLUMLVLSETTING_40PERCENT, 41=BCM_BGLLUMLVLSETTING_41PERCENT, 42=BCM_BGLLUMLVLSETTING_42PERCENT, 43=BCM_BGLLUMLVLSETTING_43PERCENT, 44=BCM_BGLLUMLVLSETTING_44PERCENT, 45=BCM_BGLLUMLVLSETTING_45PERCENT, 46=BCM_BGLLUMLVLSETTING_46PERCENT, 47=BCM_BGLLUMLVLSETTING_47PERCENT, 48=BCM_BGLLUMLVLSETTING_48PERCENT, 49=BCM_BGLLUMLVLSETTING_49PERCENT, 50=BCM_BGLLUMLVLSETTING_50PERCENT, 51=BCM_BGLLUMLVLSETTING_51PERCENT, 52=BCM_BGLLUMLVLSETTING_52PERCENT, 53=BCM_BGLLUMLVLSETTING_53PERCENT, 54=BCM_BGLLUMLVLSETTING_54PERCENT, 55=BCM_BGLLUMLVLSETTING_55PERCENT, 56=BCM_BGLLUMLVLSETTING_56PERCENT, 57=BCM_BGLLUMLVLSETTING_57PERCENT, 58=BCM_BGLLUMLVLSETTING_58PERCENT, 59=BCM_BGLLUMLVLSETTING_59PERCENT, 60=BCM_BGLLUMLVLSETTING_60PERCENT, 61=BCM_BGLLUMLVLSETTING_61PERCENT, 62=BCM_BGLLUMLVLSETTING_62PERCENT, 63=BCM_BGLLUMLVLSETTING_63PERCENT, 64=BCM_BGLLUMLVLSETTING_64PERCENT, 65=BCM_BGLLUMLVLSETTING_65PERCENT, 66=BCM_BGLLUMLVLSETTING_66PERCENT, 67=BCM_BGLLUMLVLSETTING_67PERCENT, 68=BCM_BGLLUMLVLSETTING_68PERCENT, 69=BCM_BGLLUMLVLSETTING_69PERCENT, 70=BCM_BGLLUMLVLSETTING_70PERCENT, 71=BCM_BGLLUMLVLSETTING_71PERCENT, 72=BCM_BGLLUMLVLSETTING_72PERCENT, 73=BCM_BGLLUMLVLSETTING_73PERCENT, 74=BCM_BGLLUMLVLSETTING_74PERCENT, 75=BCM_BGLLUMLVLSETTING_75PERCENT, 76=BCM_BGLLUMLVLSETTING_76PERCENT, 77=BCM_BGLLUMLVLSETTING_77PERCENT, 78=BCM_BGLLUMLVLSETTING_78PERCENT, 79=BCM_BGLLUMLVLSETTING_79PERCENT, 80=BCM_BGLLUMLVLSETTING_80PERCENT, 81=BCM_BGLLUMLVLSETTING_81PERCENT, 82=BCM_BGLLUMLVLSETTING_82PERCENT, 83=BCM_BGLLUMLVLSETTING_83PERCENT, 84=BCM_BGLLUMLVLSETTING_84PERCENT, 85=BCM_BGLLUMLVLSETTING_85PERCENT, 86=BCM_BGLLUMLVLSETTING_86PERCENT, 87=BCM_BGLLUMLVLSETTING_87PERCENT, 88=BCM_BGLLUMLVLSETTING_88PERCENT, 89=BCM_BGLLUMLVLSETTING_89PERCENT, 90=BCM_BGLLUMLVLSETTING_90PERCENT, 91=BCM_BGLLUMLVLSETTING_91PERCENT, 92=BCM_BGLLUMLVLSETTING_92PERCENT, 93=BCM_BGLLUMLVLSETTING_93PERCENT, 94=BCM_BGLLUMLVLSETTING_94PERCENT, 95=BCM_BGLLUMLVLSETTING_95PERCENT, 96=BCM_BGLLUMLVLSETTING_96PERCENT, 97=BCM_BGLLUMLVLSETTING_97PERCENT, 98=BCM_BGLLUMLVLSETTING_98PERCENT, 99=BCM_BGLLUMLVLSETTING_99PERCENT, 100=BCM_BGLLUMLVLSETTING_100PERCENT
  impl type Bcm_brakefluidstsType: compu-method=Bcm_bgllumlvlsettingTypeEnum, implementation-data-type=UInt32
  compu method Bcm_brakefluidstsTypeEnum: 0=BCM_BRAKEFLUIDSTS_INVALID, 1=BCM_BRAKEFLUIDSTS_NORMAL, 2=BCM_BRAKEFLUIDSTS_LOW, 3=BCM_BRAKEFLUIDSTS_RESERVED
  impl type Bcm_doorlockstsfrntleType: compu {0=BCM_DOORLOCKSTSFRNTLE_NO_USED, 1=BCM_DOORLOCKSTSFRNTLE_LOCKED, 2=BCM_DOORLOCKSTSFRNTLE_UNLOCKED, 3=BCM_DOORLOCKSTSFRNTLE_FAULT}, implementation-data-type=UInt32
  impl type Bcm_doorlockstsfrntriType: compu {0=BCM_DOORLOCKSTSFRNTRI_NO_USED, 1=BCM_DOORLOCKSTSFRNTRI_LOCKED, 2=BCM_DOORLOCKSTSFRNTRI_UNLOCKED, 3=BCM_DOORLOCKSTSFRNTRI_FAULT}, implementation-data-type=UInt32
  impl type Bcm_doorlockstsrearleType: compu {0=BCM_DOORLOCKSTSREARLE_NO_USED, 1=BCM_DOORLOCKSTSREARLE_LOCKED, 2=BCM_DOORLOCKSTSREARLE_UNLOCKED, 3=BCM_DOORLOCKSTSREARLE_FAULT}, implementation-data-type=UInt32
  impl type Bcm_doorlockstsrearriType: compu-method=Bcm_frontwiperstsTypeEnum, implementation-data-type=UInt32
  compu method Bcm_doorlockstsrearriTypeEnum: 0=BCM_DOORLOCKSTSREARRI_NO_USED, 1=BCM_DOORLOCKSTSREARRI_LOCKED, 2=BCM_DOORLOCKSTSREARRI_UNLOCKED, 3=BCM_DOORLOCKSTSREARRI_FAULT
  impl type Bcm_doorlockststrunkType: compu {0=BCM_DOORLOCKSTSTRUNK_NO_USED, 1=BCM_DOORLOCKSTSTRUNK_LOCKED, 2=BCM_DOORLOCKSTSTRUNK_UNLOCKED, 3=BCM_DOORLOCKSTSTRUNK_FAULT}, implementation-data-type=UInt32
  impl type Bcm_doorstsfrntleType: compu {0=BCM_DOORSTSFRNTLE_NO_USED, 1=BCM_DOORSTSFRNTLE_CLOSED, 2=BCM_DOORSTSFRNTLE_OPEN, 3=BCM_FRONTWIPERSTS_HIGH}, implementation-data-type=UInt32
  impl type Bcm_doorstsfrntriType: compu {0=BCM_DOORSTSFRNTRI_NO_USED, 1=BCM_DOORSTSFRNTRI_CLOSED, 2=BCM_DOORSTSFRNTRI_OPEN, 3=BCM_DOORSTSFRNTRI_FAULT}, implementation-data-type=UInt32
  impl type Bcm_doorstsrearleType: compu {0=EBA_REQ_NO_DEMAND, 1=EBA_REQ_DEMAND}, implementation-data-type=UInt32
  compu method Bcm_doorstsrearleTypeEnum: 0=BCM_DOORSTSREARLE_NO_USED, 1=BCM_DOORSTSREARLE_CLOSED, 2=BCM_DOORSTSREARLE_OPEN, 3=BCM_DOORSTSREARLE_FAULT
  impl type Bcm_doorstsrearriType: compu {0=BCM_DOORSTSREARRI_NO_USED, 1=BCM_DOORSTSREARRI_CLOSED, 2=BCM_DOORSTSREARRI_OPEN, 3=BCM_DOORSTSREARRI_FAULT}, implementation-data-type=UInt32
  impl type Bcm_doorststrunkType: display-presentation=PRESENTATION-CONTINUOUS, compu {0=BCM_DOORSTSTRUNK_NO_USED, 1=BCM_DOORSTSTRUNK_CLOSED, 2=BCM_DOORSTSTRUNK_OPEN, 3=BCM_DOORSTSTRUNK_FAULT}, implementation-data-type=UInt32
  impl type Bcm_driving_mode_req_bcmType: compu {0=BCM_DRIVING_MODE_REQ_BCM_NORMAL, 1=BCM_DRIVING_MODE_REQ_BCM_SNOW, 2=BCM_DRIVING_MODE_REQ_BCM_NOUSED, 3=BCM_DRIVING_MODE_REQ_BCM_SPORT, 4=BCM_DRIVING_MODE_REQ_BCM_ECO, 5=BCM_DRIVING_MODE_REQ_BCM_4L, 6=BCM_DRIVING_MODE_REQ_BCM_ROCK, 7=BCM_DRIVING_MODE_REQ_BCM_WETMUD, 8=BCM_DRIVING_MODE_REQ_BCM_SAND, 9=BCM_DRIVING_MODE_REQ_BCM_GHAT_FORN330L, 13=BCM_DRIVING_MODE_REQ_BCM_MANUAL_FORN330L, 14=BCM_DRIVING_MODE_REQ_BCM_ATSFAULTBCM, 15=BCM_DRIVING_MODE_REQ_BCM_INVALID}, implementation-data-type=UInt32
  impl type Bcm_enginehoodstsType: compu {0=BCM_ENGINEHOODSTS_NO_USED, 1=BCM_ENGINEHOODSTS_CLOSED, 2=BCM_ENGINEHOODSTS_OPEN, 3=BCM_ENGINEHOODSTS_FAULT}, implementation-data-type=UInt32
  impl type Bcm_frntfoglmpstsType: compu {0=BCM_FRNTFOGLMPSTS_INVALID, 1=BCM_FRNTFOGLMPSTS_OFF, 2=BCM_FRNTFOGLMPSTS_ON, 3=BCM_FRNTFOGLMPSTS_RESERVED}, implementation-data-type=UInt32
  impl type Bcm_frontwiperstsType: compu-method=Bcm_frontwiperstsTypeEnum, implementation-data-type=UInt32
  compu method Bcm_frontwiperstsTypeEnum: 0=BCM_FRONTWIPERSTS_NO_USED, 1=BCM_FRONTWIPERSTS_OFF, 2=BCM_FRONTWIPERSTS_LOW, 3=BCM_FRONTWIPERSTS_HIGH
  impl type Bcm_highbeamstsType: compu {0=BCM_HIGHBEAMSTS_INVALID, 1=BCM_HIGHBEAMSTS_OFF, 2=BCM_HIGHBEAMSTS_ON, 3=BCM_HIGHBEAMSTS_RESERVED}, implementation-data-type=UInt32
  impl type Bcm_loadsensitivityType: compu {0=BCM_FRONTWIPERSTS_NO_USED, 1=BCM_FRONTWIPERSTS_OFF, 2=BCM_FRONTWIPERSTS_LOW, 3=BCM_FRONTWIPERSTS_HIGH}, implementation-data-type=UInt32
  impl type Bcm_lockunlockfeedbackType: compu {0=BCM_LOCKUNLOCKFEEDBACK_NO_LOCK_UNLOCK_ACTION, 1=BCM_LOCKUNLOCKFEEDBACK_PE_LOCK, 2=BCM_LOCKUNLOCKFEEDBACK_RKE_LOCK, 3=BCM_LOCKUNLOCKFEEDBACK_LEAVE_VEHICLE_LOCK, 4=BCM_LOCKUNLOCKFEEDBACK_MASTER_LOCK, 5=BCM_LOCKUNLOCKFEEDBACK_FINGER_LOCK, 6=BCM_LOCKUNLOCKFEEDBACK_RKE_30S_AUTOLOCK, 7=BCM_LOCKUNLOCKFBCM_LOCKUNLOCKFEEDBACK_PE_30S_AUTOLOCKEEDBACK_RKE_30S_AUTOLOCK, 8=BCM_LOCKUNLOCKFEEDBACK_NEAR_TO_VEHICLE_30S_AUTOLOCK, 9=BCM_LOCKUNLOCKFEEDBACK_TBOX_LOCK, 10=BCM_LOCKUNLOCKFEEDBACK_SPEEDLOCK, 11=BCM_LOCKUNLOCKFEEDBACK_DIAGNOSTIC_LOCK, 12=BCM_LOCKUNLOCKFEEDBACK_TBOX_30S_AUTOLOCK, 15=BCM_LOCKUNLOCKFEEDBACK_ANY_OTHER_LOCK, 17=BCM_LOCKUNLOCKFEEDBACK_PE_UNLOCK, 18=BCM_LOCKUNLOCKFEEDBACK_RKE_UNLOCK, 19=BCM_LOCKUNLOCKFEEDBACK_NEAR_TO_VEHICLE_UNLOCK, 20=BCM_LOCKUNLOCKFEEDBACK_MASTER_UNLOCK, 21=BCM_LOCKUNLOCKFEEDBACK_FINGER_UNLOCK, 22=BCM_LOCKUNLOCKFEEDBACK_CRASHUNLOCK, 23=BCM_LOCKUNLOCKFEEDBACK_KEYREMOVALUNLOCK, 24=BCM_LOCKUNLOCKFEEDBACK_ENGOFFUNLOCK, 25=BCM_LOCKUNLOCKFEEDBACK_TBOX_UNLCOK, 26=BCM_LOCKUNLOCKFEEDBACK_DIAGNOSTIC_UNLOCK, 27=BCM_LOCKUNLOCKFEEDBACK_KEY_FORGOTTEN_TO_UNLOCK_THE_CAR, 31=BCM_LOCKUNLOCKFEEDBACK_ANY_OTHER_UNLOCK}, implementation-data-type=UInt32
  impl type Bcm_lowbeamstsType: compu {0=BCM_LOWBEAMSTS_INVALID, 1=BCM_LOWBEAMSTS_OFF, 2=BCM_LOWBEAMSTS_ON, 3=BCM_LOWBEAMSTS_RESERVED}, implementation-data-type=UInt32
  impl type Bcm_outsidetempdigType: compu {0=BCM_OUTSIDETEMPDIG_NOFAULT, 1=BCM_OUTSIDETEMPDIG_SHORTCIRCUIT, 2=BCM_OUTSIDETEMPDIG_OPENCIRCUIT}, implementation-data-type=UInt32
  impl type Bcm_plg_driverswType: compu {0=BCM_PLG_DRIVERSW_RELEASE, 1=BCM_PLG_DRIVERSW_PRESS, 2=BCM_PLG_DRIVERSW_STUCK, 3=BCM_PLG_DRIVERSW_RESERVED}, implementation-data-type=UInt32
  impl type Bcm_poslmpstsType: compu {0=BCM_POSLMPSTS_NOUESD, 1=BCM_POSLMPSTS_OFF, 2=BCM_POSLMPSTS_ON, 3=BCM_POSLMPSTS_RESERVED}, implementation-data-type=UInt32
  impl type Bcm_powermodeType: compu {0=BCM_POWERMODE_UNDEFINED, 1=BCM_POWERMODE_OFF, 2=BCM_POWERMODE_ACC, 3=BCM_POWERMODE_ON, 4=BCM_POWERMODE_START}, implementation-data-type=UInt32
  impl type Bcm_reardef_statusType: compu {0=BCM_REARDEF_STATUS_INVALID, 1=BCM_REARDEF_STATUS_REARDEFINACTIVE, 2=BCM_REARDEF_STATUS_REARDEFACTIVE, 3=BCM_REARDEF_STATUS_RESERVED}, implementation-data-type=UInt32
  impl type Bcm_rearwiperstsType: compu {0=BCM_REARWIPERSTS_NO_USED, 1=BCM_REARWIPERSTS_OFF, 2=BCM_REARWIPERSTS_ON, 3=BCM_REARWIPERSTS_RESERVED}, implementation-data-type=UInt32
  impl type Bcm_reverse_gearType: compu {0=BCM_REVERSE_GEAR_UNDEFINED, 1=BCM_REVERSE_GEAR_NOTINREVERSEGEAR, 2=BCM_REVERSE_GEAR_INREVERSEGEAR, 3=BCM_REVERSE_GEAR_RESERVED}, implementation-data-type=UInt32
  impl type Bcm_ss_enablestsType: compu {0=BCM_SS_ENABLESTS_INVALID, 1=BCM_SS_ENABLESTS_STARTSTOPISALLOW, 2=BCM_SS_ENABLESTS_STARTSTOPISFORBID, 3=BCM_HIGHBEAMSTS_RESERVED}, implementation-data-type=UInt32
  impl type Bcm_trunkdoorpreunlockstsType: compu {0=BCM_TRUNKDOORPREUNLOCKSTS_NO_USED_NO_ACTION, 1=BCM_TRUNKDOORPREUNLOCKSTS_PREUNLOCKED}, implementation-data-type=UInt32
  impl type Bcm_turnindicatorstsType: compu {0=BCM_TURNINDICATORSTS_OFF, 1=BCM_TURNINDICATORSTS_LEON, 2=BCM_TURNINDICATORSTS_RION, 3=BCM_TURNINDICATORSTS_LEANDRION}, implementation-data-type=UInt32
  impl type Bcm_windowscmdType: compu {0=BCM_WINDOWSCMD_INVALID, 1=BCM_WINDOWSCMD_WINDOWS_UP, 2=BCM_WINDOWSCMD_WINDOWS_DOWN, 3=BCM_WINDOWSCMD_WINDOWS_VENT, 4=BCM_WINDOWSCMD_WINDOWS_STOP}, implementation-data-type=UInt32
  impl type Cta_offtelltaleType: compu {0=CTA_OFFTELLTALE_OFFTELLTLAE_OFF, 1=CTA_OFFTELLTALE_OFFTELLTALE_ON, 2=SOD_BLIS_ACTIVE_ACTIVE, 3=SOD_BLIS_ACTIVE_FAIL}, implementation-data-type=UInt32
  impl type Cx75: category=STRUCTURE
    60 x element, all with category=TYPE_REFERENCE:
      gw_ems_sts_0x151_151: implementation-data-type=Gw_ems_sts_0x151_151
      esp_raw_0x212_212: implementation-data-type=Esp_raw_0x212_212
      gw_bcm_door_0x310_310: implementation-data-type=Gw_bcm_door_0x310_310
      pam_0x{270..272}_{270..272}: implementation-data-type=Pam_0x{270..272}_{270..272}
      mrr_0x238_238: implementation-data-type=Mrr_0x238_238
      mrr_0x239_239: implementation-data-type=Mrr_0x239_239
      esp_direction_0x235_235: implementation-data-type=Esp_direction_0x235_235
      esp_advanced_0x234_234: implementation-data-type=Esp_advanced_0x234_234
      eps_advanced_0x176_176: implementation-data-type=Eps_advanced_0x176_176
      esp_whlpulse_0x236_236: implementation-data-type=Esp_whlpulse_0x236_236
      ipm_rightline_0x490_490: implementation-data-type=Ipm_rightline_0x490_490
      sas_sensor_0x175_175: implementation-data-type=Sas_sensor_0x175_175
      gw_body_0x321_321: implementation-data-type=Gw_body_0x321_321
      ipm_leftline_0x278_278: implementation-data-type=Ipm_leftline_0x278_278
      gw_ems_engstatus_0x142_142: implementation-data-type=Gw_ems_engstatus_0x142_142
      gw_tbox_location_0x580_580: implementation-data-type=Gw_tbox_location_0x580_580
      srs_0x350_350: implementation-data-type=Srs_0x350_350
      ipm_0x245_245: implementation-data-type=Ipm_0x245_245
      gw_ems_tqwhl_0x111_111: implementation-data-type=Gw_ems_tqwhl_0x111_111
      gw_tcu_gearinfo_0x123_123: implementation-data-type=Gw_tcu_gearinfo_0x123_123
      esp_pressure_0x241_241: implementation-data-type=Esp_pressure_0x241_241
      esp_status_0x243_243: implementation-data-type=Esp_status_0x243_243
      esp_axay_0x242_242: implementation-data-type=Esp_axay_0x242_242
      gw_swm_mrr_0x31b_31b: implementation-data-type=Gw_swm_mrr_0x31b_31b
      gw_swm_body_0x31a_31a: implementation-data-type=Gw_swm_body_0x31a_31a
      gw_ems_tq_0x101_101: implementation-data-type=Gw_ems_tq_0x101_101
      esp_vlc_0x223_223: implementation-data-type=Esp_vlc_0x223_223
      gw_ems_whltq_0x107_107: implementation-data-type=Gw_ems_whltq_0x107_107
      abs_sts_0x221_221: implementation-data-type=Abs_sts_0x221_221
      mrr_frobj_0x480_480: implementation-data-type=Mrr_frobj_0x480_480
      mrr_0x246_246: implementation-data-type=Mrr_0x246_246
      gw_mp5_nav_0x533_533: implementation-data-type=Gw_mp5_nav_0x533_533
      gw_ems_whltq_0x107_107: implementation-data-type=Gw_ems_whltq_0x107_107
      abs_sts_0x221_221: implementation-data-type=Abs_sts_0x221_221
      mrr_frobj_0x480_480: implementation-data-type=Mrr_frobj_0x480_480
      mrr_0x246_246: implementation-data-type=Mrr_0x246_246
      gw_mp5_nav_0x533_533: implementation-data-type=Gw_mp5_nav_0x533_533
      gw_mp5_0x530_530: implementation-data-type=Gw_mp5_0x530_530
      mrr_frobj_0x279_279: implementation-data-type=Mrr_frobj_0x279_279
      gw_ic_0x510_510: implementation-data-type=Gw_ic_0x510_510
      abs_whlspd_0x211_211: implementation-data-type=Abs_whlspd_0x211_211
      esp_tq_0x217_217: implementation-data-type=Esp_tq_0x217_217
      esp_rpmf_0x213_213: implementation-data-type=Esp_rpmf_0x213_213
      gw_ic_time_0x581_581: implementation-data-type=Gw_ic_time_0x581_581
      afs_0x5a0_5a0: implementation-data-type=Afs_0x5a0_5a0
      sod_nm_0x440_440: implementation-data-type=Sod_nm_0x440_440
      gw_nm_0x460_460: implementation-data-type=Gw_nm_0x460_460
      eps_0x260_260: implementation-data-type=Eps_0x260_260
      sod_0x275_275: implementation-data-type=Sod_0x275_275
      gw_tpms_tire_0x361_361: implementation-data-type=Gw_tpms_tire_0x361_361
      ins_datainfo_506: implementation-data-type=Ins_datainfo_506
      ins_std_507: implementation-data-type=Ins_std_507
      ins_latitudelongitude_504: implementation-data-type=Ins_latitudelongitude_504
      ins_speed_505: implementation-data-type=Ins_speed_505
      ins_headingpitchroll_502: implementation-data-type=Ins_headingpitchroll_502
      ins_heightandtime_503: implementation-data-type=Ins_heightandtime_503
      ins_gyro_501: implementation-data-type=Ins_gyro_501
      ins_acc_500: implementation-data-type=Ins_acc_500
  impl type Doa_offtelltaleType: compu {0=SOD_BLIS_ACTIVE_NO_ACTIVE, 1=DOA_OFFTELLTALE_OFFTELLTALE_ON}, implementation-data-type=UInt32
  impl type DxtarobjType: compu {0..4=DXTAROBJ_DISTANCE_0..DXTAROBJ_DISTANCE_4, 5=TAUGAPSET_TAUGAP_5, 6=TAUGAPSET_TAUGAP_6, 7=TAUGAPSET_TAUGAP_7}, implementation-data-type=UInt32
  impl type Eba_reqType: compu {0=EBA_REQ_NO_DEMAND, 1=EBA_REQ_DEMAND}, implementation-data-type=UInt32
  impl type Ems_accpedalratioerrorType: compu {0=EMS_ACCPEDALRATIOERROR_NOERROR, 1=EMS_ACCPEDALRATIOERROR_ERROR}, implementation-data-type=UInt32
  impl type Ems_aircompressorstatusType: compu {0=EMS_AIRCOMPRESSORSTATUS_OFF, 1=EMS_AIRCOMPRESSORSTATUS_ON}, implementation-data-type=UInt32
  impl type Ems_atsdrivingmodestatusType: compu {0=EBA_REQ_NO_DEMAND, 1=EBA_REQ_DEMAND}, implementation-data-type=UInt32
  compu method Ems_atsdrivingmodestatusTypeEnum: 0=EMS_ATSDRIVINGMODESTATUS_STANDARD, 1=EMS_ATSDRIVINGMODESTATUS_SPORT, 2=EMS_ATSDRIVINGMODESTATUS_ECO, 3=EMS_ATSDRIVINGMODESTATUS_INVALID
  impl type Ems_brkpedalstasusType: compu {0=EMS_BRKPEDALSTASUS_NOTPRESSED, 1=EMS_BRKPEDALSTASUS_PRESSED, 2=EMS_BRKPEDALSTASUS_RESERVED, 3=EMS_BRKPEDALSTASUS_ERROR}, implementation-data-type=UInt32
  impl type Ems_cruisecontrolstatusType: compu {0=EMS_CRUISECONTROLSTATUS_CRUISECONTROLOOFF, 1=EMS_CRUISECONTROLSTATUS_ACTIVE, 2=EMS_CRUISECONTROLSTATUS_STANDBY, 3=EMS_CRUISECONTROLSTATUS_ERROR}, implementation-data-type=UInt32
  impl type Ems_drivingmodechange_fault_flagType: compu {0=EMS_DRIVINGMODECHANGE_FAULT_FLAG_NORMAL, 1=EMS_DRIVINGMODECHANGE_FAULT_FLAG_FAULT}, implementation-data-type=UInt32
  impl type Ems_enginestopstartstatusType: compu {0=EMS_ENGINESTOPSTARTSTATUS_NON_START_STOPMODE, 1=EMS_ENGINESTOPSTARTSTATUS_ENGINESTANDBY, 2=EMS_ENGINESTOPSTARTSTATUS_ENGINESTOPPED, 3=EMS_ENGINESTOPSTARTSTATUS_STARTERRESTART, 4=EMS_ENGINESTOPSTARTSTATUS_ENGINERESTART, 5=EMS_ENGINESTOPSTARTSTATUS_ENGINEOPERATION, 6=c, 7=EMS_ENGINESTOPSTARTSTATUS_RESERVED}, implementation-data-type=UInt32
  impl type Ems_engoperationstatusType: compu {0=EMS_ENGOPERATIONSTATUS_STOPPED, 1=EMS_ENGOPERATIONSTATUS_RUNNING, 2=EMS_ENGOPERATIONSTATUS_IDLE, 3=EMS_ENGOPERATIONSTATUS_DFCO_RESERVED, 4=EMS_ENGOPERATIONSTATUS_CRANKING, 5=EMS_ENGOPERATIONSTATUS_STALLING}, implementation-data-type=UInt32
  impl type Ems_engspeederrorType: compu {0=EMS_ENGSPEEDERROR_NOERROR, 1=EMS_ENGSPEEDERROR_ERROR}, implementation-data-type=UInt32
  impl type Ems_ignswtstsType: compu {0=EMS_IGNSWTSTS_IGNITIONOFF, 1=EMS_IGNSWTSTS_IGNITIONON}, implementation-data-type=UInt32
  impl type Ems_indicatedaccmesgerrorType: compu {0=EMS_INDICATEDACCMESGERROR_NOEERROR, 1=EMS_INDICATEDACCMESGERROR_REVERSIBLE_ERROR, 2=EMS_INDICATEDACCMESGERROR_IRREVERSIBLE_ERROR, 3=EMS_INDICATEDACCMESGERROR_NOTDEFINED}, implementation-data-type=UInt32
  impl type Ems_indicateddriveroverrideType: compu {0=EMS_INDICATEDDRIVEROVERRIDE_NOOVERRIDE, 1=EMS_INDICATEDDRIVEROVERRIDE_DRIVEROVERRIDE}, implementation-data-type=UInt32
  impl type Ems_kickdownType: compu {0=EMS_KICKDOWN_NOTACTIVE, 1=EMS_KICKDOWN_ACTIVE}, implementation-data-type=UInt32
  impl type Ems_startstopmessageType: compu {0=EMS_STARTSTOPMESSAGE_NOWARNINGMESSAGE, 1=EMS_STARTSTOPMESSAGE_CLIMATEREQUEST, 2=EMS_STARTSTOPMESSAGE_BRAKELOW, 3=EMS_STARTSTOPMESSAGE_START_STOPOFF, 4=EMS_STARTSTOPMESSAGE_BATTERYLOW, 5=EMS_STARTSTOPMESSAGE_ECTLOW, 6=EMS_STARTSTOPMESSAGE_APAINHIBIT, 7=EMS_STARTSTOPMESSAGE_ACCINHIBIT, 8=EMS_STARTSTOPMESSAGE_TCUINHIBIT, 9=EMS_STARTSTOPMESSAGE_STARTPROTECT, 10=EMS_STARTSTOPMESSAGE_HOODOPEN, 11=EMS_STARTSTOPMESSAGE_DRVIEDOOROPNE, 12=EMS_STARTSTOPMESSAGE_STEERINGANGELHIGH, 13=EMS_STARTSTOPMESSAGE_STARTSTOPFAILURE, 14=EMS_STARTSTOPMESSAGE_MANUALLYRESTART, 15=EMS_STARTSTOPMESSAGE_RESERVED}, implementation-data-type=UInt32
  impl type Ems_throttleplatepositionerrorType: compu {0=EMS_THROTTLEPLATEPOSITIONERROR_NOERROR, 1=EMS_THROTTLEPLATEPOSITIONERROR_ERROR}, implementation-data-type=UInt32
  impl type Eps_0x260_260: category=STRUCTURE
    21 x element, all with category=TYPE_REFERENCE:
      eps_n_loadinfo: implementation-data-type=Int32
      eps_sassoftlimitrightflg: implementation-data-type=Eps_sassoftlimitrightflgType
      eps_st_emergencypowerlimit: implementation-data-type=Eps_st_emergencypowerlimitType
      eps_st_emergencymotor: implementation-data-type=Eps_st_emergencymotorType
      eps_st_emergencyecu: implementation-data-type=Eps_st_emergencyecuType
      eps_st_emergencycaninterface: implementation-data-type=Eps_st_emergencycaninterfaceType
      eps_st_emergencysensor: implementation-data-type=Eps_st_emergencysensorType
      eps_st_emergencyovertemp: implementation-data-type=Eps_st_emergencyovertempType
      eps_st_emergencyovervoltage: implementation-data-type=Eps_st_emergencyovervoltageType
      eps_st_emergencyundervoltage: implementation-data-type=Eps_st_emergencyundervoltageType
      eps_f_ecutempvalid: implementation-data-type=Eps_f_ecutempvalidType
      eps_sassoftlimitleftflg: implementation-data-type=Eps_sassoftlimitleftflgType
      eps_n_ecutemp: implementation-data-type=Int32
      eps_n_performanceredu: implementation-data-type=Double
      eps_st_dtcflag: implementation-data-type=Eps_st_dtcflagType
      rolling_counter_0x260: implementation-data-type=Int32
      eps_sasindexsts: implementation-data-type=Eps_sasindexstsType
      eps_s_warninglampyellow: implementation-data-type=Eps_s_warninglampyellowType
      checksum_0x260: implementation-data-type=Int32
      eps_s_safelampred: implementation-data-type=Eps_s_safelampredType
      eps_f_loadinfo: implementation-data-type=Eps_f_loadinfoType
  impl type Eps_advanced_0x176_176: category=STRUCTURE
    11 x element, all with category=TYPE_REFERENCE:
      eps_lkaresponsetorque: implementation-data-type=Double
      eps_tosionbartorquevalid: implementation-data-type=Eps_tosionbartorquevalidType
      eps_lkaresponsetorquevalid: implementation-data-type=Eps_lkaresponsetorquevalidType
      eps_ldwcontrolstatus: implementation-data-type=Eps_ldwcontrolstatusType
      eps_pam_steeringsts_reserved: implementation-data-type=Eps_pam_steeringsts_reservedType
      eps_lkacontrolstatus: implementation-data-type=Eps_lkacontrolstatusType
      eps_epspaminh: implementation-data-type=Eps_epspaminhType
      rolling_counter_0x176: implementation-data-type=Int32
      eps_epspamsts: implementation-data-type=Eps_epspamstsType
      checksum_0x176: implementation-data-type=Int32
      eps_torsionbartorque: implementation-data-type=Double
  impl type Eps_epspaminhType: compu {0=EPS_EPSPAMINH_NORMAL_OPERATION, 1=EPS_EPSPAMINH_OVER_SPEED, 2=EPS_EPSPAMINH_DRIVER_INTERFERENCE, 4=EPS_EPSPAMINH_ABNORMAL_CAN_INPUT, 8=EPS_EPSPAMINH_EXCESS_ANGLE_DEVIATION, 16=EPS_EPSPAMINH_EPS_FAILURE}, implementation-data-type=UInt32
  impl type Eps_epspamstsType: compu {0=EPS_EPSPAMSTS_INHIBIT, 1=EPS_EPSPAMSTS_AVAILABLE, 2=EPS_EPSPAMSTS_ACTIVE, 3=EPS_EPSPAMSTS_ABORT, 4=EPS_EPSPAMSTS_REPLY_FOR_CONTROL, 5=EPS_EPSPAMSTS_NRCD_ACTIVE, 6=EPS_EPSPAMSTS_ADAS_ACTIVE, 7=EPS_EPSPAMSTS_FAILURE}, implementation-data-type=UInt32
  impl type Eps_f_ecutempvalidType: compu {0=EPS_F_ECUTEMPVALID_INVALID, 1=EPS_F_ECUTEMPVALID_VALID}, implementation-data-type=UInt32
  impl type Eps_f_loadinfoType: compu {0=EPS_F_LOADINFO_NO_FAULT, 1=EPS_F_LOADINFO_FAULT}, implementation-data-type=UInt32
  impl type Eps_ldwcontrolstatusType: compu {0=EPS_LDWCONTROLSTATUS_DEACTIVATED, 1=EPS_LDWCONTROLSTATUS_INACTIVE, 2=EPS_LDWCONTROLSTATUS_ACTIVE, 3=EPS_LDWCONTROLSTATUS_RESERVED}, implementation-data-type=UInt32
  impl type Eps_lkacontrolstatusType: compu {0=EPS_LKACONTROLSTATUS_NO_REQUEST, 1=EPS_LKACONTROLSTATUS_REQUEST_HONORED, 2=EPS_LKACONTROLSTATUS_CONTROL_REQUEST_NOT_ALLOWED_TEMPORARILY, 3=EPS_LKACONTROLSTATUS_CONTROL_REQUEST_NOT_ALLOWED_PERMANENT}, implementation-data-type=UInt32
  impl type Eps_lkaresponsetorquevalidType: compu {0=EPS_LKARESPONSETORQUEVALID_VAILD, 1=EPS_LKARESPONSETORQUEVALID_INVALID}, implementation-data-type=UInt32
  impl type Eps_pam_steeringsts_reservedType: compu {0=EPS_PAM_STEERINGSTS_RESERVED_STEERING_POSITION_IS_OK, 1=EPS_PAM_STEERINGSTS_RESERVED_STEERING_POSITION_IS_ADJUSTING}, implementation-data-type=UInt32
  impl type Eps_s_safelampredType: compu {0=EPS_S_SAFELAMPRED_CLOSE, 1=EPS_S_SAFELAMPRED_OPEN}, implementation-data-type=UInt32
  impl type Eps_s_warninglampyellowType: compu {0=EPS_S_WARNINGLAMPYELLOW_CLOSE, 1=EPS_S_WARNINGLAMPYELLOW_OPEN}, implementation-data-type=UInt32
  impl type Eps_sasindexstsType: compu {0=EPS_SASINDEXSTS_STEERWHEEL_NOT_AT_MIDDLE_POSITION, 1=EPS_SASINDEXSTS_STEERWHEEL_AT_MIDDLE_POSITION}, implementation-data-type=UInt32
  impl type Eps_sassoftlimitleftflgType: compu {0=EPS_SASSOFTLIMITLEFTFLG_NO_LEARNED, 1=EPS_SASSOFTLIMITLEFTFLG_PRIMARY_LEARNED_ONLY_FOR_CEPS, 2=EPS_SASSOFTLIMITLEFTFLG_LEARNED, 3=EPS_SASSOFTLIMITLEFTFLG_RESERVED}, implementation-data-type=UInt32
  impl type Eps_sassoftlimitrightflgType: compu {0=EPS_SASSOFTLIMITRIGHTFLG_NO_LEARNED, 1=EPS_SASSOFTLIMITRIGHTFLG_PRIMARY_LEARNED_ONLY_FOR_CEPS, 2=EPS_SASSOFTLIMITRIGHTFLG_LEARNED, 3=EPS_SASSOFTLIMITRIGHTFLG_RESERVED}, implementation-data-type=UInt32
  impl type Eps_st_dtcflagType: compu {0=EPS_ST_DTCFLAG_NO_DTC_EXIST, 1=EPS_ST_DTCFLAG_DTC_EXIST}, implementation-data-type=UInt32
  impl type Eps_st_emergencycaninterfaceType: compu {0=EPS_ST_EMERGENCYCANINTERFACE_NORMAL, 1=EPS_ST_EMERGENCYCANINTERFACE_CAN_INTERFACE_IS_FAULT}, implementation-data-type=UInt32
  impl type Eps_st_emergencyecuType: compu {0=EPS_ST_EMERGENCYECU_NORMAL, 1=EPS_ST_EMERGENCYECU_ECU_INNER_FAULT}, implementation-data-type=UInt32
  impl type Eps_st_emergencymotorType: compu {0=EPS_ST_EMERGENCYMOTOR_NORMAL, 1=EPS_ST_EMERGENCYMOTOR_SERVO_MOTOR_FAULT}, implementation-data-type=UInt32
  impl type Eps_st_emergencyovertempType: compu {0=EPS_ST_EMERGENCYOVERTEMP_NORMAL, 1=EPS_ST_EMERGENCYOVERTEMP_OVER_TEMPERATURE}, implementation-data-type=UInt32
  impl type Eps_st_emergencyovervoltageType: compu {0=EPS_ST_EMERGENCYOVERVOLTAGE_NORMAL, 1=EPS_ST_EMERGENCYOVERVOLTAGE_OVER_VOLTAGE}, implementation-data-type=UInt32
  impl type Eps_st_emergencypowerlimitType: compu {0=EPS_ST_EMERGENCYPOWERLIMIT_NORMAL, 1=EPS_ST_EMERGENCYPOWERLIMIT_POWER_DENSITY_LIMIT}, implementation-data-type=UInt32
  impl type Eps_st_emergencysensorType: compu {0=EPS_ST_EMERGENCYSENSOR_NORMAL, 1=EPS_ST_EMERGENCYSENSOR_SENSOR_IS_FAULT}, implementation-data-type=UInt32
  impl type Eps_st_emergencyundervoltageType: compu {0=EPS_ST_EMERGENCYUNDERVOLTAGE_NORMAL, 1=EPS_ST_EMERGENCYUNDERVOLTAGE_UNDER_VOLTAGE}, implementation-data-type=UInt32
  impl type Eps_tosionbartorquevalidType: compu {0=EPS_TOSIONBARTORQUEVALID_VAILD, 1=EPS_TOSIONBARTORQUEVALID_INVALID}, implementation-data-type=UInt32
  impl type Esp_abaactiveType: compu {0=ESP_ABAACTIVE_NOT_ACTIVATED, 1=ESP_ABAACTIVE_ACTIVATED}, implementation-data-type=UInt32
  impl type Esp_abaavailableType: compu {0=ESP_ABAAVAILABLE_NOT_AVAILABLE, 1=ESP_ABAAVAILABLE_AVAILABLE}, implementation-data-type=UInt32
  impl type Esp_advanced_0x234_234: category=STRUCTURE
    22 x element, all with category=TYPE_REFERENCE:
      esp_vdcactive: implementation-data-type=Esp_vdcactiveType
      esp_ebdactive: implementation-data-type=Esp_ebdactiveType
      esp_ecdtempoff: implementation-data-type=Esp_ecdtempoffType
      esp_nobrakeforce: implementation-data-type=Esp_nobrakeforceType
      esp_brkfrictqtotatwhlvaild: implementation-data-type=Esp_brkfrictqtotatwhlvaildType
      esp_aebdecavailable: implementation-data-type=Esp_aebdecavailableType
      esp_aebdecactive: implementation-data-type=Esp_aebdecactiveType
      esp_prefillavailable: implementation-data-type=Esp_prefillavailableType
      esp_prefillactive: implementation-data-type=Esp_prefillactiveType
      esp_abaavailable: implementation-data-type=Esp_abaavailableType
      esp_abaactive: implementation-data-type=Esp_abaactiveType
      esp_cddavailable: implementation-data-type=Esp_cddactiveType
      esp_dtcactive: implementation-data-type=Esp_dtcactiveType
      esp_awbavailable: implementation-data-type=Esp_awbactiveType
      esp_awbactive: implementation-data-type=Esp_awbactiveType
      esp_brkfrictqtotatwhl: implementation-data-type=Int32
      esp_vlcerror: implementation-data-type=Esp_vlcerrorType
      esp_cdderror: implementation-data-type=Esp_cdderrorType
      rolling_counter_0x234: implementation-data-type=Int32
      checksum_0x234: implementation-data-type=Int32
      esp_cddactive: implementation-data-type=Esp_cddactiveType
      esp_cdd_apactive: implementation-data-type=Esp_cdd_apactiveType
  impl type Esp_aebdecactiveType: compu {0=ESP_AEBDECACTIVE_NOT_ACTIVATED, 1=ESP_AEBDECACTIVE_ACTIVATED}, implementation-data-type=UInt32
  impl type Esp_aebdecavailableType: compu {0=ESP_AEBDECAVAILABLE_NOT_AVAILABLE, 1=ESP_AEBDECAVAILABLE_AVAILABLE}, implementation-data-type=UInt32
  impl type Esp_alatstatusType: compu {0=ESP_ALATSTATUS_OK, 1=ESP_ALATSTATUS_FAULT}, implementation-data-type=UInt32
  impl type Esp_algtstatusType: compu {0=ESP_ALGTSTATUS_OK, 1=ESP_ALGTSTATUS_FAULT}, implementation-data-type=UInt32
  impl type Esp_apa_gearboxenableType: compu-method=Esp_apa_gearboxenableTypeEnum, implementation-data-type=UInt32
  compu method Esp_apa_gearboxenableTypeEnum: 0=ESP_APA_GEARBOXENABLE_NO_REQUEST, 1=ESP_APA_GEARBOXENABLE_GEAR_SHIFT_REQUEST
  impl type Esp_avhactiveType: compu {0=ESP_AVHACTIVE_INACTIVE, 1=ESP_AVHACTIVE_ACTIVE}, implementation-data-type=UInt32
  impl type Esp_avhavabliableType: compu {0=ESP_AVHAVABLIABLE_AVAILABLE, 1=ESP_AVHAVABLIABLE_NOT_AVAILABLE}, implementation-data-type=UInt32
  impl type Esp_avhstandbyType: compu {0=ESP_AVHSTANDBY_NOT_STANDBY, 1=ESP_AVHSTANDBY_STANDBY}, implementation-data-type=UInt32
  impl type Esp_avhwarningmessageType: compu {0=ESP_AVHWARNINGMESSAGE_NO_WARNING, 1=ESP_AVHWARNINGMESSAGE_PLEASE_CLOSE_THE_DOOR_OR_SEATBLET_THEN_PRESSURE_THE_AVH_BUTTON}, implementation-data-type=UInt32
  impl type Esp_awbactiveType: compu {0=ESP_AWBACTIVE_NOT_ACTIVATED, 1=ESP_AWBACTIVE_ACTIVATED}, implementation-data-type=UInt32
  impl type Esp_axay_0x242_242: category=STRUCTURE
    8 x element, all with category=TYPE_REFERENCE:
      esp_alat: implementation-data-type=Double
      esp_yawrate: implementation-data-type=Double
      rolling_counter_0x242: implementation-data-type=Int32
      esp_yawratestatus: implementation-data-type=Esp_yawratestatusType
      esp_alatstatus: implementation-data-type=Esp_alatstatusType
      esp_algtstatus: implementation-data-type=Esp_algtstatusType
      checksum_0x242: implementation-data-type=Int32
      esp_algt: implementation-data-type=Double
  impl type Esp_brkfrictqtotatwhlvaildType: compu {0=ESP_BRKFRICTQTOTATWHLVAILD_VALID, 1=ESP_BRKFRICTQTOTATWHLVAILD_INVALID}, implementation-data-type=UInt32
  impl type Esp_ccswitchoffType: compu {0=ESP_CCSWITCHOFF_NOT_SWITCH_OFF_CRUISE_CONTROL, 1=ESP_CCSWITCHOFF_SWITCH_OFF_CRUISE_CONTROL}, implementation-data-type=UInt32
  impl type Esp_cdd_apactiveType: compu {0=ESP_CDD_APACTIVE_NOT_ACTIVATED, 1=ESP_CDD_APACTIVE_ACTIVATED}, implementation-data-type=UInt32
  impl type Esp_cddactiveType: compu {0=ESP_CDDACTIVE_NOT_ACTIVATED, 1=ESP_CDDACTIVE_ACTIVATED}, implementation-data-type=UInt32
  impl type Esp_cdderrorType: compu {0=ESP_CDDERROR_NOT_ERROR, 1=ESP_CDDERROR_ERROR}, implementation-data-type=UInt32
  impl type Esp_cdpactiveType: compu {0=ESP_CDPACTIVE_NOT_ACTIVE, 1=ESP_CDPACTIVE_ACTIVE}, implementation-data-type=UInt32
  impl type Esp_cdpavailableType: compu {0=ESP_CDPAVAILABLE_AVAILABLE, 1=ESP_CDPAVAILABLE_NOT_AVAILABLE}, implementation-data-type=UInt32
  impl type Esp_direction_0x235_235: category=STRUCTURE
    15 x element, all with category=TYPE_REFERENCE:
      esp_whlmilgrearre: implementation-data-type=Int32
      esp_frwheeldrivedirstatus: implementation-data-type=Esp_frwheeldrivedirstatusType
      esp_flwheeldrivedirstatus: implementation-data-type=Esp_flwheeldrivedirstatusType
      esp_rrwheeldrivedirstatus: implementation-data-type=Esp_rrwheeldrivedirstatusType
      esp_rlwheeldrivedirstatus: implementation-data-type=Esp_rlwheeldrivedirstatusType
      esp_rrwheeldrivedirection: implementation-data-type=Esp_rrwheeldrivedirectionType
      esp_rlwheeldrivedirection: implementation-data-type=Esp_rlwheeldrivedirectionType
      esp_frwheeldrivedirection: implementation-data-type=Esp_frwheeldrivedirectionType
      esp_flwheeldrivedirection: implementation-data-type=Esp_flwheeldrivedirectionType
      rolling_counter_0x235: implementation-data-type=Int32
      esp_whlmilgrearlestatus: implementation-data-type=Esp_whlmilgrearlestatusType
      esp_whlmilgrearristatus: implementation-data-type=Esp_whlmilgrearristatusType
      esp_vehiclestandstill: implementation-data-type=Esp_vehiclestandstillType
      checksum_0x235: implementation-data-type=Int32
      esp_whlmilgrearle: implementation-data-type=Int32
  impl type Esp_driving_mode_reqType: compu {0=ESP_DRIVING_MODE_REQ_AUTO, 1=ESP_DRIVING_MODE_REQ_SNOW, 2=ESP_DRIVING_MODE_REQ_NO_USED, 3=ESP_DRIVING_MODE_REQ_SPORT, 4=ESP_DRIVING_MODE_REQ_ECO, 5=ESP_DRIVING_MODE_REQ_4L, 6=ESP_DRIVING_MODE_REQ_ROCK, 7=ESP_DRIVING_MODE_REQ_WETMUD, 8=ESP_DRIVING_MODE_REQ_SAND, 13=ESP_DRIVING_MODE_REQ_ATS_SHIFTING, 14=ESP_DRIVING_MODE_REQ_ATS_SHIFT_FAILURE, 15=ESP_DRIVING_MODE_REQ_INVALID}, implementation-data-type=UInt32
  impl type Esp_dtcactiveType: compu {0=ESP_DTCACTIVE_NOT_ACTIVATED, 1=ESP_DTCACTIVE_ACTIVATED}, implementation-data-type=UInt32
  impl type Esp_ebdactiveType: compu {0=ESP_EBDACTIVE_NOT_ACTIVE, 1=ESP_EBDACTIVE_ACTIVE}, implementation-data-type=UInt32
  impl type Esp_ecdtempoffType: compu {0=ESP_ECDTEMPOFF_NOT_HIGH, 1=ESP_ECDTEMPOFF_TEMP_TOO_HIGH}, implementation-data-type=UInt32
  impl type Esp_epberrorstatusType: compu {0=ESP_EPBERRORSTATUS_UNDEFINED, 1=ESP_EPBERRORSTATUS_NO_ERROR, 2=ESP_EPBERRORSTATUS_ERROR, 3=ESP_EPBERRORSTATUS_DIAGNOSIS}, implementation-data-type=UInt32
  impl type Esp_epbstatusType: compu {0=ESP_EPBSTATUS_RELEASED, 1=ESP_EPBSTATUS_APPLIED, 2=ESP_EPBSTATUS_RELEASINGR, 3=ESP_EPBSTATUS_APPLYING, 4=ESP_EPBSTATUS_UNKNOWN, 5=ESP_EPBSTATUS_ERROR}, implementation-data-type=UInt32
  impl type Esp_epbwarningmessage1Type: compu {0=ESP_EPBWARNINGMESSAGE1_NO_DISPLAY, 1=ESP_EPBWARNINGMESSAGE1_NO_BRAKE_PEDAL_PRESSED_AND_RELEASE_THE_EPB}, implementation-data-type=UInt32
  impl type Esp_epbwarningmessage2Type: compu {0=ESP_EPBWARNINGMESSAGE2_NO_DISPLAY, 1=ESP_EPBWARNINGMESSAGE2_EPB_DRIVEROFF_WITHOUT_SEATBLET_OR_DRIVER_DOOR}, implementation-data-type=UInt32
  impl type Esp_epbwarningmessage3Type: compu {0=ESP_EPBWARNINGMESSAGE3_NO_DISPLAY, 1=ESP_EPBWARNINGMESSAGE3_WHEN_APPLIED_THE_EPB_THE_SLOPE_OF_VEHICLE_IS_MORE_THAN_20_FOR_PK_30_FOR_SUV}, implementation-data-type=UInt32
  impl type Esp_espctrlactvType: compu {0=ESP_ESPCTRLACTV_NOT_ACTIVE, 1=ESP_ESPCTRLACTV_ACTIVE}, implementation-data-type=UInt32
  impl type Esp_espenablestsType: compu {0=ESP_ESPENABLESTS_ESP_DISABLED, 1=ESP_ESPENABLESTS_ESP_ENABLED}, implementation-data-type=UInt32
  impl type Esp_espinfolampType: compu {0=ESP_ESPINFOLAMP_OFF, 1=ESP_ESPINFOLAMP_ON}, implementation-data-type=UInt32
  impl type Esp_flwheeldrivedirectionType: compu {0=ESP_FLWHEELDRIVEDIRECTION_UNDEFINED, 1=ESP_FLWHEELDRIVEDIRECTION_STANDSTILL, 2=ESP_FLWHEELDRIVEDIRECTION_FORWARD, 3=ESP_FLWHEELDRIVEDIRECTION_BACKWARD}, implementation-data-type=UInt32
  impl type Esp_flwheeldrivedirstatusType: compu {0=ESP_FLWHEELDRIVEDIRSTATUS_VALID, 1=ESP_FLWHEELDRIVEDIRSTATUS_INVALID}, implementation-data-type=UInt32
  impl type Esp_frwheeldrivedirectionType: compu {0=ESP_FRWHEELDRIVEDIRECTION_UNDEFINED, 1=ESP_FRWHEELDRIVEDIRECTION_STANDSTILL, 2=ESP_FRWHEELDRIVEDIRECTION_FORWARD, 3=ESP_FRWHEELDRIVEDIRECTION_BACKWARD}, implementation-data-type=UInt32
  impl type Esp_frwheeldrivedirstatusType: compu {0=ESP_FRWHEELDRIVEDIRSTATUS_VALID, 1=ESP_FRWHEELDRIVEDIRSTATUS_INVALID}, implementation-data-type=UInt32
  impl type Esp_gearshiftprevnType: compu {0=ESP_GEARSHIFTPREVN_NO_REQUEST, 1=ESP_GEARSHIFTPREVN_INHIBIT_UPSHIFT, 2=ESP_GEARSHIFTPREVN_INHIBIT_DOWN_SHIFT, 3=ESP_GEARSHIFTPREVN_INHIBIT_ALL_SHIFTS}, implementation-data-type=UInt32
  impl type Esp_hdcavailableType: compu {0=ESP_HDCAVAILABLE_AVAILABLE, 1=ESP_HDCAVAILABLE_NOT_AVAILABLE}, implementation-data-type=UInt32
  impl type Esp_hhcactiveType: compu {0=ESP_HHCACTIVE_NOT_ACTIVE, 1=ESP_HHCACTIVE_ACTIVE}, implementation-data-type=UInt32
  impl type Esp_hhcavailableType: compu {0=ESP_HHCAVAILABLE_AVAILABLE, 1=ESP_HHCAVAILABLE_NOT_AVAILABLE}, implementation-data-type=UInt32
  impl type Esp_ldmblc_blrequestcontrollerType: compu {0=ESP_LDMBLC_BLREQUESTCONTROLLER_NOT_ILLUMINATE, 1=ESP_LDMBLC_BLREQUESTCONTROLLER_ILLUMINATE}, implementation-data-type=UInt32
  impl type Esp_master_cylinder_pressure_staType: compu {0=ESP_MASTER_CYLINDER_PRESSURE_STA_VALID, 1=ESP_MASTER_CYLINDER_PRESSURE_STA_INVALID}, implementation-data-type=UInt32
  impl type Esp_nobrakeforceType: compu {0=ESP_NOBRAKEFORCE_EXIST_BRK_FORCE, 1=ESP_NOBRAKEFORCE_NO_BRK_FORCE}, implementation-data-type=UInt32
  impl type Esp_pam_lc_failurestsType: compu {0=ESP_PAM_LC_FAILURESTS_NO_ERROR, 1=ESP_PAM_LC_FAILURESTS_VEHICLE_BLOCKED, 2=ESP_PAM_LC_FAILURESTS_UNEXPECTED_GEARPOSITION, 3=ESP_PAM_LC_FAILURESTS_UNEXPECTED_EPB_ACTION, 4=ESP_PAM_LC_FAILURESTS_UNEXPECTED_ACCPEDALINTERVENTION, 5=ESP_PAM_LC_FAILURESTS_UNEXPECTED_GEARINTERVENTION, 7=ESP_PAM_LC_FAILURESTS_ERROR}, implementation-data-type=UInt32
  impl type Esp_pam_lc_statusType: compu {0=ESP_PAM_LC_STATUS_OFF, 1=ESP_PAM_LC_STATUS_STANDBY, 4=ESP_PAM_LC_STATUS_ACTIVE_AUTOMATICPARK, 10=ESP_PAM_LC_STATUS_ERROR}, implementation-data-type=UInt32
  impl type Esp_prefillactiveType: compu {0=ESP_PREFILLACTIVE_NOT_ACTIVATED, 1=ESP_PREFILLACTIVE_ACTIVATED}, implementation-data-type=UInt32
  impl type Esp_prefillavailableType: compu {0=ESP_PREFILLAVAILABLE_NOT_AVAILABLE, 1=ESP_PREFILLAVAILABLE_NOT_AVAILABLE}, implementation-data-type=UInt32
  impl type Esp_presoffsetmastercylindervaliType: compu {0=ESP_PRESOFFSETMASTERCYLINDERVALI_VALID, 1=ESP_PRESOFFSETMASTERCYLINDERVALI_INVALID}, implementation-data-type=UInt32
  impl type Esp_pressure_0x241_241: category=STRUCTURE
    8 x element, all with category=TYPE_REFERENCE:
      esp_trfcasetqlmtdbyesp: implementation-data-type=Int32
      esp_trfcasemodreqdbyesp: implementation-data-type=Esp_trfcasemodreqdbyespType
      esp_presoffsetmastercylindervali: implementation-data-type=Esp_presoffsetmastercylindervaliType
      esp_presoffsetmastercylinder: implementation-data-type=Int32
      rolling_counter_0x241: implementation-data-type=Int32
      esp_master_cylinder_pressure_sta: implementation-data-type=Esp_master_cylinder_pressure_staType
      checksum_0x241: implementation-data-type=Int32
      esp_master_cylinder_pressure: implementation-data-type=Double
  impl type Esp_raw_0x212_212: category=STRUCTURE
    10 x element, all with category=TYPE_REFERENCE:
      esp_vxwwheelrawfr: implementation-data-type=Double
      esp_vxwwheelrawrl: implementation-data-type=Double
      esp_vxwwheelrawrr: implementation-data-type=Double
      rolling_counter_0x212: implementation-data-type=Int32
      esp_vxwwheelrrvalid: implementation-data-type=Esp_vxwwheelrrvalidType
      esp_vxwwheelrlvalid: implementation-data-type=Esp_vxwwheelrlvalidType
      esp_vxwwheelfrvalid: implementation-data-type=Esp_vxwwheelfrvalidType
      esp_vxwwheelflvalid: implementation-data-type=Esp_vxwwheelflvalidType
      checksum_0x212: implementation-data-type=Int32
      esp_vxwwheelrawfl: implementation-data-type=Double
  impl type Esp_rlwheeldrivedirectionType: compu {0=ESP_RLWHEELDRIVEDIRECTION_UNDEFINED, 1=ESP_RLWHEELDRIVEDIRECTION_STANDSTILL, 2=ESP_RLWHEELDRIVEDIRECTION_FORWARD, 3=ESP_RLWHEELDRIVEDIRECTION_BACKWARD}, implementation-data-type=UInt32
  impl type Esp_rlwheeldrivedirstatusType: compu {0=ESP_RLWHEELDRIVEDIRSTATUS_VALID, 1=ESP_RLWHEELDRIVEDIRSTATUS_INVALID}, implementation-data-type=UInt32
  impl type Esp_rpmf_0x213_213: category=STRUCTURE
    6 x element, all with category=TYPE_REFERENCE:
      esp_wheelrpmfr: implementation-data-type=Double
      esp_wheelrpmfrvalid: implementation-data-type=Esp_wheelrpmfrvalidType
      rolling_counter_0x213: implementation-data-type=Int32
      checksum_0x213: implementation-data-type=Int32
      esp_wheelrpmfl: implementation-data-type=Double
      esp_wheelrpmflvalid: implementation-data-type=Esp_vxwwheelflvalidType
  impl type Esp_rrwheeldrivedirectionType: compu {0=ESP_RRWHEELDRIVEDIRECTION_UNDEFINED, 1=ESP_RRWHEELDRIVEDIRECTION_STANDSTILL, 2=ESP_RRWHEELDRIVEDIRECTION_FORWARD, 3=ESP_RRWHEELDRIVEDIRECTION_BACKWARD}, implementation-data-type=UInt32
  impl type Esp_rrwheeldrivedirstatusType: compu {0=ESP_RRWHEELDRIVEDIRSTATUS_VALID, 1=ESP_RRWHEELDRIVEDIRSTATUS_INVALID}, implementation-data-type=UInt32
  impl type Esp_status_0x243_243: category=STRUCTURE
    27 x element, all with category=TYPE_REFERENCE:
      esp_hhcavailable: implementation-data-type=Esp_hhcavailableType
      esp_hhcactive: implementation-data-type=Esp_hhcactiveType
      esp_hdcactive: implementation-data-type=Esp_hdcavailableType
      esp_ldmblc_blrequestcontroller: implementation-data-type=Esp_ldmblc_blrequestcontrollerType
      esp_cdpavailable: implementation-data-type=Esp_cdpavailableType
      esp_epbwarningmessage3: implementation-data-type=Esp_epbwarningmessage3Type
      esp_epbwarningmessage2: implementation-data-type=Esp_epbwarningmessage2Type
      esp_epbwarningmessage1: implementation-data-type=Esp_epbwarningmessage1Type
      esp_avhwarningmessage: implementation-data-type=Esp_avhwarningmessageType
      esp_avhactive: implementation-data-type=Esp_avhactiveType
      esp_avhstandby: implementation-data-type=Esp_avhstandbyType
      esp_avhavabliable: implementation-data-type=Esp_avhavabliableType
      esp_vdcflgflt: implementation-data-type=Esp_vdcflgfltType
      esp_tcsflgflt: implementation-data-type=Esp_tcsflgfltType
      esp_tcsctrlactv: implementation-data-type=Esp_tcsctrlactvType
      esp_espctrlactv: implementation-data-type=Esp_espctrlactvType
      esp_driving_mode_req: implementation-data-type=Esp_driving_mode_reqType
      esp_espinfolamp: implementation-data-type=Esp_espinfolampType
      esp_espenablests: implementation-data-type=Esp_espenablestsType
      esp_gearshiftprevn: implementation-data-type=Esp_gearshiftprevnType
      esp_epbstatus: implementation-data-type=Esp_epbstatusType
      rollingcounter_0x243: implementation-data-type=Int32
      rollerbenchmodests: implementation-data-type=RollerbenchmodestsType
      checksum_0x243: implementation-data-type=Int32
      esp_epberrorstatus: implementation-data-type=Esp_epberrorstatusType
      esp_ccswitchoff: implementation-data-type=Esp_ccswitchoffType
      esp_hdcavailable: implementation-data-type=Esp_hdcavailableType
  impl type Esp_target_gear_requestType: compu {0=ESP_TARGET_GEAR_REQUEST_NO_REQUEST, 1=ESP_TARGET_GEAR_REQUEST_PARK, 2=ESP_TARGET_GEAR_REQUEST_REVERSE, 3=ESP_TARGET_GEAR_REQUEST_NEUTRAL, 4=ESP_TARGET_GEAR_REQUEST_DRIVE}, implementation-data-type=UInt32
  impl type Esp_tcsctrlactvType: compu {0=ESP_TCSCTRLACTV_NOT_ACTIVE, 1=ESP_TCSCTRLACTV_ACTIVE}, implementation-data-type=UInt32
  impl type Esp_tcsflgfltType: compu {0=ESP_TCSFLGFLT_NO_FAILURE, 1=ESP_TCSFLGFLT_FAILURE}, implementation-data-type=UInt32
  impl type Esp_tq_0x217_217: category=STRUCTURE
    7 x element, all with category=TYPE_REFERENCE:
      esp_tqdecreqdbyespslow: implementation-data-type=Double
      esp_tqinccreqdbyesp: implementation-data-type=Double
      rolling_counter_0x217: implementation-data-type=Int32
      esp_trqinc_req: implementation-data-type=Esp_trqinc_reqType
      esp_trqred_req: implementation-data-type=Esp_trqred_reqType
      checksum_0x217: implementation-data-type=Int32
      esp_tqdecreqdbyespfast: implementation-data-type=Double
  impl type Esp_trfcasemodreqdbyespType: compu {0=ESP_TRFCASEMODREQDBYESP_NO_REQUEST, 1=ESP_TRFCASEMODREQDBYESP_FAST_OPEN_REQUEST, 2=ESP_TRFCASEMODREQDBYESP_TORQUE_UPPER_LIMIT_REQUEST, 3=ESP_TRFCASEMODREQDBYESP_FAILURE}, implementation-data-type=UInt32
  impl type Esp_trqinc_reqType: compu {0=ESP_TRQINC_REQ_INACTIVE, 1=ESP_TRQINC_REQ_ACTIVE}, implementation-data-type=UInt32
  impl type Esp_trqred_reqType: compu {0=ESP_TRQRED_REQ_INACTIVE, 1=ESP_TRQRED_REQ_ACTIVE}, implementation-data-type=UInt32
  impl type Esp_vdcactiveType: compu {0=ESP_VDCACTIVE_NOT_ACTIVE, 1=ESP_VDCACTIVE_ACTIVE}, implementation-data-type=UInt32
  impl type Esp_vdcflgfltType: compu {0=ESP_VDCFLGFLT_NO_FAILURE, 1=ESP_VDCFLGFLT_FAILURE}, implementation-data-type=UInt32
  impl type Esp_vehiclestandstillType: compu {0=ESP_VEHICLESTANDSTILL_NOT_STANDSTILL, 1=ESP_VEHICLESTANDSTILL_STANDSTILL, 3=ESP_VEHICLESTANDSTILL_INVALID}, implementation-data-type=UInt32
  impl type Esp_vlc_0x223_223: category=STRUCTURE
    13 x element, all with category=TYPE_REFERENCE:
      esp_vlc_internaltargetacce: implementation-data-type=Double
      esp_apa_gearboxenable: implementation-data-type=Esp_apa_gearboxenableType
      esp_target_gear_request: implementation-data-type=Esp_target_gear_requestType
      esp_vlc_apactive: implementation-data-type=Esp_vlc_apactiveType
      esp_pam_lc_failurests: implementation-data-type=Esp_pam_lc_failurestsType
      esp_pam_lc_status: implementation-data-type=Esp_pam_lc_statusType
      rolling_counter_0x223: implementation-data-type=Int32
      esp_vlc_active: implementation-data-type=Esp_vlc_activeType
      esp_vlc_available: implementation-data-type=Esp_vlc_availableType
      esp_vlcapa_available: implementation-data-type=Esp_vlcapa_availableType
      esp_vlcengtorqreqact: implementation-data-type=Esp_vlcengtorqreqactType
      checksum_0x223: implementation-data-type=Int32
      esp_vlcengtorqreq: implementation-data-type=Int32
  impl type Esp_vlc_activeType: compu {0=ESP_VLC_ACTIVE_NOT_ACTIVE, 1=ESP_VLC_ACTIVE_ACTIVE}, implementation-data-type=UInt32
  impl type Esp_vlc_apactiveType: compu {0=ESP_VLC_APACTIVE_NOT_ACTIVE, 1=ESP_VLC_APACTIVE_ACTIVE}, implementation-data-type=UInt32
  impl type Esp_vlc_availableType: compu {0=ESP_VLC_AVAILABLE_NOT_AVAILABLE, 1=ESP_VLC_AVAILABLE_AVAILABLE}, implementation-data-type=UInt32
  impl type Esp_vlcapa_availableType: compu-method=Esp_apa_gearboxenableTypeEnum, implementation-data-type=UInt32
  compu method Esp_vlcapa_availableTypeEnum: 0=ABS_ABSCTRLACTV_NOT_ACTIVE, 1=ABS_ABSCTRLACTV_ACTIVE
  impl type Esp_vlcengtorqreqactType: compu {0=ESP_VLCENGTORQREQACT_VALID, 1=ESP_VLCENGTORQREQACT_INVALID}, implementation-data-type=UInt32
  impl type Esp_vlcerrorType: compu {0=ESP_VLCERROR_NOT_ERROR, 1=ESP_VLCERROR_ERROR}, implementation-data-type=UInt32
  impl type Esp_vxwwheelflvalidType: compu {0=ESP_VXWWHEELRLVALID_VALID, 1=ESP_VXWWHEELRLVALID_INVALID}, implementation-data-type=UInt32
  compu method Esp_vxwwheelflvalidTypeEnum: 0=ESP_VXWWHEELFLVALID_VALID, 1=ESP_VXWWHEELFLVALID_INVALID
  impl type Esp_vxwwheelfrvalidType: compu {0=ESP_VXWWHEELFRVALID_VALID, 1=ESP_VXWWHEELFRVALID_INVALID}, implementation-data-type=UInt32
  impl type Esp_vxwwheelrlvalidType: compu {0=ESP_VXWWHEELRLVALID_VALID, 1=ESP_VXWWHEELRLVALID_INVALID}, implementation-data-type=UInt32
  impl type Esp_vxwwheelrrvalidType: compu {0=ESP_VXWWHEELRRVALID_VALID, 1=ESP_VXWWHEELRRVALID_INVALID}, implementation-data-type=UInt32
  impl type Esp_wheelpulse_fl_validType: compu {0=ESP_WHEELPULSE_FL_VALID_VALID, 1=ESP_WHEELPULSE_FL_VALID_INVALID}, implementation-data-type=UInt32
  impl type Esp_wheelpulse_fr_validType: compu {0=ESP_WHEELPULSE_FR_VALID_VALID, 1=ESP_WHEELPULSE_FR_VALID_INVALID}, implementation-data-type=UInt32
  impl type Esp_wheelpulse_rl_validType: compu {0=ESP_WHEELPULSE_RL_VALID_VALID, 1=ESP_WHEELPULSE_RL_VALID_INVALID}, implementation-data-type=UInt32
  impl type Esp_wheelpulse_rr_validType: compu {0=ESP_WHEELPULSE_RR_VALID_VALID, 1=ESP_WHEELPULSE_RR_VALID_INVALID}, implementation-data-type=UInt32
  impl type Esp_wheelrpmflvalidType: compu {0=ESP_WHEELRPMFLVALID_VALID, 1=ESP_WHEELRPMFLVALID_INVALID}, implementation-data-type=UInt32
  impl type Esp_wheelrpmfrvalidType: compu {0=ESP_WHEELRPMFRVALID_VALID, 1=ESP_WHEELRPMFRVALID_INVALID}, implementation-data-type=UInt32
  impl type Esp_whlmilgrearlestatusType: compu {0=ESP_WHLMILGREARLESTATUS_VALID, 1=ESP_WHLMILGREARLESTATUS_INVALID}, implementation-data-type=UInt32
  impl type Esp_whlmilgrearristatusType: compu {0=ESP_WHLMILGREARRISTATUS_VALID, 1=ESP_WHLMILGREARRISTATUS_INVALID}, implementation-data-type=UInt32
  impl type Esp_whlpulse_0x236_236: category=STRUCTURE
    10 x element, all with category=TYPE_REFERENCE:
      esp_wheelpulse_fr: implementation-data-type=Int32
      esp_wheelpulse_rl: implementation-data-type=Int32
      esp_wheelpulse_rr: implementation-data-type=Int32
      rollingcounter_esp_0x236: implementation-data-type=Int32
      esp_wheelpulse_rr_valid: implementation-data-type=Esp_wheelpulse_rr_validType
      esp_wheelpulse_rl_valid: implementation-data-type=Esp_wheelpulse_rl_validType
      esp_wheelpulse_fr_valid: implementation-data-type=Esp_wheelpulse_fr_validType
      esp_wheelpulse_fl_valid: implementation-data-type=Esp_wheelpulse_fl_validType
      checksum_esp_0x236: implementation-data-type=Int32
      esp_wheelpulse_fl: implementation-data-type=Int32
  impl type Esp_yawratestatusType: compu {0=ESP_YAWRATESTATUS_OK, 1=ESP_YAWRATESTATUS_FAULT}, implementation-data-type=UInt32
  impl type Fcw_latentwarningType: compu {0=FCW_LATENTWARNING_NO_WARNING, 1=FCW_LATENTWARNING_WARNING}, implementation-data-type=UInt32
  impl type Fcw_prewarningType: compu {0=FCW_PREWARNING_NO_WARNING, 1=FCW_PREWARNING_WARNING}, implementation-data-type=UInt32
  impl type Fcw_stateType: compu {0=FCW_STATE_UNAVAILABLE, 1=FCW_STATE_OFF, 2=FCW_STATE_STANDBY, 3=FCW_STATE_ACTIVE_NO_INTERVENTION, 4=FCW_STATE_ACTIVE, 5=FCW_STATE_RESERVED}, implementation-data-type=UInt32
  18 x impl type:
    Gw_bcm_door_0x310_310: category=STRUCTURE
      22 x element, all with category=TYPE_REFERENCE:
        bcm_doorstsrearri: implementation-data-type=Bcm_doorstsrearriType
        bcm_doorlockstsrearle: implementation-data-type=Bcm_doorlockstsrearleType
        bcm_doorlockstsfrntri: implementation-data-type=Bcm_doorlockstsfrntriType
        bcm_doorlockstsfrntle: implementation-data-type=Bcm_doorlockstsfrntleType
        bcm_antitheftsts: implementation-data-type=Bcm_antitheftstsType
        bcm_loadsensitivity: implementation-data-type=Bcm_loadsensitivityType
        bcm_lockunlockfeedback: implementation-data-type=Bcm_lockunlockfeedbackType
        bcm_doorlockststrunk: implementation-data-type=Bcm_doorlockststrunkType
        bcm_doorststrunk: implementation-data-type=Bcm_doorststrunkType
        bcm_trunkdoorpreunlocksts: implementation-data-type=Bcm_trunkdoorpreunlockstsType
        bcm_doorstsrearle: implementation-data-type=Bcm_doorstsrearleType
        bcm_frontwipersts: implementation-data-type=Bcm_frontwiperstsType
        bcm_enginehoodsts: implementation-data-type=Bcm_enginehoodstsType
        bcm_plg_driversw: implementation-data-type=Bcm_plg_driverswType
        bcm_windowscmd: implementation-data-type=Bcm_windowscmdType
        bcm_rearwipersts: implementation-data-type=Bcm_rearwiperstsType
        bcm_doorstsfrntri: implementation-data-type=Bcm_doorstsfrntriType
        bcm_rolling_counter_0x310: implementation-data-type=Int32
        bcm_turnindicatorsts: implementation-data-type=Bcm_turnindicatorstsType
        bcm_checksum_0x310: implementation-data-type=Int32, sw-impl-policy=CONST
        bcm_doorstsfrntle: implementation-data-type=Bcm_doorstsfrntleType, sw-impl-policy=CONST
        bcm_doorlockstsrearri: implementation-data-type=Bcm_doorlockstsrearriType
    Gw_body_0x321_321: category=STRUCTURE
      14 x element, all with category=TYPE_REFERENCE:
        bcm_outsidetempdig: implementation-data-type=Bcm_outsidetempdigType
        bcm_outsidetemp: implementation-data-type=Double
        bcm_driving_mode_req_bcm: implementation-data-type=Bcm_driving_mode_req_bcmType
        bcm_powermode: implementation-data-type=Bcm_powermodeType
        bcm_frntfoglmpsts: implementation-data-type=Bcm_frntfoglmpstsType
        bcm_lowbeamsts: implementation-data-type=Bcm_lowbeamstsType
        bcm_highbeamsts: implementation-data-type=Bcm_highbeamstsType
        bcm_ss_enablests: implementation-data-type=Bcm_ss_enablestsType
        bcm_reardef_status: implementation-data-type=Bcm_reardef_statusType
        bcm_brakefluidsts: implementation-data-type=Bcm_brakefluidstsType
        bcm_autolampsts: implementation-data-type=Bcm_autolampstsType
        bcm_poslmpsts: implementation-data-type=Bcm_poslmpstsType
        bcm_bgllumlvlsetting: implementation-data-type=Bcm_bgllumlvlsettingType
        bcm_reverse_gear: implementation-data-type=Bcm_reverse_gearType
    Gw_ems_engstatus_0x142_142: category=STRUCTURE
      10 x element, all with category=TYPE_REFERENCE:
        ems_ignitiontiming: implementation-data-type=Int32
        ems_setlengidlespeed: implementation-data-type=Double
        ems_engoperationstatus: implementation-data-type=Ems_engoperationstatusType
        ems_aircompressorstatus: implementation-data-type=Ems_aircompressorstatusType
        ems_throttleplatepositionerror: implementation-data-type=Ems_throttleplatepositionerrorType
        ems_startstopmessage: implementation-data-type=Ems_startstopmessageType
        dcm_ems_rollingcounter_0x142: implementation-data-type=Int32
        ems_ignswtsts: implementation-data-type=Ems_ignswtstsType
        dcm_ems_checksum_0x142: implementation-data-type=Int32
        ems_engthrottleposition: implementation-data-type=Double
    Gw_ems_sts_0x151_151: category=STRUCTURE
      10 x element, all with category=TYPE_REFERENCE:
        ems_engbarometricpressure: implementation-data-type=Int32
        ms_vacuumpressure: implementation-data-type=Double
        ems_targcruisespeed: implementation-data-type=Double
        ems_atsdrivingmodestatus: implementation-data-type=Ems_atsdrivingmodestatusType
        ems_enginestopstartstatus: implementation-data-type=Ems_enginestopstartstatusType
        dcm_ems_rollingcounter_0x151: implementation-data-type=Int32
        ems_cruisecontrolstatus: implementation-data-type=Ems_cruisecontrolstatusType
        ems_drivingmodechange_fault_flag: implementation-data-type=Ems_drivingmodechange_fault_flagType
        dcm_ems_checksum_0x151: implementation-data-type=Int32
        ems_engofftime: implementation-data-type=Int32
    Gw_ems_tq_0x101_101: category=STRUCTURE
      7 x element, all with category=TYPE_REFERENCE:
        ems_indicatedrealengtorq: implementation-data-type=Double
        ems_engspeed: implementation-data-type=Double
        ems_engspeederror: implementation-data-type=Ems_engspeederrorType
        ems_rngmodtorqcrsleadmin: implementation-data-type=Double
        dcm_ems_rollingcounter_0x101: implementation-data-type=Int32
        ems_rngmodtorqcrsleadmax: implementation-data-type=Double
        dcm_ems_checksum_0x101: implementation-data-type=Int32
    Gw_ems_tqwhl_0x111_111: category=STRUCTURE
      17 x element, all with category=TYPE_REFERENCE:
        tcu_displaygear: implementation-data-type=Tcu_displaygearType
        tcu_gearselectorreq: implementation-data-type=Tcu_gearselectorreqType
        tcu_transpmotoparkreqinvalid: implementation-data-type=Tcu_transpmotoparkreqinvalidType
        tcu_gearshiftinprogress: implementation-data-type=Tcu_gearshiftinprogressType
        tcu_shiftleverpos_sbwm: implementation-data-type=Tcu_shiftleverpos_sbwmType
        tcu_targetgearreq: implementation-data-type=Tcu_targetgearreqType
        tcu_available: implementation-data-type=Tcu_availableType
        tcu_driverintervention: implementation-data-type=Tcu_driverinterventionType
        tcu_trsmfaultflag: implementation-data-type=Tcu_trsmfaultflagType
        tcu_stgearmode: implementation-data-type=Tcu_stgearmodeType
        tcu_driving_mode_req: implementation-data-type=Tcu_driving_mode_reqType
        tcu_shiftlevertopreqinvalid: implementation-data-type=Tcu_shiftlevertopreqinvalidType
        tcu_status_alivecounter0x123: implementation-data-type=Int32
        tcu_transpmotorparkreq: implementation-data-type=Tcu_transpmotorparkreqType
        tcu_shiftlevertopreq: implementation-data-type=Tcu_shiftlevertopreqType
        tcu_status_checksum0x123: implementation-data-type=Int32
        tcu_currentgearposition: implementation-data-type=Tcu_currentgearpositionType
    Gw_ems_whltq_0x107_107: category=STRUCTURE
      9 x element, all with category=TYPE_REFERENCE:
        minindicatedtorqwhl: implementation-data-type=Int32
        ems_accrawpedalratio: implementation-data-type=Double
        ems_accpedalratio: implementation-data-type=Double
        dcm_ems_rollingcounter_0x107: implementation-data-type=Int32
        dcm_ems_checksum_0x107: implementation-data-type=Abs_absflgfltType
        ems_brkpedalstasus: implementation-data-type=Ems_brkpedalstasusType
        ems_accpedalratioerror: implementation-data-type=Ems_accpedalratioerrorType
        maxindicatedtorqwhl: implementation-data-type=Int32
        ems_kickdown: implementation-data-type=Ems_kickdownType
    Gw_ic_0x510_510: category=STRUCTURE
      8 x element, all with category=TYPE_REFERENCE:
        ic_airbagtelltalebehavior: implementation-data-type=Ic_airbagtelltalebehaviorType
        ic_vehbrkpump_err_ic: implementation-data-type=Double
        ic_disfail: implementation-data-type=Ic_disfailType
        ic_qdashaccfail: implementation-data-type=Ic_qdashaccfailType
        ic_vehspd_hmi: implementation-data-type=Int32
        ic_rolling_counter_0x510: implementation-data-type=Int32
        ic_checksum_0x510: implementation-data-type=Int32
        ic_odometermastervalue: implementation-data-type=Double
    Gw_ic_time_0x581_581: category=STRUCTURE
      6 x element, all with category=TYPE_REFERENCE:
        ic_month: implementation-data-type=Ic_monthType
        ic_date: implementation-data-type=Ic_dateType
        ic_hour: implementation-data-type=Ic_hourType
        ic_minute: implementation-data-type=Ic_minuteType
        ic_second: implementation-data-type=Ic_secondType
        ic_year: implementation-data-type=Ic_yearType
    Gw_mp5_0x530_530: category=STRUCTURE
      25 x element, all with category=TYPE_REFERENCE:
        mp5_fcw_sensitive: implementation-data-type=Mp5_fcw_sensitiveType
        mp5_icmenushift_button: implementation-data-type=Mp5_icmenushift_buttonType
        mp5_aeb_on_off: implementation-data-type=Mp5_aeb_on_offType
        mp5_fcw_on_off: implementation-data-type=Mp5_fcw_on_offType
        mp5_bsdswitchsts: implementation-data-type=Mp5_bsdswitchstsType
        mp5_afs_swtichsts: implementation-data-type=Mp5_afs_swtichstsType
        mp5_laneassittypereq: implementation-data-type=Mp5_laneassittypereqType
        mp5_icmenuactive_button: implementation-data-type=Mp5_icmenuactive_buttonType
        mp5_alarmstatus: implementation-data-type=Mp5_alarmstatusType
        mp5_alarmornot: implementation-data-type=Mp5_alarmornotType
        mp5_paakreset_req: implementation-data-type=Mp5_paakreset_reqType
        mp5_cta_active: implementation-data-type=Mp5_cta_activeType
        mp5_bsdlca_active: implementation-data-type=Mp5_bsdlca_activeType
        mp5_tsrmenureq: implementation-data-type=Mp5_tsrmenureqType
        mp5_ldwwarning: implementation-data-type=Mp5_ldwwarningType
        mp5_ldwsensitvity: implementation-data-type=Mp5_ldwsensitvityType
        mp5_avm_angle: implementation-data-type=Mp5_avm_angleType
        mp5_avm_rotationchange: implementation-data-type=Int32
        mp5_ihcmenureq: implementation-data-type=Mp5_ihcmenureqType
        mp5_doa_active: implementation-data-type=Mp5_doa_activeType
        mp5_apa_available_sts: implementation-data-type=Mp5_apa_available_stsType
        mp5_tpmsautolocationsetting: implementation-data-type=Mp5_tpmsautolocationsettingType
        mp5_avm_rotationdirection: implementation-data-type=Mp5_avm_rotationdirectionType
        mp5_avm_button: implementation-data-type=Mp5_avm_buttonType
        mp5_view_choice: implementation-data-type=Mp5_view_choiceType
    Gw_mp5_nav_0x533_533: category=STRUCTURE
      9 x element, all with category=TYPE_REFERENCE:
        nav_speedlimitunits: implementation-data-type=Nav_speedlimitunitsType
        nav_currroadtype: implementation-data-type=Nav_currroadtypeType
        nav_speedlimit: implementation-data-type=Nav_speedlimitType
        mp5_apaactive_cmd: implementation-data-type=Mp5_apaactive_cmdType
        mp5_apa_confirmbutton: implementation-data-type=Mp5_apa_confirmbuttonType
        mp5_apa_function_select: implementation-data-type=Mp5_apa_function_selectType
        nav_sts: implementation-data-type=Nav_stsType
        nav_countrycode: implementation-data-type=Int32
        nav_speedlimitstatus: implementation-data-type=Nav_speedlimitstatusType
    Gw_nm_0x460_460: category=STRUCTURE
      6 x element, all with category=TYPE_REFERENCE:
        gwnmlimphome: implementation-data-type=GwnmlimphomeType
        gwnmsleepind: implementation-data-type=GwnmsleepindType
        gwnmsleepack: implementation-data-type=GwnmsleepackType
        gwnmdestaddr: implementation-data-type=Int32
        gwnmalive: implementation-data-type=GwnmaliveType
        gwnmring: implementation-data-type=GwnmringType
    Gw_swm_body_0x31a_31a: category=STRUCTURE
      28 x element, all with category=TYPE_REFERENCE:
        swm_highbeam: implementation-data-type=Swm_highbeamType
        swm_frontwipingmode: implementation-data-type=Swm_frontwipingmodeType
        swm_wipinginterval_sensitvity: implementation-data-type=Swm_wipinginterval_sensitvityType
        swm_rearfoglight: implementation-data-type=Swm_rearfoglightType
        swm_frontfoglight: implementation-data-type=Swm_frontfoglightType
        swm_washerlimphomests: implementation-data-type=Swm_washerlimphomestsType
        swm_rearwipingmode: implementation-data-type=Swm_rearwipingmodeType
        swm_turnindicationact: implementation-data-type=Swm_turnindicationactType
        swm_vol_plus: implementation-data-type=Swm_vol_plusType
        swm_vol_minus: implementation-data-type=Swm_vol_minusType
        swm_wechat: implementation-data-type=Swm_wechatType
        swm_lamplimphomests: implementation-data-type=Swm_lamplimphomestsType
        swm_headlamp: implementation-data-type=Swm_headlampType
        swm_next_song: implementation-data-type=Swm_next_songType
        swm_previous_song: implementation-data-type=Swm_previous_songType
        swm_phone: implementation-data-type=Swm_phoneType
        swm_mute: implementation-data-type=Swm_muteType
        swm_menu_right: implementation-data-type=Swm_menu_rightType
        swm_menu_left: implementation-data-type=Swm_menu_leftType
        swm_menu_down: implementation-data-type=Swm_menu_downType
        swm_menu_up: implementation-data-type=Swm_menu_upType
        swm_fwashersts: implementation-data-type=Swm_fwasherstsType
        rolling_counter_0x31a: implementation-data-type=Int32
        swm_menu_return: implementation-data-type=Swm_menu_returnType
        swm_menu_confirm: implementation-data-type=Swm_menu_confirmType
        checksum_0x31a: implementation-data-type=Int32
        swm_rwashersts: implementation-data-type=Swm_rwasherstsType
        swm_flashlightsts: implementation-data-type=Swm_flashlightstsType
    Gw_swm_mrr_0x31b_31b: category=STRUCTURE
      16 x element, all with category=TYPE_REFERENCE:
        swm_acctaugapsetplus: implementation-data-type=Swm_acctaugapsetplusType
        swm_accvsetminus: implementation-data-type=Swm_accvsetminusType
        swm_shiftpadrequp: implementation-data-type=Swm_shiftpadrequpType
        swm_acclimphomests: implementation-data-type=Swm_acclimphomestsType
        swm_laneassistswitch: implementation-data-type=Swm_laneassistswitchType
        swm_acctaugapsetminus: implementation-data-type=Swm_acctaugapsetminusType
        swm_accvsetplus: implementation-data-type=Swm_accvsetplusType
        swm_shiftpadflt: implementation-data-type=Swm_shiftpadfltType
        swm_accdeactivate: implementation-data-type=Swm_accdeactivateType
        swm_accresume: implementation-data-type=Swm_accresumeType
        rolling_counter_0x31b: implementation-data-type=Int32
        swm_accenableswitch: implementation-data-type=Swm_accenableswitchType
        checksum_0x31b: implementation-data-type=Int32
        swm_accresume_qt: implementation-data-type=Swm_accresume_qtType
        swm_tjaswitch: implementation-data-type=Swm_tjaswitchType
        swm_shiftpadreqdown: implementation-data-type=Swm_shiftpadreqdownType
    Gw_tbox_location_0x580_580: category=STRUCTURE
      4 x element, all with category=TYPE_REFERENCE:
        tbox_longitude: implementation-data-type=Double
        tbox_latidude: implementation-data-type=Double
        tbox_gps_ub: implementation-data-type=Tbox_gps_ubType
        tbox_locationsts: implementation-data-type=Tbox_locationstsType
    Gw_tcu_gearinfo_0x123_123: category=STRUCTURE
      17 x element, all with category=TYPE_REFERENCE:
        tcu_displaygear: implementation-data-type=Tcu_displaygearType
        tcu_gearselectorreq: implementation-data-type=Tcu_gearselectorreqType
        tcu_transpmotoparkreqinvalid: implementation-data-type=Tcu_transpmotoparkreqinvalidType
        tcu_gearshiftinprogress: implementation-data-type=Tcu_gearshiftinprogressType
        tcu_shiftleverpos_sbwm: implementation-data-type=Tcu_shiftleverpos_sbwmType
        tcu_targetgearreq: implementation-data-type=Tcu_targetgearreqType
        tcu_available: implementation-data-type=Tcu_availableType
        tcu_driverintervention: implementation-data-type=Tcu_driverinterventionType
        tcu_trsmfaultflag: implementation-data-type=Tcu_trsmfaultflagType
        tcu_stgearmode: implementation-data-type=Tcu_stgearmodeType
        tcu_driving_mode_req: implementation-data-type=Tcu_driving_mode_reqType
        tcu_epblockreq: implementation-data-type=Tcu_epblockreqType
        tcu_highresistance: implementation-data-type=Tcu_highresistanceType
        tcu_drivingmodechange_fault_flag: implementation-data-type=Tcu_drivingmodechange_fault_flagType
        tcu_shiftlevertopreqinvalid: implementation-data-type=Tcu_shiftlevertopreqinvalidType
        tcu_status_alivecounter0x123: implementation-data-type=Int32
        tcu_currentgearposition: implementation-data-type=Tcu_currentgearpositionType
    Gw_tpms_tire_0x361_361: category=STRUCTURE
      15 x element, all with category=TYPE_REFERENCE:
        tpms_rf_pressure: implementation-data-type=Double
        tpms_rr_pressure: implementation-data-type=Double
        tpms_lr_pressure: implementation-data-type=Double
        tpms_tire_temperature: implementation-data-type=Int32
        tpms_lf_pressure_warning: implementation-data-type=Tpms_lf_pressure_warningType
        tpms_rf_pressure_warning: implementation-data-type=Tpms_rf_pressure_warningType
        tpms_system_status: implementation-data-type=Tpms_system_statusType
        tpms_rr_pressure_warning: implementation-data-type=Tpms_rr_pressure_warningType
        tpms_lr_pressure_warning: implementation-data-type=Tpms_lr_pressure_warningType
        tpms_temperature_warning: implementation-data-type=Tpms_temperature_warningType
        tpms_resrved: implementation-data-type=Tpms_resrvedType
        tire_position: implementation-data-type=Tire_positionType
        tpms_lamp_status: implementation-data-type=Tpms_lamp_statusType
        tpms_al_state: implementation-data-type=Tpms_al_stateType
        tpms_lf_pressure: implementation-data-type=Double
    GwnmaliveType: compu {0=GWNMALIVE_NOT_ACTIVE, 1=GWNMALIVE_ACTIVE}, implementation-data-type=UInt32
  impl type GwnmlimphomeType: compu {0=GWNMLIMPHOME_NOT_ACTIVE, 1=GWNMLIMPHOME_ACTIVE}, implementation-data-type=UInt32
  impl type GwnmringType: compu {0=GWNMRING_NOT_ACTIVE, 1=GWNMRING_ACTIVE}, implementation-data-type=UInt32
  impl type GwnmsleepackType: compu {0=GWNMSLEEPACK_NOT_ACTIVE, 1=GWNMSLEEPACK_ACTIVE}, implementation-data-type=UInt32
  impl type GwnmsleepindType: compu {0=GWNMSLEEPIND_NOT_ACTIVE, 1=GWNMSLEEPIND_ACTIVE}, implementation-data-type=UInt32
  impl type INS_GpsFlag: compu {0=NONE, 1=FIXEDPOS, 2=FIXEDHEIGHT, 8=DOPPLER_VELOCITY, 16=SINGLE, 17=PSRDIFF, 18..0=SBAS, 32=L1_FLOAT, 33=IONOFREE_FLOAT, 33=IONOFREE_FLOAT, 34=NARROW_FLOAT, 48=L1_INT, 49=WIDE_INT, 50=NARROW_INT}, implementation-data-type=UInt32
  impl type Ic_airbagtelltalebehaviorType: compu {0=IC_AIRBAGTELLTALEBEHAVIOR_NO_FAILURE_IN_LAMP_AND_LAMP_IS_OFF, 1=IC_AIRBAGTELLTALEBEHAVIOR_FAILURE_IN_LAMP, 2=IC_AIRBAGTELLTALEBEHAVIOR_NO_FAILURE_IN_THE_LAMP_LAMP_IS_ON, 3=IC_AIRBAGTELLTALEBEHAVIOR_NO_FAILURE_IN_THE_LAMP_LAMP_IS_BLINKING, 4=IC_AIRBAGTELLTALEBEHAVIOR_AIRBAGFAILSTS_SIGNAL_NOT_RECEIVED, 5=IC_AIRBAGTELLTALEBEHAVIOR_INVALID}, implementation-data-type=UInt32
  impl type Ic_dateType: compu {0..21=IC_DATE_1..IC_DATE_22, 23..30=IC_DATE_24..IC_DATE_31}, implementation-data-type=UInt32
  impl type Ic_disfailType: compu {0=IC_DISFAIL_NO_ERROR, 1=IC_DISFAIL_ERROR}, implementation-data-type=UInt32
  impl type Ic_hourType: compu {0..21=IC_DATE_1..IC_DATE_22, 23..30=IC_DATE_24..IC_DATE_31}, implementation-data-type=UInt32
  compu method Ic_hourTypeEnum: 0..23=IC_HOUR_0..IC_HOUR_23
  impl type Ic_minuteType: compu {0..21=IC_DATE_1..IC_DATE_22, 23..30=IC_DATE_24..IC_DATE_31}, implementation-data-type=UInt32
  compu method Ic_minuteTypeEnum: 0..59=IC_MINUTE_0..IC_MINUTE_59
  impl type Ic_monthType: compu {0..11=IC_MONTH_1..IC_MONTH_12}, implementation-data-type=UInt32
  impl type Ic_qdashaccfailType: compu {0=IC_QDASHACCFAIL_NO_ERROR, 1=IC_QDASHACCFAIL_REVERSIBLE_ERROR, 2=IC_QDASHACCFAIL_IRREVERSIBLE_ERROR, 3=IC_QDASHACCFAIL_NOT_DEFINED}, implementation-data-type=UInt32
  impl type Ic_secondType: compu {0..59=IC_SECOND_0..IC_SECOND_59}, implementation-data-type=UInt32
  impl type Ic_vehbrkpump_err_icType: compu {0=IC_VEHBRKPUMP_ERR_IC_NORMAL, 1=IC_VEHBRKPUMP_ERR_IC_ERROR}, implementation-data-type=UInt32
  impl type Ic_yearType: compu {2=IC_YEAR_2019, 3=IC_YEAR_2020, 4=IC_YEAR_2021}, implementation-data-type=UInt32
  impl type Ins_acc_500: category=STRUCTURE
    element acc_x: implementation-data-type=Double
    element acc_y: implementation-data-type=Double
    element acc_z: implementation-data-type=Double
  impl type Ins_car_statusType: compu {0=INS_CAR_STATUS_RECEIVEWHEELSPEED, 1=INS_CAR_STATUS_NORECEIVE}, implementation-data-type=UInt32
  7 x impl type:
    Ins_datainfo_506: category=STRUCTURE
      6 x element, all with category=TYPE_REFERENCE, implementation-data-type=Int32:
        ins_gpsflag_pos
        ins_numsv
        ins_gpsflag_heading
        ins_gps_age
        ins_car_status
        ins_status
    Ins_gyro_501: category=STRUCTURE
      element gyro_x: implementation-data-type=Double
      element gyro_y: implementation-data-type=Double
      element gyro_z: implementation-data-type=Double
    Ins_headingpitchroll_502: category=STRUCTURE
      element ins_pitchangle: implementation-data-type=Double
      element ins_rollangle: implementation-data-type=Double
      element ins_headingangle: implementation-data-type=Double
    Ins_heightandtime_503: category=STRUCTURE
      element ins_locatheight: implementation-data-type=Double
      element ins_time: implementation-data-type=Int32
    Ins_latitudelongitude_504: category=STRUCTURE
      element ins__latitude: implementation-data-type=Double
      element ins_longitude: implementation-data-type=Double
    Ins_speed_505: category=STRUCTURE
      element ins_northspd: implementation-data-type=Double
      element ins_eastspd: implementation-data-type=Double
      element ins_togroundspd: implementation-data-type=Double
    Ins_statusType: compu-method=Ins_statusTypeEnum, implementation-data-type=UInt32
  compu method Ins_statusTypeEnum: 0=INS_STATUS_NONE, 1=INS_STATUS_ATTITUDEINITIALIZATION, 2=INS_STATUS_NAVIGATION
  impl type Ins_std_507: category=STRUCTURE
    4 x element, all with category=TYPE_REFERENCE, implementation-data-type=Double:
      ins_std_lat
      ins_std_lon
      ins_std_locatheight
      inins_std_heading
  impl type Ipm_0x245_245: category=STRUCTURE
    20 x element, all with category=TYPE_REFERENCE:
      ipm_laneassit_torquereqstatus: implementation-data-type=Ipm_laneassit_torquereqstatusType
      ipm_laneassit_torquevalidity: implementation-data-type=Ipm_laneassit_torquevalidityType
      ipm_laneassit_sensitivity: implementation-data-type=Ipm_laneassit_sensitivityType
      ipm_laneassit_warningaudio: implementation-data-type=Ipm_laneassit_warningaudioType
      ipm_laneassit_leftvisualization: implementation-data-type=Ipm_laneassit_leftvisualizationType
      ipm_laneassit_rightvisualization: implementation-data-type=Ipm_laneassit_rightvisualizationType
      ipm_slaspdlimitunits: implementation-data-type=Ipm_slaspdlimitunitsType
      ipm_slastate: implementation-data-type=Ipm_slastateType
      ipm_laneassit_status: implementation-data-type=Ipm_laneassit_statusType
      ipm_slaspdlimit: implementation-data-type=Ipm_slaspdlimitType
      ipm_hma_status: implementation-data-type=Ipm_hma_statusType
      ipm_tjaica_status: implementation-data-type=Ipm_tjaica_statusType
      rolling_counter_0x245: implementation-data-type=Int32
      ipm_ldwwarningtype: implementation-data-type=Ipm_ldwwarningtypeType
      ipm_laneassit_handsonreq: implementation-data-type=Ipm_laneassit_handsonreqType
      ipm_hma_highbeamreq: implementation-data-type=Ipm_hma_highbeamreqType
      checksum_0x245: implementation-data-type=Int32
      ipm_laneassit_torquereq: implementation-data-type=Double
      ipm_laneassittype: implementation-data-type=Ipm_laneassittypeType
      ipm_laneassit_warningvibration: implementation-data-type=Ipm_laneassit_warningvibrationType
  impl type Ipm_hma_highbeamreqType: compu {0=IPM_HMA_HIGHBEAMREQ_NO_REQUEST, 1=IPM_HMA_HIGHBEAMREQ_HIGH_BEAM_REQUEST}, implementation-data-type=UInt32
  impl type Ipm_hma_statusType: compu {0=IPM_HMA_STATUS_OFF, 1=IPM_HMA_STATUS_PASSIVE, 2=IPM_HMA_STATUS_STANDBY, 3=IPM_HMA_STATUS_ACTIVE, 4=IPM_HMA_STATUS_FAULT, 5=IPM_HMA_STATUS_CAMERA_BLOCKED, 6=IPM_HMA_STATUS_RESERVED}, implementation-data-type=UInt32
  impl type Ipm_laneassit_handsonreqType: compu {0=IPM_LANEASSIT_HANDSONREQ_INACTIVE, 1=IPM_LANEASSIT_HANDSONREQ_ACTIVE}, implementation-data-type=Int32
  impl type Ipm_laneassit_leftvisualizationType: compu {0=IPM_LANEASSIT_LEFTVISUALIZATION_NO_DISPLAY, 1=IPM_LANEASSIT_LEFTVISUALIZATION_LINE_TRACKING, 2=IPM_LANEASSIT_LEFTVISUALIZATION_INTERVENTION, 3=IPM_LANEASSIT_LEFTVISUALIZATION_WARNING}, implementation-data-type=UInt32
  impl type Ipm_laneassit_rightvisualizationType: compu {0=IPM_LANEASSIT_RIGHTVISUALIZATION_NO_DISPLAY, 1=IPM_LANEASSIT_RIGHTVISUALIZATION_LINE_TRACKING, 2=IPM_LANEASSIT_RIGHTVISUALIZATION_INTERVENTION, 3=IPM_LANEASSIT_RIGHTVISUALIZATION_WARNING}, implementation-data-type=UInt32
  impl type Ipm_laneassit_sensitivityType: compu {0=IPM_LANEASSIT_SENSITIVITY_HIGHSENSITIVITY, 1=IPM_LANEASSIT_SENSITIVITY_LOWSENSITIVITY}, implementation-data-type=UInt32
  impl type Ipm_laneassit_statusType: compu {0=IPM_LANEASSIT_STATUS_OFF, 1=IPM_LANEASSIT_STATUS_STANDBY, 2=IPM_LANEASSIT_STATUS_LDW_ACTIVE_LKA_STANDBY, 3=IPM_LANEASSIT_STATUS_LDW_STANDBY_LKA_ACTIVE, 4=IPM_LANEASSIT_STATUS_ACTIVE, 5=IPM_LANEASSIT_STATUS_FAULT, 6=IPM_LANEASSIT_STATUS_CAMERA_BLOCKED, 7=IPM_LANEASSIT_STATUS_CAMERA_UNCALIBRATED}, implementation-data-type=Int32
  impl type Ipm_laneassit_torquereqstatusType: compu {0=IPM_LANEASSIT_TORQUEREQSTATUS_NO_REQUEST, 1=IPM_LANEASSIT_TORQUEREQSTATUS_TORQUE_REQUEST, 2=IPM_LANEASSIT_TORQUEREQSTATUS_RESERVED}, implementation-data-type=UInt32
  impl type Ipm_laneassit_torquevalidityType: compu {0=IPM_LANEASSIT_TORQUEVALIDITY_VALID, 1=IPM_LANEASSIT_TORQUEVALIDITY_INVALID}, implementation-data-type=UInt32
  impl type Ipm_laneassit_warningaudioType: compu {0=IPM_LANEASSIT_WARNINGAUDIO_INACTIVE, 1=IPM_LANEASSIT_WARNINGAUDIO_ACTIVE}, implementation-data-type=Int32
  impl type Ipm_laneassit_warningvibrationType: compu {0=IPM_LANEASSIT_WARNINGVIBRATION_INACTIVE, 1=IPM_LANEASSIT_WARNINGVIBRATION_ACTIVE}, implementation-data-type=Int32
  impl type Ipm_laneassittypeType: compu {0=IPM_LANEASSITTYPE_UNAVAILABLE, 1=IPM_LANEASSITTYPE_LDW, 2=IPM_LANEASSITTYPE_LKA, 3=IPM_LANEASSITTYPE_LDW_LKA, 4=IPM_LANEASSITTYPE_TJA_ICA, 5=IPM_LANEASSITTYPE_TJA_ICA_LDW, 6=IPM_LANEASSITTYPE_RESERVED}, implementation-data-type=Int32
  impl type Ipm_ldwwarningtypeType: compu {0=IPM_LDWWARNINGTYPE_AUDIBLE_WARNING_AND_WHEELSTEER_SHAKE, 1=IPM_LDWWARNINGTYPE_AUDIBLE_WARNING, 2=IPM_LDWWARNINGTYPE_WHEELSTEER_SHAKE, 3=IPM_LDWWARNINGTYPE_RESERVED}, implementation-data-type=Int32
  impl type Ipm_leftline_0x278_278: category=STRUCTURE
    5 x element, all with category=TYPE_REFERENCE, implementation-data-type=Double:
      ipm_leftline_dy
      ipm_leftline_dx_lookhead
      ipm_leftline_hor_curve
      ipm_leftline_yawangle
      ipm_ledtline_dx_start
  impl type Ipm_rightline_0x490_490: category=STRUCTURE
    5 x element, all with category=TYPE_REFERENCE:
      ipm_rightline_dy: implementation-data-type=Double
      ipm_rightline_dx_lookhead: implementation-data-type=Double
      ipm_rightline_hor_curve: implementation-data-type=Int32
      ipm_rightline_yawangle: implementation-data-type=Double
      ipm_rightline_dx_start: implementation-data-type=Double
  impl type Ipm_slaspdlimitType: compu {0=IPM_SLASPDLIMIT_NO_DISPLAY, 1=IPM_SLASPDLIMIT_SPL_CANCELLED, 2=IPM_SLASPDLIMIT_SPL_5, 3=IPM_SLASPDLIMIT_SPL_10, 4=IPM_SLASPDLIMIT_SPL_15, 5=IPM_SLASPDLIMIT_SPL_20, 6=IPM_SLASPDLIMIT_SPL_25, 7=IPM_SLASPDLIMIT_SPL_30, 8=IPM_SLASPDLIMIT_SPL_35, 10=IPM_SLASPDLIMIT_SPL_45, 11=IPM_SLASPDLIMIT_SPL_50, 12=IPM_SLASPDLIMIT_SPL_55, 13=IPM_SLASPDLIMIT_SPL_60, 14=IPM_SLASPDLIMIT_SPL_65, 15=IPM_SLASPDLIMIT_SPL_70, 16=IPM_SLASPDLIMIT_SPL_75, 17=IPM_SLASPDLIMIT_SPL_80, 18=IPM_SLASPDLIMIT_SPL_85, 19=IPM_SLASPDLIMIT_SPL_90, 20=IPM_SLASPDLIMIT_SPL_95, 21=IPM_SLASPDLIMIT_SPL_100, 22=IPM_SLASPDLIMIT_SPL_105, 23=IPM_SLASPDLIMIT_SPL_110, 24=IPM_SLASPDLIMIT_SPL_115, 25=IPM_SLASPDLIMIT_SPL_120, 26=IPM_SLASPDIPM_SLASPDLIMIT_SPL_125LIMIT_SPL_100, 27=IPM_SLASPDLIMIT_SPL_130}, implementation-data-type=UInt32
  impl type Ipm_slaspdlimitunitsType: compu {0=IPM_SLASPDLIMITUNITS_UNKNOWN, 1=IPM_SLASPDLIMITUNITS_KMH, 2=IPM_SLASPDLIMITUNITS_MPH, 3=IPM_SLASPDLIMITUNITS_RESERVED}, implementation-data-type=UInt32
  impl type Ipm_slastateType: compu {0=IPM_SLASTATE_OFF, 1=IPM_SLASTATE_FUSION_MODE, 2=IPM_SLASTATE_VISION_MODE, 3=IPM_SLASTATE_NAVIGATION_ONLY_MODE, 4=IPM_SLASTATE_DEFECT}, implementation-data-type=UInt32
  impl type Ipm_tjaica_statusType: compu {0=IPM_TJAICA_STATUS_INACTIVE, 1=IPM_TJAICA_STATUS_ACTIVE}, implementation-data-type=UInt32
  impl type Mp5_aeb_on_offType: compu {0=MP5_AEB_ON_OFF_SWITCH_ON, 1=MP5_AEB_ON_OFF_SWITCH_OFF}, implementation-data-type=UInt32
  impl type Mp5_afs_swtichstsType: compu {0=MP5_AFS_SWTICHSTS_NO_PRESS, 1=MP5_AFS_SWTICHSTS_PRESS}, implementation-data-type=UInt32
  impl type Mp5_alarmornotType: compu {0=MP5_ALARMORNOT_NO_ALARM, 1=MP5_ALARMORNOT_ALARM}, implementation-data-type=UInt32
  impl type Mp5_alarmstatusType: compu {0=MP5_ALARMSTATUS_INACTIVE, 1=MP5_ALARMSTATUS_ACTIVE, 2=MP5_ALARMSTATUS_FAILED, 3=MP5_ALARMSTATUS_RESERVED}, implementation-data-type=UInt32
  impl type Mp5_apa_available_stsType: compu {0=MP5_APA_AVAILABLE_STS_INITIAL, 1=MP5_APA_AVAILABLE_STS_AVALIBLE, 2=MP5_APA_AVAILABLE_STS_NOT_AVALIBLE}, implementation-data-type=UInt32
  impl type Mp5_apa_confirmbuttonType: compu {0=MP5_APA_CONFIRMBUTTON_NO_BUTTON_PRESS, 1=MP5_APA_CONFIRMBUTTON_COMFIRM_BUTTON_PRESS, 2=MP5_APA_CONFIRMBUTTON_TERMINATED_BUTTON_PRESS, 3=MP5_APA_CONFIRMBUTTON_RESERVED}, implementation-data-type=UInt32
  impl type Mp5_apa_function_selectType: compu {0=MP5_APA_FUNCTION_SELECT_NO_BUTTON_PRESS, 1=MP5_APA_FUNCTION_SELECT_PPSC_BUTTON_PRESS, 2=MP5_APA_FUNCTION_SELECT_CPSC_BUTTON_PRESS, 3=MP5_APA_FUNCTION_SELECT_POC_BUTTON_PRESS}, implementation-data-type=UInt32
  impl type Mp5_apaactive_cmdType: compu {0=MP5_APAACTIVE_CMD_NO_REQUEST, 1=MP5_APAACTIVE_CMD_REQUEST}, implementation-data-type=UInt32
  impl type Mp5_avm_angleType: compu {0=MP5_AVM_ANGLE_CENTER_KEY, 1=MP5_AVM_ANGLE_FRONT_3D_FRONT_AVM_2D, 2=MP5_AVM_ANGLE_FRONT_RIGHT_3D, 3=MP5_AVM_ANGLE_RIGHT_3D_RIGHT_AVM_2D, 4=MP5_AVM_ANGLE_REAR_RIGHT_3D, 5=MP5_AVM_ANGLE_REAR_3D_REAR_AVM_2D, 6=MP5_AVM_ANGLE_LEFT_REAR_3D, 7=MP5_AVM_ANGLE_LEFT_3D_LEFT_AVM_2D, 8=MP5_AVM_ANGLE_LEFT_FRONT_3D, 9=MP5_AVM_ANGLE_3D_KEY, 10=MP5_AVM_ANGLE_2D_KEY, 11=MP5_AVM_ANGLE_NO_VIDEO_SIGNAL_RESERVED, 12=MP5_AVM_ANGLE_RESERVED, 15=MP5_AVM_ANGLE_INVALID}, implementation-data-type=UInt32
  impl type Mp5_avm_buttonType: compu {0=MP5_AVM_BUTTON_INIT, 1=MP5_AVM_BUTTON_START_UP, 2=MP5_AVM_BUTTON_SHUT_DOWN, 3=MP5_AVM_BUTTON_FAULTURE}, implementation-data-type=UInt32
  impl type Mp5_avm_rotationdirectionType: compu {0=MP5_AVM_ROTATIONDIRECTION_INITIAL, 1=MP5_AVM_ROTATIONDIRECTION_CLOCKWISE, 2=MP5_AVM_ROTATIONDIRECTION_ANTICLOCKWISE, 3=MP5_AVM_ROTATIONDIRECTION_RESERVED}, implementation-data-type=UInt32
  impl type Mp5_bsdlca_activeType: compu {0=MP5_BSDLCA_ACTIVE_ON, 1=MP5_BSDLCA_ACTIVE_OFF}, implementation-data-type=UInt32
  impl type Mp5_bsdswitchstsType: compu {0=MP5_BSDSWITCHSTS_ON, 1=MP5_BSDSWITCHSTS_OFF}, implementation-data-type=UInt32
  impl type Mp5_cta_activeType: compu {0=MP5_CTA_ACTIVE_ON, 1=MP5_CTA_ACTIVE_OFF}, implementation-data-type=UInt32
  impl type Mp5_doa_activeType: compu {0=MP5_DOA_ACTIVE_ON, 1=MP5_DOA_ACTIVE_OFF}, implementation-data-type=UInt32
  impl type Mp5_fcw_on_offType: compu {0=MP5_FCW_ON_OFF_SWITCH_ON, 1=MP5_FCW_ON_OFF_SWITCH_OFF}, implementation-data-type=UInt32
  impl type Mp5_fcw_sensitiveType: compu {0=MP5_FCW_SENSITIVE_UNAVAILABLE, 1=MP5_FCW_SENSITIVE_LEVEL1_LOW_SENSITIVE, 2=MP5_FCW_SENSITIVE_LEVEL2_NORMAL, 3=MP5_FCW_SENSITIVE_LEVEL3_HIGH_SENSITIVE}, implementation-data-type=UInt32
  impl type Mp5_icmenuactive_buttonType: compu {0=MP5_ICMENUACTIVE_BUTTON_OFF, 1=MP5_ICMENUACTIVE_BUTTON_MENU_SWITCH_ACTIVE, 2=MP5_ICMENUACTIVE_BUTTON_SILENCE, 3=MP5_ICMENUACTIVE_BUTTON_INVALID}, implementation-data-type=UInt32
  impl type Mp5_icmenushift_buttonType: compu {0=MP5_ICMENUSHIFT_BUTTON_NO_EVENT, 1=MP5_ICMENUSHIFT_BUTTON_PAGE_UP, 2=MP5_ICMENUSHIFT_BUTTON_PAGE_DOWN, 3=MP5_ICMENUSHIFT_BUTTON_INVALID}, implementation-data-type=UInt32
  impl type Mp5_ihcmenureqType: compu {0=MP5_IHCMENUREQ_ON, 1=MP5_IHCMENUREQ_OFF}, implementation-data-type=UInt32
  impl type Mp5_laneassittypereqType: compu {0=MP5_LANEASSITTYPEREQ_NO_SELECTION, 1=MP5_LANEASSITTYPEREQ_LDW, 2=MP5_LANEASSITTYPEREQ_LKA, 3=MP5_LANEASSITTYPEREQ_LDW_LKA}, implementation-data-type=UInt32
  impl type Mp5_ldwsensitvityType: compu {0=MP5_LDWSENSITVITY_HIGH, 1=MP5_LDWSENSITVITY_LOW, 2=MP5_LDWSENSITVITY_RESERVED}, implementation-data-type=UInt32
  impl type Mp5_ldwwarningType: compu {0=MP5_LDWWARNING_AUDIBLE_WARNING_AND_WHEELSTEER_SHAKE, 1=MP5_LDWWARNING_AUDIBLE_WARNING, 2=MP5_LDWWARNING_WHEELSTEER_SHAKE, 3=MP5_LDWWARNING_RESERVED}, implementation-data-type=UInt32
  impl type Mp5_paakreset_reqType: compu {0=MP5_PAAKRESET_REQ_NO_REQUEST, 1=MP5_PAAKRESET_REQ_REQUEST}, implementation-data-type=UInt32
  impl type Mp5_tpmsautolocationsettingType: compu-method=Ins_statusTypeEnum, implementation-data-type=UInt32
  compu method Mp5_tpmsautolocationsettingTypeEnum: 0=ABS_WHLSPDFRNTLESTATUS_VALID, 1=ABS_WHLSPDFRNTLESTATUS_INVALID
  impl type Mp5_tsrmenureqType: compu {0=MP5_TSRMENUREQ_ON, 1=MP5_TSRMENUREQ_OFF}, implementation-data-type=UInt32
  impl type Mp5_view_choiceType: compu {0=MP5_VIEW_CHOICE_AVM, 1=MP5_VIEW_CHOICE_ADAS}, implementation-data-type=UInt32
  4 x impl type:
    Mrr_0x238_238: category=STRUCTURE
      7 x element, all with category=TYPE_REFERENCE:
        acc_tgtaxlowercomftband: implementation-data-type=Double
        acc_tgtaxupperlim: implementation-data-type=Double
        acc_tgtaxlowerlim: implementation-data-type=Double
        acc_tgtax: implementation-data-type=Double
        rolling_counter_0x238: implementation-data-type=Int32
        checksum_0x238: implementation-data-type=Int32
        acc_tgtaxuppercomftband: implementation-data-type=Double
    Mrr_0x239_239: category=STRUCTURE
      7 x element, all with category=TYPE_REFERENCE:
        acc_tgtaxlowercomftband: implementation-data-type=Double
        acc_tgtaxupperlim: implementation-data-type=Double
        acc_tgtaxlowerlim: implementation-data-type=Double
        acc_tgtax: implementation-data-type=Double
        rolling_counter_0x238: implementation-data-type=Int32
        checksum_0x238: implementation-data-type=Int32
        acc_tgtaxuppercomftband: implementation-data-type=Double
    Mrr_0x246_246: category=STRUCTURE
      17 x element, all with category=TYPE_REFERENCE:
        taugapset: implementation-data-type=TaugapsetType
        dxtarobj: implementation-data-type=DxtarobjType
        acchmi_mode: implementation-data-type=Acchmi_modeType
        accfailinfo: implementation-data-type=AccfailinfoType
        takeoverreq: implementation-data-type=TakeoverreqType
        mrr_fcw_sensitive: implementation-data-type=Mrr_fcw_sensitiveType
        aeb_state: implementation-data-type=Aeb_stateType
        acc_startstop_infor: implementation-data-type=Acc_startstop_inforType
        fcw_prewarning: implementation-data-type=Fcw_prewarningType
        fcw_latentwarning: implementation-data-type=Fcw_latentwarningType
        fcw_state: implementation-data-type=Fcw_stateType
        obj_speed: implementation-data-type=Int32
        rolling_counter_0x246: implementation-data-type=Int32
        textinfo: implementation-data-type=TextinfoType
        checksum_0x246: implementation-data-type=Int32
        vsetdis: implementation-data-type=Double
        objvalid: implementation-data-type=ObjvalidType
    Mrr_f_obj_0x_classType: compu {0=MRR_F_OBJ_0X_CLASS_UNKNOWN, 1=MRR_F_OBJ_0X_CLASS_CAR, 2=MRR_F_OBJ_0X_CLASS_TRUCK, 3=MRR_F_OBJ_0X_CLASS_TWO_WHEELER}, implementation-data-type=UInt32
  impl type Mrr_fcw_sensitiveType: compu {0=MRR_FCW_SENSITIVE_UNAVAILABLE, 1=MRR_FCW_SENSITIVE_LEVEL1_LOW_SENSITIVE, 2=MRR_FCW_SENSITIVE_LEVEL2_NORMAL, 3=MRR_FCW_SENSITIVE_LEVEL3_HIGH_SENSITIVE}, implementation-data-type=UInt32
  impl type Mrr_ff_obj_0x_classType: compu {0=MRR_FF_OBJ_0X_CLASS_UNKNOWN, 1=MRR_FF_OBJ_0X_CLASS_CAR, 2=MRR_FF_OBJ_0X_CLASS_TRUCK, 3=MRR_FF_OBJ_0X_CLASS_TWO_WHEELER}, implementation-data-type=UInt32
  impl type Mrr_fftargrtdetectionType: compu {0=MRR_FFTARGRTDETECTION_NOT_DECTECTED, 1=MRR_FFTARGRTDETECTION_DECTECTED}, implementation-data-type=UInt32, sw-impl-policy=CONST
  impl type Mrr_frobj_0x279_279: category=STRUCTURE
    8 x element, all with category=TYPE_REFERENCE:
      mrr_f_object_dy: implementation-data-type=Double
      mrr_f_obj_0x_class: implementation-data-type=Mrr_f_obj_0x_classType
      mrr_ff_object_dx: implementation-data-type=Double
      mrr_ff_object_dy: implementation-data-type=Double
      mrr_ff_obj_0x_class: implementation-data-type=Mrr_ff_obj_0x_classType
      mrr_fftargrtdetection: implementation-data-type=Mrr_fftargrtdetectionType
      mrr_peddetection: implementation-data-type=Mrr_peddetectionType
      mrr_f_object_dx: implementation-data-type=Double
  impl type Mrr_frobj_0x480_480: category=STRUCTURE
    8 x element, all with category=TYPE_REFERENCE:
      mrr_l_object_dy: implementation-data-type=Double
      mrr_l_obj_0x_class: implementation-data-type=Mrr_l_obj_0x_classType
      mrr_r_object_dx: implementation-data-type=Double
      mrr_r_object_dy: implementation-data-type=Double
      mrr_r_obj_0x_class: implementation-data-type=Mrr_r_obj_0x_classType
      mrr_lefttargrtdetection: implementation-data-type=Mrr_lefttargrtdetectionType
      mrr_righttargrtdetection: implementation-data-type=Mrr_righttargrtdetectionType
      mrr_l_object_dx: implementation-data-type=Double
  impl type Mrr_l_obj_0x_classType: compu {0=MRR_L_OBJ_0X_CLASS_UNKNOWN, 1=MRR_L_OBJ_0X_CLASS_CAR, 2=MRR_L_OBJ_0X_CLASS_TRUCK, 3=MRR_L_OBJ_0X_CLASS_TWO_WHEELER}, implementation-data-type=UInt32
  impl type Mrr_lefttargrtdetectionType: compu {0=MRR_LEFTTARGRTDETECTION_NOT_DECTECTED, 1=MRR_LEFTTARGRTDETECTION_DECTECTED}, implementation-data-type=UInt32
  impl type Mrr_peddetectionType: compu {0=MRR_PEDDETECTION_NOT_DECTECTED, 1=MRR_PEDDETECTION_DECTECTED}, implementation-data-type=UInt32
  impl type Mrr_r_obj_0x_classType: compu {0=MRR_R_OBJ_0X_CLASS_UNKNOWN, 1=MRR_R_OBJ_0X_CLASS_CAR, 2=MRR_R_OBJ_0X_CLASS_TRUCK, 3=MRR_R_OBJ_0X_CLASS_TWO_WHEELER}, implementation-data-type=UInt32
  impl type Mrr_righttargrtdetectionType: compu {0=MRR_RIGHTTARGRTDETECTION_NOT_DECTECTED, 1=MRR_RIGHTTARGRTDETECTION_DECTECTED}, implementation-data-type=UInt32
  impl type Nav_currroadtypeType: compu {0=NAV_CURRROADTYPE_UNKNOW, 1=NAV_CURRROADTYPE_HIGH_SPEED_ROAD, 2=NAV_CURRROADTYPE_CITY_EXPRESS_WAY, 3=NAV_CURRROADTYPE_DOWNTOWN_ROAD, 4=NAV_CURRROADTYPE_COUNTRY_ROAD}, implementation-data-type=UInt32
  impl type Nav_speedlimitType: compu {0=NAV_SPEEDLIMIT_NO_DISPLAY, 1=NAV_SPEEDLIMIT_SPL_5, 2=NAV_SPEEDLIMIT_SPL_10, 3=NAV_SPEEDLIMIT_SPL_15, 4=NAV_SPEEDLIMIT_SPL_20, 5=NAV_SPEEDLIMIT_SPL_25, 26=NAV_SPEEDLIMIT_SPL_130}, implementation-data-type=UInt32
  impl type Nav_speedlimitstatusType: compu {0=NAV_SPEEDLIMITSTATUS_SL_UNKNOWN, 1=NAV_SPEEDLIMITSTATUS_SL_EXISTS, 2=NAV_SPEEDLIMITSTATUS_SL_NOLIMIT, 3=NAV_SPEEDLIMITSTATUS_SL_PLURAL}, implementation-data-type=UInt32
  impl type Nav_speedlimitunitsType: compu {0=NAV_SPEEDLIMITUNITS_UNKNOWN, 1=NAV_SPEEDLIMITUNITS_MPH, 2=NAV_SPEEDLIMITUNITS_KMH, 3=NAV_SPEEDLIMITUNITS_RESERVED}, implementation-data-type=UInt32
  impl type Nav_stsType: compu {0=NAV_STS_INACTIVE, 1=NAV_STS_ACTIVE}, implementation-data-type=UInt32
  impl type ObjvalidType: compu {0=OBJVALID_NO_OBJECT, 1=OBJVALID_TARGET_OBJECT_DETECTED, 2..7=ABS_WHLSPDFRNTLESTATUS_VALID}, implementation-data-type=UInt32
  4 x impl type:
    Pam_0x270_270: category=STRUCTURE
      13 x element, all with category=TYPE_REFERENCE:
        pam_esp_target_gear_request: implementation-data-type=Pam_esp_target_gear_requestType
        pam_brakefunctionmode: implementation-data-type=Pam_brakefunctionmodeType
        stopstartinhibit_apa: implementation-data-type=Stopstartinhibit_apaType
        ems_pam_apaf: implementation-data-type=Pam_apafType
        pam_cmdepssts: implementation-data-type=Pam_cmdepsstsType
        pam_sts: implementation-data-type=Pam_stsType
        pam_brakemodests: implementation-data-type=Pam_brakemodestsType
        pam_failurebrakemode: implementation-data-type=Pam_failurebrakemodeType
        pam_esp_speed_target: implementation-data-type=Float
        pam_esp_stop_distance: implementation-data-type=Int32
        rolling_counter_0x270: implementation-data-type=Int32
        checksum_0x270: implementation-data-type=Int32
        pam_trgtepsstrgwhlang: implementation-data-type=Double
    Pam_0x271_271: category=STRUCTURE
      14 x element, all with category=TYPE_REFERENCE:
        pam_infodisplayreq: implementation-data-type=Pam_infodisplayreqType
        pam_objectstsflm: implementation-data-type=Pam_objectstsflmType
        pam_objectstsflc: implementation-data-type=Pam_objectstsflcType
        pam_objectstsfrc: implementation-data-type=Pam_objectstsfrcType
        pam_objectstsfrm: implementation-data-type=Pam_objectstsfrmType
        pam_objectstsrlm: implementation-data-type=Pam_objectstsrlmType
        pam_objectstsrlc: implementation-data-type=Pam_objectstsrlcType
        pam_objectstsrrc: implementation-data-type=Pam_objectstsrrcType
        pam_objectstsrrm: implementation-data-type=Pam_objectstsrrmType
        pam_chimecmdsoundstatus: implementation-data-type=Pam_chimecmdsoundstatusType
        pam_frontsystemworksts: implementation-data-type=Pam_frontsystemworkstsType
        pam_parkingbarsts: implementation-data-type=Pam_parkingbarstsType
        pam_chimecmdsoundcadence: implementation-data-type=Pam_chimecmdsoundcadenceType
        pam_parkingbarpercent: implementation-data-type=Pam_parkingbarpercentType
    Pam_0x272_272: category=STRUCTURE
      11 x element, all with category=TYPE_REFERENCE:
        apa_parkslot_state: implementation-data-type=Apa_parkslot_stateType
        sdg_objectsts_frs: implementation-data-type=Sdg_objectsts_frsType
        sdg_objectstsrls: implementation-data-type=Sdg_objectstsrlsType
        apa_selectedside: implementation-data-type=Apa_selectedsideType
        sdg_objectstsrrs: implementation-data-type=Sod_blis_displayType
        sdg_objectstsfrs_rrs: implementation-data-type=Sdg_objectstsfrs_rrsType
        apa_quit_indication: implementation-data-type=Apa_quit_indicationType
        apa_recover_int_indication: implementation-data-type=Apa_recover_int_indicationType
        sdg_objectstsfls_rls: implementation-data-type=Sdg_objectstsfls_rlsType
        apa_indication: implementation-data-type=Apa_indicationType
        sdg_objectstsfls: implementation-data-type=Sdg_objectstsflsType
    Pam_apafType: compu {0=PAM_APAF_NORMAL, 1=PAM_APAF_APA_FAILURE}, implementation-data-type=UInt32
  impl type Pam_brakefunctionmodeType: compu {0=PAM_BRAKEFUNCTIONMODE_NO_ACTION, 1=PAM_BRAKEFUNCTIONMODE_AUTOMATICPARK}, implementation-data-type=UInt32
  impl type Pam_brakemodestsType: compu {0=PAM_BRAKEMODESTS_INIT, 1=PAM_BRAKEMODESTS_STANDBY, 2=PAM_BRAKEMODESTS_ACTIVE, 3=PAM_BRAKEMODESTS_MANEUVERFINISHED, 4=PAM_BRAKEMODESTS_SUSPEND, 5=PAM_BRAKEMODESTS_ABORT}, implementation-data-type=UInt32
  impl type Pam_chimecmdsoundcadenceType: compu {0=PAM_CHIMECMDSOUNDCADENCE_TONE_0_NO_WARNING, 1..7=PAM_CHIMECMDSOUNDCADENCE_TONE_1..PAM_CHIMECMDSOUNDCADENCE_TONE_7, 8=PAM_CHIMECMDSOUNDCADENCE_RPA_NOK, 9=PAM_CHIMECMDSOUNDCADENCE_RPA_OK, 10=PAM_CHIMECMDSOUNDCADENCE_TONE_10_PAM_FAILED_TONE, 11=PAM_CHIMECMDSOUNDCADENCE_TONE_11_PAM_WARNING_TONE, 12=PAM_CHIMECMDSOUNDCADENCE_TONE_12_PAM_SUCCESSFUL_TONE}, implementation-data-type=UInt32
  impl type Pam_chimecmdsoundstatusType: compu {0=PAM_CHIMECMDSOUNDSTATUS_NOWARNING, 1=PAM_CHIMECMDSOUNDSTATUS_FRONTSYSTEMWARNING, 2=PAM_CHIMECMDSOUNDSTATUS_REARSYSTEMWARNING, 3=PAM_CHIMECMDSOUNDSTATUS_APA}, implementation-data-type=UInt32
  impl type Pam_cmdepsstsType: compu-method=Pam_cmdepsstsTypeEnum, implementation-data-type=UInt32
  compu method Pam_cmdepsstsTypeEnum: 0=PAM_CMDEPSSTS_NO_REQUEST, 1=PAM_CMDEPSSTS_CONTROL_EPS_REQUEST, 2=PAM_CMDEPSSTS_EPS_CONTROL
  impl type Pam_esp_target_gear_requestType: compu {0=PAM_ESP_TARGET_GEAR_REQUEST_NO_REQUEST, 1=PAM_ESP_TARGET_GEAR_REQUEST_PARK, 2=PAM_ESP_TARGET_GEAR_REQUEST_REVERSE, 3=PAM_ESP_TARGET_GEAR_REQUEST_NEUTRAL, 4=PAM_ESP_TARGET_GEAR_REQUEST_DRIVE}, implementation-data-type=UInt32
  impl type Pam_failurebrakemodeType: compu {0=PAM_FAILUREBRAKEMODE_IDLE_NO_BRAKING, 1=PAM_FAILUREBRAKEMODE_COMFORTABLE_RESERVED, 2=PAM_FAILUREBRAKEMODE_EMERGENCY, 3=PAM_FAILUREBRAKEMODE_RESERVED}, implementation-data-type=UInt32
  impl type Pam_frontsystemworkstsType: compu {0=PAM_FRONTSYSTEMWORKSTS_DISABLE, 1=PAM_FRONTSYSTEMWORKSTS_ENABLE, 2=PAM_FRONTSYSTEMWORKSTS_ACTIVE, 3=PAM_FRONTSYSTEMWORKSTS_FAILED}, implementation-data-type=UInt32
  impl type Pam_infodisplayreqType: compu {0=PAM_INFODISPLAYREQ_NO_REQUEST, 1=PAM_INFODISPLAYREQ_REQ_FORWARD_AGAIN, 2=PAM_INFODISPLAYREQ_REQ_TURN_LEVER, 3=PAM_INFODISPLAYREQ_REQ_GEAR_P, 4=PAM_INFODISPLAYREQ_REQ_CONFIRM_SWITCH, 5=PAM_INFODISPLAYREQ_REQ_SEARCHINGPROCESS, 6=PAM_INFODISPLAYREQ_REQ_DRIVE_FW, 7=PAM_INFODISPLAYREQ_REQ_STOP, 8=PAM_INFODISPLAYREQ_REQ_FUNCTION_SELECT, 9=PAM_INFODISPLAYREQ_REQ_FUNCTION_OFF, 10=PAM_INFODISPLAYREQ_REQ_PROCESS_BAR, 11=PAM_INFODISPLAYREQ_PPSC_REQUEST_ONLY, 12=PAM_INFODISPLAYREQ_CPSC_REQUEST_ONLY, 13=PAM_INFODISPLAYREQ_PPSC_CPSC_REQUEST, 14=PAM_INFODISPLAYREQ_REQ_GEAR_R, 15=PAM_INFODISPLAYREQ_REQ_GEAR_D, 16=PAM_INFODISPLAYREQ_REQ_DRIVE_BW, 17=PAM_INFODISPLAYREQ_REQ_SLOW_DOWN, 18=PAM_INFODISPLAYREQ_REQ_RELEASE_BRAKE_ANDSTEERING_WHEEL, 19=PAM_INFODISPLAYREQ_REQ_CLOSE_DOOR, 20=PAM_INFODISPLAYREQ_REQ_BUCKLE_SEAT_BELT, 21=PAM_INFODISPLAYREQ_REQ_REPRESS_DEAD_MAN_SWITCH, 22=PAM_INFODISPLAYREQ_REQ_PRESS_BRAKE_PEDAL, 23=PAM_INFODISPLAYREQ_REQ_GEAR_R_AND_BRAKE, 24=PAM_INFODISPLAYREQ_REQ_FUNCTION_COMPLETE, 25=PAM_INFODISPLAYREQ_REQ_FUNCTION_NOT_AVAILABLE, 26=PAM_INFODISPLAYREQ_RESERVED}, implementation-data-type=UInt32
  impl type Pam_objectstsflcType: compu {0=PAM_OBJECTSTSFLC_NO_OBJECT, 1=PAM_OBJECTSTSFLC_OBJECT_IN_ZONE_1, 2=PAM_OBJECTSTSFLC_OBJECT_ZONE_2, 3=PAM_OBJECTSTSFLC_OBJECT_ZONE_3}, implementation-data-type=UInt32
  impl type Pam_objectstsflmType: compu {0=PAM_OBJECTSTSFLM_NO_OBJECT, 1=PAM_OBJECTSTSFLM_OBJECT_IN_ZONE_1, 2..5=PAM_OBJECTSTSFLM_OBJECT_ZONE_2..PAM_OBJECTSTSFLM_OBJECT_ZONE_5}, implementation-data-type=UInt32
  impl type Pam_objectstsfrcType: compu {0=PAM_OBJECTSTSFRC_NO_OBJECT, 1=PAM_OBJECTSTSFRC_OBJECT_IN_ZONE_1, 2=PAM_OBJECTSTSFRC_OBJECT_ZONE_2, 3=PAM_OBJECTSTSFRC_OBJECT_ZONE_3}, implementation-data-type=UInt32
  impl type Pam_objectstsfrmType: compu {0=PAM_OBJECTSTSFRM_NO_OBJECT, 1=PAM_OBJECTSTSFRM_OBJECT_IN_ZONE_1, 2..5=PAM_OBJECTSTSFRM_OBJECT_ZONE_2..PAM_OBJECTSTSFRM_OBJECT_ZONE_5}, implementation-data-type=UInt32
  impl type Pam_objectstsrlcType: compu {0=PAM_OBJECTSTSRLC_NO_OBJECT, 1=PAM_OBJECTSTSRLC_OBJECT_IN_ZONE_1, 2=PAM_OBJECTSTSRLC_OBJECT_ZONE_2, 3=PAM_OBJECTSTSRLC_OBJECT_ZONE_3}, implementation-data-type=UInt32
  impl type Pam_objectstsrlmType: compu {0=PAM_OBJECTSTSRLM_NO_OBJECT, 1=PAM_OBJECTSTSRLM_OBJECT_IN_ZONE1, 2=PAM_OBJECTSTSRLM_OBJECT_IN_ZONE1, 3..7=PAM_OBJECTSTSRLM_OBJECT_ZONE3..PAM_OBJECTSTSRLM_OBJECT_ZONE7, 8=PAM_OBJECTSTSRLM_RESERVED}, implementation-data-type=UInt32
  impl type Pam_objectstsrrcType: compu {0=PAM_OBJECTSTSRRC_NO_OBJECT, 1=PAM_OBJECTSTSRRC_OBJECT_IN_ZONE_1, 2=PAM_OBJECTSTSRRC_OBJECT_ZONE_2, 3=PAM_OBJECTSTSRRC_OBJECT_ZONE_3}, implementation-data-type=UInt32
  impl type Pam_objectstsrrmType: compu {0=PAM_OBJECTSTSRRM_NO_OBJECT, 1=PAM_OBJECTSTSRRM_OBJECT_IN_ZONE_1, 2..7=PAM_OBJECTSTSRRM_OBJECT_ZONE_2..PAM_OBJECTSTSRRM_OBJECT_ZONE_7}, implementation-data-type=UInt32
  impl type Pam_parkingbarpercentType: compu {0=PAM_PARKINGBARPERCENT_0PERCENT, 1=PAM_PARKINGBARPERCENT_1PERCENT, 2=PAM_PARKINGBARPERCENT_2PERCENT, 3=PAM_PARKINGBARPERCENT_3PERCENT, 4=PAM_PARKINGBARPERCENT_4PERCENT, 5=PAM_PARKINGBARPERCENT_5PERCENT, 6=PAM_PARKINGBARPERCENT_6PERCENT, 7=PAM_PARKINGBARPERCENT_7PERCENT, 8=PAM_PARKINGBARPERCENT_8PERCENT, 9=PAM_PARKINGBARPERCENT_9PERCENT, 10=PAM_PARKINGBARPERCENT_10PERCENT, 11=PAM_PARKINGBARPERCENT_11PERCENT, 12=PAM_PARKINGBARPERCENT_12PERCENT, 13=PAM_PARKINGBARPERCENT_13PERCENT, 14=PAM_PARKINGBARPERCENT_14PERCENT, 15=PAM_PARKINGBARPERCENT_15PERCENT, 16=PAM_PARKINGBARPERCENT_16PERCENT, 17=PAM_PARKINGBARPERCENT_17PERCENT, 18=PAM_PARKINGBARPERCENT_18PERCENT, 19=PAM_PARKINGBARPERCENT_19PERCENT, 20=PAM_PARKINGBARPERCENT_20PERCENT, 21=PAM_PARKINGBARPERCENT_21PERCENT, 22=PAM_PARKINGBARPERCENT_22PERCENT, 23=PAM_PARKINGBARPERCENT_23PERCENT, 24=PAM_PARKINGBARPERCENT_24PERCENT, 25=PAM_PARKINGBARPERCENT_25PERCENT, 26=PAM_PARKINGBARPERCENT_26PERCENT, 27=PAM_PARKINGBARPERCENT_27PERCENT, 28=PAM_PARKINGBARPERCENT_28PERCENT, 29=PAM_PARKINGBARPERCENT_29PERCENT, 30=PAM_PARKINGBARPERCENT_30PERCENT, 31=PAM_PARKINGBARPERCENT_31PERCENT, 32=PAM_PARKINGBARPERCENT_32PERCENT, 33=PAM_PARKINGBARPERCENT_33PERCENT, 34=PAM_PARKINGBARPERCENT_34PERCENT, 35=PAM_PARKINGBARPERCENT_35PERCENT, 36=PAM_PARKINGBARPERCENT_36PERCENT, 37=PAM_PARKINGBARPERCENT_37PERCENT, 38=PAM_PARKINGBARPERCENT_38PERCENT, 39=PAM_PARKINGBARPERCENT_39PERCENT, 40=PAM_PARKINGBARPERCENT_40PERCENT, 41=PAM_PARKINGBARPERCENT_41PERCENT, 42=PAM_PARKINGBARPERCENT_42PERCENT, 43=PAM_PARKINGBARPERCENT_43PERCENT, 44=PAM_PARKINGBARPERCENT_44PERCENT, 45=PAM_PARKINGBARPERCENT_45PERCENT, 46=PAM_PARKINGBARPERCENT_46PERCENT, 47=PAM_PARKINGBARPERCENT_47PERCENT, 48=PAM_PARKINGBARPERCENT_48PERCENT, 49=PAM_PARKINGBARPERCENT_49PERCENT, 50=PAM_PARKINGBARPERCENT_50PERCENT, 51=PAM_PARKINGBARPERCENT_51PERCENT, 52=PAM_PARKINGBARPERCENT_52PERCENT, 53=PAM_PARKINGBARPERCENT_53PERCENT, 54=PAM_PARKINGBARPERCENT_54PERCENT, 55=PAM_PARKINGBARPERCENT_55PERCENT, 56=PAM_PARKINGBARPERCENT_56PERCENT, 57=PAM_PARKINGBARPERCENT_57PERCENT, 58=PAM_PARKINGBARPERCENT_58PERCENT, 59=PAM_PARKINGBARPERCENT_59PERCENT, 60=PAM_PARKINGBARPERCENT_60PERCENT, 61=PAM_PARKINGBARPERCENT_61PERCENT, 62=PAM_PARKINGBARPERCENT_62PERCENT, 63=PAM_PARKINGBARPERCENT_63PERCENT, 64=PAM_PARKINGBARPERCENT_64PERCENT, 65=PAM_PARKINGBARPERCENT_65PERCENT, 65=PAM_PARKINGBARPERCENT_65PERCENT, 66=PAM_PARKINGBARPERCENT_66PERCENT, 67=PAM_PARKINGBARPERCENT_67PERCENT, 68=PAM_PARKINGBARPERCENT_68PERCENT, 69=PAM_PARKINGBARPERCENT_69PERCENT, 70=PAM_PARKINGBARPERCENT_70PERCENT, 71=PAM_PARKINGBARPERCENT_71PERCENT, 72=PAM_PARKINGBARPERCENT_72PERCENT, 73=PAM_PARKINGBARPERCENT_73PERCENT, 74=PAM_PARKINGBARPERCENT_74PERCENT, 75=PAM_PARKINGBARPERCENT_75PERCENT, 76=PAM_PARKINGBARPERCENT_76PERCENT, 77=PAM_PARKINGBARPERCENT_77PERCENT, 78=PAM_PARKINGBARPERCENT_78PERCENT, 79=PAM_PARKINGBARPERCENT_79PERCENT, 80=PAM_PARKINGBARPERCENT_80PERCENT, 81=PAM_PARKINGBARPERCENT_81PERCENT, 82=PAM_PARKINGBARPERCENT_82PERCENT, 83=PAM_PARKINGBARPERCENT_83PERCENT, 84=PAM_PARKINGBARPERCENT_84PERCENT, 85=PAM_PARKINGBARPERCENT_85PERCENT, 86=PAM_PARKINGBARPERCENT_86PERCENT, 87=PAM_PARKINGBARPERCENT_87PERCENT, 88=PAM_PARKINGBARPERCENT_88PERCENT, 89=PAM_PARKINGBARPERCENT_89PERCENT, 90=PAM_PARKINGBARPERCENT_90PERCENT, 91=PAM_PARKINGBARPERCENT_91PERCENT, 92=PAM_PARKINGBARPERCENT_92PERCENT, 93=PAM_PARKINGBARPERCENT_93PERCENT, 94=PAM_PARKINGBARPERCENT_94PERCENT, 95=PAM_PARKINGBARPERCENT_95PERCENT, 96=PAM_PARKINGBARPERCENT_96PERCENT, 97=PAM_PARKINGBARPERCENT_97PERCENT, 98=PAM_PARKINGBARPERCENT_98PERCENT, 99=PAM_PARKINGBARPERCENT_99PERCENT, 100=PAM_PARKINGBARPERCENT_100PERCENT, 101=PAM_PARKINGBARPERCENT_NO_DISPLAY_APA}, implementation-data-type=UInt32
  impl type Pam_parkingbarstsType: compu {0=PAM_PARKINGBARSTS_DISPLAY_OFF, 1=PAM_PARKINGBARSTS_DISPLAY_ON_FROM_TOP_TO_BOTTOM, 2=PAM_PARKINGBARSTS_DISPLAY_ON_FROM_BOTTOM_TO_TOP}, implementation-data-type=UInt32
  impl type Pam_rearsystemworkstsType: compu {0=PAM_REARSYSTEMWORKSTS_DISABLE, 1=PAM_REARSYSTEMWORKSTS_ENABLE, 2=PAM_REARSYSTEMWORKSTS_ACTIVE, 3=PAM_REARSYSTEMWORKSTS_FAILED}, implementation-data-type=UInt32
  impl type Pam_stsType: compu {0=PAM_STS_OFF, 1=PAM_STS_STANDBY_STANDBY_ENABLE, 2=PAM_STS_SEARCHING_ENABLE, 3=PAM_STS_GUIDANCE_ACTIVE_ACTIVE, 4=PAM_STS_COMPLETED, 5=PAM_STS_FAILURE_DISABLE, 6=PAM_STS_TERMINATED, 7=PAM_STS_RESERVED}, implementation-data-type=UInt32
  impl type RollerbenchmodestsType: compu {0=ROLLERBENCHMODESTS_ROLLERBENCH_MODE_INACTIVE, 1=ROLLERBENCHMODESTS_ROLLERBENCH_MODE_ACTIVE}, implementation-data-type=UInt32
  impl type Sas_raw_sasstssnsrType: compu {0=SAS_RAW_SASSTSSNSR_SENSOR_VALUE_INVALID, 1=SAS_RAW_SASSTSSNSR_SENSOR_VALUE_VALID}, implementation-data-type=UInt32
  impl type Sas_sasstscalType: compu {0=SAS_SASSTSCAL_SENSOR_NOT_CALIBRATED, 1=SAS_SASSTSCAL_SENSOR_CALIBRATED}, implementation-data-type=UInt32
  impl type Sas_sasstssnsrType: compu {0=SAS_SASSTSSNSR_SENSOR_VALUE_INVALID, 1=SAS_SASSTSSNSR_SENSOR_VALUE_VALID}, implementation-data-type=UInt32
  impl type Sas_sensor_0x175_175: category=STRUCTURE
    8 x element, all with category=TYPE_REFERENCE:
      sas_raw_steerwheelangle: implementation-data-type=Double
      sas_steerwheelrotspd: implementation-data-type=Double
      sas_trimmingsts: implementation-data-type=Sas_trimmingstsType
      sas_steerwheelrotspdstatus: implementation-data-type=Sas_steerwheelrotspdstatusType
      rolling_counter_0x175: implementation-data-type=Int32
      sas_sasstscal: implementation-data-type=Sas_sasstscalType
      checksum_0x175: implementation-data-type=Int32
      sas_steerwheelangle: implementation-data-type=Double
  impl type Sas_steerwheelrotspdstatusType: compu {0=SAS_STEERWHEELROTSPDSTATUS_VALID, 1=SAS_STEERWHEELROTSPDSTATUS_INVALID}, implementation-data-type=UInt32
  impl type Sas_trimmingstsType: compu {0=SAS_TRIMMINGSTS_NOT_TRIMMED, 1=SAS_TRIMMINGSTS_TRIMMED}, implementation-data-type=UInt32
  impl type Sdg_objectsts_frsType: compu-method=Sdg_objectstsfrs_rrsTypeEnum, implementation-data-type=UInt32
  compu method Sdg_objectsts_frsTypeEnum: 0=SDG_OBJECTSTS_FRS_NO_OBJECT, 1=SDG_OBJECTSTS_FRS_OBJECT_IN_ZONE_1, 2=SDG_OBJECTSTS_FRS_OBJECT_IN_ZONE_2, 3=SDG_OBJECTSTS_FRS_OBJECT_IN_ZONE_3
  impl type Sdg_objectstsflsType: compu {0=SDG_OBJECTSTSFLS_NO_OBJECT, 1=SDG_OBJECTSTSFLS_OBJECT_IN_ZONE_1, 2=SDG_OBJECTSTSFLS_OBJECT_IN_ZONE_2, 3=SDG_OBJECTSTSFLS_OBJECT_IN_ZONE_3}, implementation-data-type=UInt32
  impl type Sdg_objectstsfls_rlsType: compu {0=SDG_OBJECTSTSFLS_RLS_NO_OBJECT, 1=SDG_OBJECTSTSFLS_RLS_OBJECT_IN_ZONE_1, 2=SDG_OBJECTSTSFLS_RLS_OBJECT_IN_ZONE_2, 3=SDG_OBJECTSTSFLS_RLS_OBJECT_IN_ZONE_3}, implementation-data-type=UInt32
  impl type Sdg_objectstsfrs_rrsType: compu-method=Sdg_objectstsfrs_rrsTypeEnum, implementation-data-type=UInt32
  compu method Sdg_objectstsfrs_rrsTypeEnum: 0=SDG_OBJECTSTSFRS_RRS_NO_OBJECT, 1=SDG_OBJECTSTSFRS_RRS_OBJECT_IN_ZONE_1, 2=SDG_OBJECTSTSFRS_RRS_OBJECT_IN_ZONE_2, 3=SDG_OBJECTSTSFRS_RRS_OBJECT_IN_ZONE_3
  impl type Sdg_objectstsrlsType: compu-method=Sdg_objectstsfrs_rrsTypeEnum, implementation-data-type=UInt32
  compu method Sdg_objectstsrlsTypeEnum: 0=SDG_OBJECTSTSRLS_NO_OBJECT, 1=SDG_OBJECTSTSRLS_OBJECT_IN_ZONE_1, 2=SDG_OBJECTSTSRLS_OBJECT_IN_ZONE_2, 3=SDG_OBJECTSTSRLS_OBJECT_IN_ZONE_3
  impl type Sod_0x275_275: category=STRUCTURE
    15 x element, all with category=TYPE_REFERENCE:
      tpms_rf_pressure: implementation-data-type=Double
      tpms_rr_pressure: implementation-data-type=Double
      tpms_lr_pressure: implementation-data-type=Double
      tpms_tire_temperature: implementation-data-type=Int32
      tpms_lf_pressure_warning: implementation-data-type=Tpms_lf_pressure_warningType
      tpms_rf_pressure_warning: implementation-data-type=Tpms_rf_pressure_warningType
      tpms_system_status: implementation-data-type=Tpms_system_statusType
      tpms_rr_pressure_warning: implementation-data-type=Tpms_rr_pressure_warningType
      tpms_lr_pressure_warning: implementation-data-type=Tpms_lr_pressure_warningType
      tpms_temperature_warning: implementation-data-type=Tpms_temperature_warningType
      tpms_resrved: implementation-data-type=Tpms_resrvedType
      tire_position: implementation-data-type=Tire_positionType
      tpms_lamp_status: implementation-data-type=Tpms_lamp_statusType
      tpms_al_state: implementation-data-type=Tpms_al_stateType
      tpms_lf_pressure: implementation-data-type=Double
  impl type Sod_autoalignmentflagType: compu {0=SOD_AUTOALIGNMENTFLAG_NO_SUCCESS, 1=SOD_AUTOALIGNMENTFLAG_SUCCESSFUL, 2=SOD_AUTOALIGNMENTFLAG_RESERVED}, implementation-data-type=UInt32
  impl type Sod_blis_activeType: compu {0=SOD_CTA_STATE_INACTIVE, 1=SOD_CTA_STATE_ACTIVE}, implementation-data-type=UInt32
  compu method Sod_blis_activeTypeEnum: 0=SOD_BLIS_ACTIVE_NO_ACTIVE, 1=SOD_BLIS_ACTIVE_STANBY, 2=SOD_BLIS_ACTIVE_ACTIVE, 3=SOD_BLIS_ACTIVE_FAIL
  impl type Sod_blis_displayType: compu {0=SOD_BLIS_DISPLAY_NO_DISPLAY, 1=SOD_BLIS_DISPLAY_SOD_LCA_CTA_DOA_ERROR, 2=SOD_BLIS_DISPLAY_SOD_LCA_CTA_DOA_BLINDNESS, 3=SOD_BLIS_DISPLAY_SOD_LCA_CTA_DOA_UNCALIBRATION, 4=SOD_BLIS_DISPLAY_TEMPORARY_ERROR, 5=SOD_BLIS_DISPLAY_RESERVED}, implementation-data-type=UInt32
  impl type Sod_cta_stateType: compu {0=SOD_CTA_STATE_INACTIVE, 1=SOD_CTA_STATE_ACTIVE}, implementation-data-type=UInt32
  impl type Sod_cta_warningreqleftType: compu {0=SOD_CTA_WARNINGREQLEFT_NO_WARNING, 1=SOD_CTA_WARNINGREQLEFT_RESERVED, 2=SOD_CTA_WARNINGREQLEFT_WARNING_LEVEL_2}, implementation-data-type=UInt32
  impl type Sod_cta_warningreqrightType: compu {0=SOD_CTA_WARNINGREQRIGHT_NO_WARNING, 1=SOD_CTA_WARNINGREQRIGHT_RESERVED, 2=OD_CTA_WARNINGREQRIGHT_WARNING_LEVEL_2}, implementation-data-type=UInt32
  impl type Sod_doa_stateType: compu-method=Sdg_objectstsfrs_rrsTypeEnum, implementation-data-type=UInt32
  compu method Sod_doa_stateTypeEnum: 0=SOD_DOA_STATE_INACTIVE, 1=SOD_DOA_STATE_ACTIVE
  impl type Sod_doa_warningreqleftfrontType: compu {0=SOD_DOA_WARNINGREQLEFTFRONT_NO_WARNING, 1=SOD_DOA_WARNINGREQLEFTFRONT_WARNING_LEVEL_1, 2=SOD_DOA_WARNINGREQLEFTFRONT_WARNING_LEVEL_2, 3=SOD_DOA_WARNINGREQLEFTFRONT_RESERVED}, implementation-data-type=UInt32
  impl type Sod_doa_warningreqleftrearType: compu {0=SOD_DOA_WARNINGREQLEFTREAR_NO_WARNING, 1=SOD_DOA_WARNINGREQLEFTREAR_WARNING_LEVEL_1, 2=SOD_DOA_WARNINGREQLEFTREAR_WARNING_LEVEL_2, 3=SOD_DOA_WARNINGREQLEFTREAR_RESERVED}, implementation-data-type=UInt32
  impl type Sod_doa_warningreqrightfrontType: compu {0=SOD_BLIS_ACTIVE_NO_ACTIVE, 1=SOD_BLIS_ACTIVE_STANBY, 2=SOD_BLIS_ACTIVE_ACTIVE, 3=SOD_BLIS_ACTIVE_FAIL}, implementation-data-type=UInt32
  impl type Sod_doa_warningreqrightrearType: compu {0=SOD_DOA_WARNINGREQRIGHTREAR_NO_WARNING, 1=SOD_DOA_WARNINGREQRIGHTREAR_WARNING_LEVEL_1, 2=SOD_DOA_WARNINGREQRIGHTREAR_WARNING_LEVEL_2, 3=SOD_DOA_WARNINGREQRIGHTREAR_RESERVED}, implementation-data-type=UInt32
  impl type Sod_lca_warningreqleftType: compu {0=SOD_LCA_WARNINGREQLEFT_NO_WARNING, 1=SOD_LCA_WARNINGREQLEFT_WARNING_LEVEL_1, 2=SOD_LCA_WARNINGREQLEFT_WARNING_LEVEL_2, 3=SOD_LCA_WARNINGREQLEFT_RESERVED}, implementation-data-type=UInt32
  impl type Sod_nm_0x440_440: category=STRUCTURE
    6 x element, all with category=TYPE_REFERENCE:
      sodnmlimphome: implementation-data-type=SodnmlimphomeType
      sodnmsleepind: implementation-data-type=SodnmsleepindType
      sodnmsleepack: implementation-data-type=SodnmsleepackType
      sodnmdestaddr: implementation-data-type=Int32
      sodnmalive: implementation-data-type=SodnmaliveType
      sodnmring: implementation-data-type=SodnmringType
  impl type Sod_sodlca_stateType: compu {0=SOD_SODLCA_STATE_INACTIVE, 1=SOD_SODLCA_STATE_ACTIVE}, implementation-data-type=UInt32
  impl type Sodlca_offtelltaleType: compu {0=SOD_BLIS_ACTIVE_NO_ACTIVE, 1=SOD_BLIS_ACTIVE_STANBY, 2=SOD_BLIS_ACTIVE_ACTIVE, 3=SOD_BLIS_ACTIVE_FAIL}, implementation-data-type=UInt32
  impl type SodnmaliveType: compu {0=SODNMALIVE_NOT_ACTIVE, 1=SODNMALIVE_ACTIVE}, implementation-data-type=UInt32
  impl type SodnmlimphomeType: compu {0=SODNMLIMPHOME_NOT_ACTIVE, 1=SODNMLIMPHOME_ACTIVE}, implementation-data-type=UInt32
  impl type SodnmringType: compu {0=SODNMRING_NOT_ACTIVE, 1=SODNMRING_ACTIVE}, implementation-data-type=UInt32
  impl type SodnmsleepackType: compu {0=SODNMSLEEPACK_NOT_ACTIVE, 1=SODNMSLEEPACK_ACTIVE}, implementation-data-type=UInt32
  impl type SodnmsleepindType: compu {0=SODNMSLEEPIND_NOT_ACTIVE, 1=SODNMSLEEPIND_ACTIVE}, implementation-data-type=UInt32
  impl type Srs_0x350_350: category=STRUCTURE
    9 x element, all with category=TYPE_REFERENCE:
      srs_sbr_secondrowright: implementation-data-type=Srs_sbr_secondrowrightType
      srs_sbr_secondrowmid: implementation-data-type=Srs_sbr_secondrowmidType
      srs_sbr_secondrowleft: implementation-data-type=Srs_sbr_secondrowleftType
      srs_sbr_pamsenger: implementation-data-type=Srs_sbr_pamsengerType
      rolling_counter_0x350: implementation-data-type=Int32
      srs_sbr_driver: implementation-data-type=Srs_sbr_driverType
      checksum_0x350: implementation-data-type=Int32
      srs_crashoutputsts: implementation-data-type=Srs_crashoutputstsType
      srs_airbagfailsts: implementation-data-type=Srs_airbagfailstsType
  impl type Srs_airbagfailstsType: compu {0=SRS_AIRBAGFAILSTS_LAMP_OFF, 1=SRS_AIRBAGFAILSTS_LAMP_FLASH, 1=SRS_AIRBAGFAILSTS_LAMP_ON, 1=SRS_AIRBAGFAILSTS_RESERVED}, implementation-data-type=UInt32
  impl type Srs_crashoutputstsType: compu {0=SRS_CRASHOUTPUTSTS_NO_CRASH, 1=SRS_CRASHOUTPUTSTS_CRASH}, implementation-data-type=UInt32
  impl type Srs_sbr_driverType: compu {0=SRS_SBR_DRIVER_LAMP_OFF, 1=SRS_SBR_DRIVER_LAMP_FLASHING_RESERVED, 2=SRS_SBR_DRIVER_LAMP_ON, 3=SRS_SBR_DRIVER_FAULT_RESERVED}, implementation-data-type=UInt32
  impl type Srs_sbr_pamsengerType: compu {0=SRS_SBR_PAMSENGER_LAMP_OFF, 1=SRS_SBR_PAMSENGER_LAMP_FLASHING_RESERVED, 2=SRS_SBR_PAMSENGER_LAMP_ON, 3=SRS_SBR_PAMSENGER_FAULT_RESERVED}, implementation-data-type=UInt32
  impl type Srs_sbr_secondrowleftType: compu {0=SRS_SBR_SECONDROWLEFT_LAMP_OFF, 1=SRS_SBR_SECONDROWLEFT_LAMP_FLASHING_RESERVED, 2=SRS_SBR_SECONDROWLEFT_LAMP_ON, 3=SRS_SBR_SECONDROWLEFT_FAULT_RESERVED}, implementation-data-type=UInt32
  impl type Srs_sbr_secondrowmidType: compu {0=SRS_SBR_SECONDROWMID_LAMP_OFF, 1=SRS_SBR_SECONDROWMID_LAMP_FLASHING_RESERVED, 2=SRS_SBR_SECONDROWMID_LAMP_ON, 3=SRS_SBR_SECONDROWMID_FAULT_RESERVED}, implementation-data-type=UInt32
  impl type Srs_sbr_secondrowrightType: compu {0=SRS_SBR_SECONDROWRIGHT_LAMP_OFF, 1=SRS_SBR_SECONDROWRIGHT_LAMP_FLASHING_RESERVED, 2=SRS_SBR_SECONDROWRIGHT_LAMP_ON, 3=SRS_SBR_SECONDROWRIGHT_FAULT_RESERVED}, implementation-data-type=UInt32
  impl type Stopstartinhibit_apaType: compu-method=Pam_cmdepsstsTypeEnum, implementation-data-type=UInt32
  compu method Stopstartinhibit_apaTypeEnum: 0=STOPSTARTINHIBIT_APA_FALSE, 1=STOPSTARTINHIBIT_APA_TRUE
  impl type Swm_accdeactivateType: compu {0=SWM_ACCDEACTIVATE_NO_PRESS, 1=SWM_ACCDEACTIVATE_PRESSED}, implementation-data-type=UInt32
  impl type Swm_accenableswitchType: compu {0=SWM_ACCENABLESWITCH_PREVENT_ACC_CONTROL, 1=SWM_ACCENABLESWITCH_ENABLE_ACC_CONTROL}, implementation-data-type=UInt32
  impl type Swm_acclimphomestsType: compu {0=SWM_ACCLIMPHOMESTS_NORMAL, 1=SWM_ACCLIMPHOMESTS_LIMPHOME}, implementation-data-type=UInt32
  impl type Swm_accresumeType: compu {0=SWM_ACCRESUME_NO_PRESS, 1=SWM_ACCRESUME_PRESSED}, implementation-data-type=UInt32
  impl type Swm_accresume_qtType: compu {0=SWM_ACCRESUME_QT_VALID, 1=SWM_ACCRESUME_QT_INVALID}, implementation-data-type=UInt32
  impl type Swm_accsetType: compu {0=SWM_ACCSET_NO_PRESS, 1=SWM_ACCSET_PRESSED}, implementation-data-type=UInt32
  impl type Swm_acctaugapsetminusType: compu {0=SWM_ACCTAUGAPSETMINUS_NO_PRESS, 1=SWM_ACCTAUGAPSETMINUS_PRESSED}, implementation-data-type=UInt32
  impl type Swm_acctaugapsetplusType: compu {0=SWM_ACCTAUGAPSETPLUS_NO_PRESS, 1=SWM_ACCTAUGAPSETPLUS_PRESSED}, implementation-data-type=UInt32
  impl type Swm_accvsetminusType: compu {0=SWM_ACCVSETMINUS_NO_PRESS, 1=SWM_ACCVSETMINUS_PRESSED}, implementation-data-type=UInt32
  impl type Swm_accvsetplusType: compu {0=SWM_ACCVSETPLUS_NO_PRESS, 1=SWM_ACCVSETPLUS_PRESSED}, implementation-data-type=UInt32
  impl type Swm_flashlightstsType: compu {0=SWM_FLASHLIGHTSTS_RELEASED, 1=SWM_FLASHLIGHTSTS_PRESSED, 2=SWM_FLASHLIGHTSTS_RESERVED, 3=SWM_FLASHLIGHTSTS_INVALID}, implementation-data-type=UInt32
  impl type Swm_frontfoglightType: compu {0=SWM_FRONTFOGLIGHT_OFF, 1=SWM_FRONTFOGLIGHT_ON, 2=SWM_FRONTFOGLIGHT_RESERVED, 3=SWM_FRONTFOGLIGHT_INVALID}, implementation-data-type=UInt32
  impl type Swm_frontwipingmodeType: compu {0=SWM_FRONTWIPINGMODE_FRONT_WIPING_OFF, 1=SWM_FRONTWIPINGMODE_FRONT_WIPER_SPEED_LOW_ACTIVATION, 2=SWM_FRONTWIPINGMODE_FRONT_WIPER_SPEED_HIGH_ACTIVATION, 3=SWM_FRONTWIPINGMODE_FRONT_MIST_WIPING_ACTIVATION, 4=SWM_FRONTWIPINGMODE_FRONT_AUTO_INTERVAL_WIPING_ACTIVATION, 7=SWM_FRONTWIPINGMODE_INVALID}, implementation-data-type=UInt32
  impl type Swm_fwasherstsType: compu {0=SWM_FWASHERSTS_RELEASED, 1=SWM_FWASHERSTS_PRESSED, 2=SWM_FWASHERSTS_RESERVED, 3=SWM_FWASHERSTS_INVALID}, implementation-data-type=UInt32
  impl type Swm_headlampType: compu {0=SWM_HEADLAMP_OFF, 1=SWM_HEADLAMP_AUTOLIGHT, 2=SWM_HEADLAMP_POSITIONLIGHT, 3=SWM_HEADLAMP_LOWBEAM, 4=SWM_HEADLAMP_INVALID}, implementation-data-type=UInt32
  impl type Swm_highbeamType: compu {0=SWM_HIGHBEAM_RELEASED, 1=SWM_HIGHBEAM_PRESSED, 2=SWM_HIGHBEAM_RESERVED, 3=SWM_HIGHBEAM_INVALID}, implementation-data-type=UInt32
  impl type Swm_lamplimphomestsType: compu {0=SWM_LAMPLIMPHOMESTS_NORMAL, 1=SWM_LAMPLIMPHOMESTS_LIMPHOME}, implementation-data-type=UInt32
  impl type Swm_laneassistswitchType: compu {0=SWM_LANEASSISTSWITCH_PREVENT_LANEASSIST_CONTROL, 1=SWM_LANEASSISTSWITCH_ENABLE_LANEASSIST_CONTROL}, implementation-data-type=UInt32
  impl type Swm_menu_confirmType: compu {0=SWM_MENU_CONFIRM_RELEASED, 1=SWM_MENU_CONFIRM_PRESSED, 2=SWM_MENU_CONFIRM_RESERVED, 3=SWM_MENU_CONFIRM_INVALID}, implementation-data-type=UInt32
  impl type Swm_menu_downType: compu {0=SWM_MENU_DOWN_RELEASED, 1=SWM_MENU_DOWN_PRESSED, 2=SWM_MENU_DOWN_RESERVED, 3=SWM_MENU_DOWN_INVALID}, implementation-data-type=UInt32
  impl type Swm_menu_leftType: compu {0=SWM_MENU_LEFT_RELEASED, 1=SWM_MENU_LEFT_RESERVED, 2=SWM_MENU_LEFT_RESERVED, 3=SWM_MENU_LEFT_INVALID}, implementation-data-type=UInt32
  impl type Swm_menu_returnType: compu {0=SWM_MENU_RETURN_RELEASED, 1=SWM_MENU_RETURN_PRESSED, 2=SWM_MENU_RETURN_RESERVED, 3=SWM_MENU_RETURN_INVALID}, implementation-data-type=UInt32
  impl type Swm_menu_rightType: compu {0=SWM_MENU_RIGHT_RELEASED, 1=SWM_MENU_RIGHT_PRESSED, 2=SWM_MENU_RIGHT_RESERVED, 3=SWM_MENU_RIGHT_INVALID}, implementation-data-type=UInt32
  impl type Swm_menu_upType: compu {0=SWM_MENU_UP_RELEASED, 1=SWM_MENU_UP_PRESSED, 2=SWM_MENU_UP_RESERVED, 3=SWM_MENU_UP_INVALID}, implementation-data-type=UInt32
  impl type Swm_muteType: compu {0=SWM_MUTE_RELEASED, 1=SWM_MUTE_PRESSED, 2=SWM_MUTE_RESERVED, 3=SWM_MUTE_INVALID}, implementation-data-type=UInt32
  impl type Swm_next_songType: compu {0=SWM_NEXT_SONG_RELEASED, 1=SWM_NEXT_SONG_PRESSED, 2=SWM_NEXT_SONG_RESERVED, 3=SWM_NEXT_SONG_INVALID}, implementation-data-type=UInt32
  impl type Swm_phoneType: compu {0=SWM_PHONE_RELEASED, 1=SWM_PHONE_PRESSED, 2=SWM_PHONE_RESERVED, 3=SWM_PHONE_INVALID}, implementation-data-type=UInt32
  impl type Swm_previous_songType: compu {0=SWM_PREVIOUS_SONG_RELEASED, 1=SWM_PREVIOUS_SONG_PRESSED, 2=SWM_PREVIOUS_SONG_RESERVED, 3=SWM_PREVIOUS_SONG_INVALID}, implementation-data-type=UInt32
  impl type Swm_rearfoglightType: compu {0=SWM_REARFOGLIGHT_RELEASED, 1=SWM_REARFOGLIGHT_PRESSED, 2=SWM_REARFOGLIGHT_RESERVED, 3=SWM_REARFOGLIGHT_INVALID}, implementation-data-type=UInt32
  impl type Swm_rearwipingmodeType: compu {0=SWM_REARWIPINGMODE_REARWIPING_OFF, 1=SWM_REARWIPINGMODE_REAR_WIPER_UNIFORMITY_SPEED, 2=SWM_REARWIPINGMODE_RESERVED, 3=SWM_REARWIPINGMODE_INVALID}, implementation-data-type=UInt32
  impl type Swm_rwasherstsType: compu {0=SWM_RWASHERSTS_RELEASED, 1=SWM_RWASHERSTS_PRESSED, 2=SWM_RWASHERSTS_RESERVED, 3=SWM_RWASHERSTS_INVALID}, implementation-data-type=UInt32
  impl type Swm_shiftpadfltType: compu {0=SWM_SHIFTPADFLT_NO_FAULT, 1=SWM_SHIFTPADFLT_FAULT}, implementation-data-type=UInt32
  impl type Swm_shiftpadreqdownType: compu {0=SWM_SHIFTPADREQDOWN_NO_PRESS, 1=SWM_SHIFTPADREQDOWN_PRESS}, implementation-data-type=UInt32
  impl type Swm_shiftpadrequpType: compu {0=SWM_SHIFTPADREQUP_NO_PRESS, 1=SWM_SHIFTPADREQUP_PRESS}, implementation-data-type=UInt32
  impl type Swm_tjaswitchType: compu {0=SWM_TJASWITCH_PREVENT_TJA_CONTROL, 1=SWM_TJASWITCH_ENABLE_TJA_CONTROL}, implementation-data-type=UInt32
  impl type Swm_turnindicationactType: compu {0=SWM_TURNINDICATIONACT_DEFAULT, 1=SWM_TURNINDICATIONACT_TURN_LEFT, 2=SWM_TURNINDICATIONACT_TURN_RIGHT, 3=SWM_TURNINDICATIONACT_INVALID}, implementation-data-type=UInt32
  impl type Swm_vol_minusType: compu {0=SWM_VOL_MINUS_RELEASED, 1=SWM_VOL_MINUS_PRESSED, 2=SWM_VOL_MINUS_RESERVED, 3=SWM_VOL_MINUS_INVALID}, implementation-data-type=UInt32
  impl type Swm_vol_plusType: compu {0=SWM_VOL_MINUS_INVALID, 1=SWM_VOL_MINUS_PRESSED, 2=SWM_VOL_PLUS_RESERVED, 3=SWM_VOL_PLUS_INVALID}, implementation-data-type=UInt32
  impl type Swm_washerlimphomestsType: compu {0=SWM_WASHERLIMPHOMESTS_NORMAL, 1=SWM_WASHERLIMPHOMESTS_LIMPHOME}, implementation-data-type=UInt32
  impl type Swm_wechatType: compu {0=SWM_WECHAT_RELEASED, 1=SWM_WECHAT_PRESSED}, implementation-data-type=UInt32
  impl type Swm_wipinginterval_sensitvityType: compu {0..3=SWM_WIPINGINTERVAL_SENSITVITY_SENSITIVITY_0..SWM_WIPINGINTERVAL_SENSITVITY_SENSITIVITY_3, 7=SWM_FRONTWIPINGMODE_INVALID}, implementation-data-type=UInt32
  impl type TakeoverreqType: compu {0=TAKEOVERREQ_NO_TAKEOVER_REQUEST, 1=TAKEOVERREQ_VALID_TAKEOVER_REQUEST}, implementation-data-type=UInt32
  impl type TaugapsetType: compu {0..7=TAUGAPSET_TAUGAP_0..TAUGAPSET_TAUGAP_7}, implementation-data-type=UInt32
  impl type Tbox_gps_ubType: compu {0=TBOX_GPS_UB_NOT_UPDATE_GPS, 1=TBOX_GPS_UB_UPDATE_GPS}, implementation-data-type=UInt32
  impl type Tbox_locationstsType: compu {0=TBOX_LOCATIONSTS_NORTH_LATITUDE_EAST_LONGITUDE, 1=TBOX_LOCATIONSTS_NORTH_LATITUDE_WEST_LONGITUDE, 2=TBOX_LOCATIONSTS_SOUTH_LATITUDE_EAST_LONGITUDE, 3=TBOX_LOCATIONSTS_SOUTH_LATITUDE_WEST_LONGITUDE, 7=TBOX_LOCATIONSTS_INVALID}, implementation-data-type=UInt32
  impl type Tcu_availableType: compu {0=TCU_AVAILABLE_NOTAVAILABLE, 1=TCU_AVAILABLE_AVAILABLE}, implementation-data-type=UInt32
  impl type Tcu_currentgearpositionType: compu {0=TCU_CURRENTGEARPOSITION_DRIVETRAINOPEN_GEARN, 1=TCU_CURRENTGEARPOSITION_1STGEAR, 2=TCU_CURRENTGEARPOSITION_2NDGEAR, 3=TCU_CURRENTGEARPOSITION_3RDGEAR, 4=TCU_CURRENTGEARPOSITION_4THGEAR, 5=TCU_CURRENTGEARPOSITION_5THGEAR, 6=TCU_CURRENTGEARPOSITION_6THGEAR, 7=TCU_CURRENTGEARPOSITION_7THGEAR, 8=TCU_CURRENTGEARPOSITION_8THGEAR, 14=TCU_CURRENTGEARPOSITION_REVERSEGEAR, 15=TCU_CURRENTGEARPOSITION_INVALID}, implementation-data-type=UInt32
  impl type Tcu_displaygearType: compu {0=TCU_DISPLAYGEAR_CURRENT_GEAR_N, 1..8=TCU_DISPLAYGEAR_GEAR_1..TCU_DISPLAYGEAR_GEAR_8, 9=TCU_DISPLAYGEAR_CURRENT_GEAR_D, 10=TCU_DISPLAYGEAR_CURRENT_GEAR_L, 11=TCU_DISPLAYGEAR_CURRENT_GEAR_R, 12=TCU_DISPLAYGEAR_RESERVED, 13=TCU_DISPLAYGEAR_CURRENT_GEAR_P, 15=TCU_DISPLAYGEAR_INVALID}, implementation-data-type=UInt32
  impl type Tcu_driverinterventionType: compu {0=TCU_DRIVERINTERVENTION_NOINTERVENTION, 1=TCU_DRIVERINTERVENTION_DRIVERINTERVENTION}, implementation-data-type=UInt32
  impl type Tcu_driving_mode_reqType: compu {0=TCU_DRIVING_MODE_REQ_NORMAL, 1=TCU_DRIVING_MODE_REQ_SNOW, 2=TCU_DRIVING_MODE_REQ_NOUSED, 3=TCU_DRIVING_MODE_REQ_SPORT, 4=TCU_DRIVING_MODE_REQ_ECO, 4=TCU_DRIVING_MODE_REQ_ECO, 5=TCU_DRIVING_MODE_REQ_4L, 6=TCU_DRIVING_MODE_REQ_ROCK, 7=TCU_DRIVING_MODE_REQ_WETMUD, 8=TCU_DRIVING_MODE_REQ_SAND, 14=TCU_DRIVING_MODE_REQ_SWITCHFAULT, 15=TCU_DRIVING_MODE_REQ_INVALID}, implementation-data-type=UInt32
  impl type Tcu_drivingmodechange_fault_flagType: compu {0=TCU_DRIVINGMODECHANGE_FAULT_FLAG_NOFAULT, 1=TCU_DRIVINGMODECHANGE_FAULT_FLAG_FAULT}, implementation-data-type=UInt32
  impl type Tcu_epblockreqType: compu {0=TCU_EPBLOCKREQ_NO_REQUEST, 1=TCU_EPBLOCKREQ_REQUEST_PARK_BRAKE_ENGAGE}, implementation-data-type=UInt32
  impl type Tcu_gearselectorreqType: compu {0=TCU_GEARSELECTORREQ_P, 1=TCU_GEARSELECTORREQ_L_RESERVED, 2=TCU_GEARSELECTORREQ_2_RESERVED, 3=TCU_GEARSELECTORREQ_3_RESERVED, 5=TCU_GEARSELECTORREQ_D, 6=TCU_GEARSELECTORREQ_N, 7=TCU_GEARSELECTORREQ_R, 8=TCU_GEARSELECTORREQ_M, 15=TCU_GEARSELECTORREQ_INVALID}, implementation-data-type=UInt32
  impl type Tcu_gearshiftinprogressType: compu {0=TCU_GEARSHIFTINPROGRESS_NOGEARSHIFTINPROGRESS, 1=TCU_GEARSHIFTINPROGRESS_GEARSHIFTINPROGRESS}, implementation-data-type=UInt32
  impl type Tcu_highresistanceType: compu {0=TCU_HIGHRESISTANCE_NO_HIGHRESISTANCE, 1=TCU_HIGHRESISTANCE_HIGHRESISTANCE}, implementation-data-type=UInt32
  impl type Tcu_shiftleverpos_sbwmType: compu {0=TCU_SHIFTLEVERPOS_SBWM_P, 1=TCU_SHIFTLEVERPOS_SBWM_D, 2=TCU_SHIFTLEVERPOS_SBWM_N, 3=TCU_SHIFTLEVERPOS_SBWM_R, 4=TCU_SHIFTLEVERPOS_SBWM_M, 5=TCU_SHIFTLEVERPOS_SBWM_BLANK, 6=TCU_SHIFTLEVERPOS_SBWM_RESERVED, 7=TCU_SHIFTLEVERPOS_SBWM_INVALID}, implementation-data-type=UInt32
  impl type Tcu_shiftlevertopreqType: compu {0=TCU_SHIFTLEVERTOPREQ_NOREQUEST, 1=TCU_SHIFTLEVERTOPREQ_PARKREQUEST, 2=TCU_SHIFTLEVERTOPREQ_RESERVED}, implementation-data-type=UInt32
  impl type Tcu_shiftlevertopreqinvalidType: compu {0=TCU_SHIFTLEVERTOPREQINVALID_VALID, 1=TCU_SHIFTLEVERTOPREQINVALID_INVALID}, implementation-data-type=UInt32
  impl type Tcu_stgearmodeType: compu {0=TCU_STGEARMODE_STANDARD, 1=TCU_STGEARMODE_SNOW, 2=TCU_STGEARMODE_MANUAL_RESERVED, 3=TCU_STGEARMODE_SPORT, 4=TCU_STGEARMODE_ECO, 5=TCU_STGEARMODE_4L, 7=TCU_STGEARMODE_WETMUD, 8=TCU_STGEARMODE_SAND, 9=TCU_STGEARMODE_GHAT, 13=TCU_STGEARMODE_MANUAL, 14=TCU_STGEARMODE_ATSFAULTTCU, 15=TCU_STGEARMODE_INVALID}, implementation-data-type=UInt32
  impl type Tcu_targetgearreqType: compu {0=TCU_TARGETGEARREQ_DRIVETRAINOPEN_GEARN, 1=TCU_TARGETGEARREQ_1STGEAR, 2=TCU_TARGETGEARREQ_2NDGEAR, 3=TCU_TARGETGEARREQ_3RDGEAR, 4=TCU_TARGETGEARREQ_4THGEAR, 5=TCU_TARGETGEARREQ_5THGEAR, 6=TCU_TARGETGEARREQ_6THGEAR, 7=TCU_TARGETGEARREQ_7THGEAR, 8=TCU_TARGETGEARREQ_8THGEAR, 14=TCU_TARGETGEARREQ_REVERSEGEAR, 15=TCU_TARGETGEARREQ_INVALID}, implementation-data-type=UInt32
  impl type Tcu_transpmotoparkreqinvalidType: compu {0=TCU_TRANSPMOTOPARKREQINVALID_VALID, 1=TCU_TRANSPMOTOPARKREQINVALID_INVALID}, implementation-data-type=UInt32
  impl type Tcu_transpmotorparkreqType: compu {0=TCU_TRANSPMOTORPARKREQ_NOREQUEST, 1=TCU_TRANSPMOTORPARKREQ_UNPARKREQUEST, 2=TCU_TRANSPMOTORPARKREQ_PARKREQUEST, 3=TCU_TRANSPMOTORPARKREQ_RESERVED}, implementation-data-type=UInt32
  impl type Tcu_trsmfaultflagType: compu {0=TCU_TRSMFAULTFLAG_NORMAL, 1=TCU_TRSMFAULTFLAG_FAILURE_NOLIMP_HOME, 2=TCU_TRSMFAULTFLAG_FAIL_LIMP_HOMEACTIVATED, 3=TCU_TRSMFAULTFLAG_RESERVED}, implementation-data-type=UInt32
  impl type TextinfoType: compu {0=TEXTINFO_NO_DISPLAY, 1=TEXTINFO_ACC_IS_SWITCHED_ON, 2=TEXTINFO_ACC_IS_CANCELLED, 3=TEXTINFO_ACC_IS_CANCELLED, 4=TEXTINFO_ACC_ACTIVE, 5=TEXTINFO_MRR_BLINDNESS, 6=TEXTINFO_ACC_AND_PEBS_ERROR, 7=TEXTINFO_EPB_ACTIVATE, 8=TEXTINFO_NO_FORWARD_GEAR, 9=TEXTINFO_SEATBELT_UNBUCKLED, 10=TEXTINFO_ESP_OFF, 11=TEXTINFO_SPEED_OVER_150KPH, 12=TEXTINFO_DOOR_OPEN, 13=TEXTINFO_OVERRIDE, 14=TEXTINFO_ESP_ERROR, 15=TEXTINFO_UNCALIBRATED}, implementation-data-type=UInt32
  impl type Tire_positionType: compu-method=Tire_positionTypeEnum, implementation-data-type=UInt32
  compu method Tire_positionTypeEnum: 0=TIRE_POSITION_NO_ANY_SENSOR_ERROR, 1=TIRE_POSITION_LEFT_FRONT_TIRE, 2=TIRE_POSITION_RIGHT_FRONT_TIRE, 3=TIRE_POSITION_RIGHT_REAR_TIRE, 4=TIRE_POSITION_LEFT_REAR_TIRE, 5=TIRE_POSITION_RESERVED
  impl type Tpms_al_stateType: compu {0=TPMS_AL_STATE_DEFAULTS, 1=TPMS_AL_STATE_SELF_LEARNING, 2=TPMS_AL_STATE_SELF_LEARNING_OVER, 3=TPMS_AL_STATE_RESERVE}, implementation-data-type=UInt32
  impl type Tpms_lamp_statusType: compu {0=TPMS_LAMP_STATUS_NO_LAMP_LIGHT, 1=TPMS_LAMP_STATUS_LAMP_FLASH, 2=TPMS_LAMP_STATUS_LAMP_LIGHT, 3=TPMS_LAMP_STATUS_RESEVED}, implementation-data-type=UInt32
  impl type Tpms_lf_pressure_warningType: compu-method=Tpms_lr_pressure_warningTypeEnum, implementation-data-type=UInt32
  compu method Tpms_lf_pressure_warningTypeEnum: 0=TPMS_LF_PRESSURE_WARNING_NO_WARNING, 1=TPMS_LF_PRESSURE_WARNING_HIGH_PRESSURE_WARNING, 2=TPMS_LF_PRESSURE_WARNING_LOW_PRESSURE_WARNING, 3=TPMS_LF_PRESSURE_WARNING_QUIK_LEAKAGE_RESERVED, 4=TPMS_LF_PRESSURE_WARNING_LOST_SENSOR, 5=TPMS_LF_PRESSURE_WARNING_SENSOR_BATTERY_LOW, 6=TPMS_LF_PRESSURE_WARNING_SENSOR_FAULTURE_RESERVED, 7=TPMS_LF_PRESSURE_WARNING_LOW_PRESSURE_WARN_QUIK_LEAK_RESERVED
  impl type Tpms_lr_pressure_warningType: compu-method=Tpms_lr_pressure_warningTypeEnum, implementation-data-type=UInt32
  compu method Tpms_lr_pressure_warningTypeEnum: 0=TPMS_LR_PRESSURE_WARNING_NO_WARNING, 1=TPMS_LR_PRESSURE_WARNING_HIGH_PRESSURE_WARNING, 2=TPMS_LR_PRESSURE_WARNING_LOW_PRESSURE_WARNING, 3=TPMS_LR_PRESSURE_WARNING_QUIK_LEAKAGE_RESERVED, 4=TPMS_LR_PRESSURE_WARNING_LOST_SENSOR, 5=TPMS_LR_PRESSURE_WARNING_SENSOR_BATTERY_LOW, 6=TPMS_LR_PRESSURE_WARNING_SENSOR_FAULTURE_RESERVED, 7=TPMS_LR_PRESSURE_WARNING_LOW_PRESSURE_WARN_QUIK_LEAK_RESERVED
  impl type Tpms_resrvedType: compu {0=TPMS_RESRVED_RESERVED, 1=TPMS_RESRVED_RESERVED1}, implementation-data-type=UInt32
  impl type Tpms_rf_pressure_warningType: compu {0=TPMS_RF_PRESSURE_WARNING_NO_WARNING, 1=TPMS_RF_PRESSURE_WARNING_HIGH_PRESSURE_WARNING, 2=TPMS_RF_PRESSURE_WARNING_LOW_PRESSURE_WARNING, 3=TPMS_RF_PRESSURE_WARNING_QUIK_LEAKAGE_RESERVED, 4=TPMS_RF_PRESSURE_WARNING_LOST_SENSOR, 5=TPMS_RF_PRESSURE_WARNING_SENSOR_BATTERY_LOW, 0=ABS_WHLSPDFRNTLESTATUS_VALID, 6=TPMS_RF_PRESSURE_WARNING_SENSOR_FAULTURE_RESERVED, 7=TPMS_RF_PRESSURE_WARNING_LOW_PRESSURE_WARN_QUIK_LEAK_RESERVED}, implementation-data-type=UInt32
  impl type Tpms_rr_pressure_warningType: compu-method=Tpms_lr_pressure_warningTypeEnum, implementation-data-type=UInt32
  compu method Tpms_rr_pressure_warningTypeEnum: 0=TPMS_RR_PRESSURE_WARNING_NO_WARNING, 1=TPMS_RR_PRESSURE_WARNING_HIGH_PRESSURE_WARNING, 2=TPMS_RR_PRESSURE_WARNING_LOW_PRESSURE_WARNING, 3=TPMS_RR_PRESSURE_WARNING_QUIK_LEAKAGE_RESERVED, 4=TPMS_RR_PRESSURE_WARNING_LOST_SENSOR, 5=TPMS_RR_PRESSURE_WARNING_SENSOR_BATTERY_LOW, 6=TPMS_RR_PRESSURE_WARNING_SENSOR_FAULTURE_RESERVED, 7=TPMS_RR_PRESSURE_WARNING_LOW_PRESSURE_WARN_QUIK_LEAK_RESERVED
  impl type Tpms_system_statusType: compu-method=Tire_positionTypeEnum, implementation-data-type=UInt32
  compu method Tpms_system_statusTypeEnum: 0=TPMS_SYSTEM_STATUS_NO_ANY_ERROR, 1=TPMS_SYSTEM_STATUS_SYSTEM_ERROR, 2=TPMS_SYSTEM_STATUS_SYETEM_WAIT_FOR_LEARNING, 3=TPMS_SYSTEM_STATUS_WINTER_MODE
  impl type Tpms_temperature_warningType: compu {0=TPMS_RESRVED_RESERVED, 1=TPMS_RESRVED_RESERVED1}, implementation-data-type=UInt32
  compu method Tpms_temperature_warningTypeEnum: 0=TPMS_TEMPERATURE_WARNING_NO_TEMPERATURE_WARNING, 1=TPMS_TEMPERATURE_WARNING_TEMPERATURE_WARNING
  impl type od_lca_warningreqrightType: compu {0=SOD_LCA_WARNINGREQRIGHT_NO_WARNING, 1=SOD_LCA_WARNINGREQRIGHT_WARNING_LEVEL_1, 2=SOD_LCA_WARNINGREQRIGHT_WARNING_LEVEL_2, 3=SOD_LCA_WARNINGREQRIGHT_RESERVED}, implementation-data-type=UInt32
package /jmc_auto/vehicle_chassis
  impl type Vehicle_Chassis: category=STRUCTURE
    11 x element, all with category=TYPE_REFERENCE:
      SOC: implementation-data-type=Float
      speed_mps: implementation-data-type=Float
      ACC_Speed: implementation-data-type=Float
      throttle_percentage: implementation-data-type=Float
      brake_percentage: implementation-data-type=Float
      steering_percentage: implementation-data-type=Float
      header: implementation-data-type=ComHeader
      engine_started: implementation-data-type=Bool
      driving_mode: implementation-data-type=DrivingMode
      error_code: implementation-data-type=ChassisErrorCode
      gear_location: implementation-data-type=GearPosition
package /jmc_auto/vehicle_parameter
  impl type VehicleBrand: compu {0=LINCOLN_MKZ, 1=GEM, 2=CH, 3=TESHUN, 4=CX75}, implementation-data-type=UInt8
  impl type VehicleParameter: category=STRUCTURE
    4 x element, all with category=TYPE_REFERENCE:
      brand: implementation-data-type=VehicleBrand
      max_engine_pedal: implementation-data-type=Double
      max_enable_fail_attempt: implementation-data-type=Int32
      driving_mode: implementation-data-type=DrivingMode
