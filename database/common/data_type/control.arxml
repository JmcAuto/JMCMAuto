AUTOSAR XML (schema 00046)
package /jmc_auto/calibration_table
  impl type ControlCalibrationInfo: category=STRUCT
    element speed: implementation-data-type=Double
    element acceleration: implementation-data-type=Double
    element command: implementation-data-type=Double
  impl type ControlCalibrationTable: category=VECTOR
    element calibration: implementation-data-type=ControlCalibrationInfo
package /jmc_auto/control_cmd
  7 x impl type:
    ControlCommand: category=STRUCTURE
      20 x element, all with category=TYPE_REFERENCE:
        header: implementation-data-type=ComHeader
        steering_target: implementation-data-type=Double
        parking_brake: implementation-data-type=Bool
        speed: implementation-data-type=Double
        acceleration: implementation-data-type=Double
        reset_model: implementation-data-type=Bool
        engine_on_off: implementation-data-type=Bool
        trajectory_fraction: implementation-data-type=Double
        driving_mode: implementation-data-type=Double
        gear_location: implementation-data-type=Double
        debug: implementation-data-type=Debug
        signal: implementation-data-type=Double
        latency_stats: implementation-data-type=LatencyStats
        pad_msg: implementation-data-type=String
        engage_advice: implementation-data-type=String
        is_in_safe_mode: implementation-data-type=Bool
        steering_torque: implementation-data-type=Double
        pam_esp_stop_distance: implementation-data-type=Int32
        ACC_StandstillReq: implementation-data-type=Bool
        TurnSignal: implementation-data-type=TurnSignal
    Debug: category=STRUCTURE
      element simple_lon_debug: implementation-data-type=SimpleLongtitudinalDebug
      element simple_lat_debug: implementation-data-type=SimpleLateralDebug
      element input_debug: implementation-data-type=InputDebug
    InputDebug: category=STRUCTURE
      element localization_header: implementation-data-type=ComHeader
      element canbus_header: implementation-data-type=ComHeader
      element trajectory_header: implementation-data-type=ComHeader
    LatencyStats: category=STRUCTURE
      element total_time_ms: implementation-data-type=Double
      element controller_time_ms: category=VECTOR, implementation-data-type=Double
      element total_time_exceeded: implementation-data-type=Bool
    SimpleLateralDebug: category=STRUCTURE
      19 x element, all with category=TYPE_REFERENCE, implementation-data-type=Double:
        lateral_error
        lateral_error_rate
        heading_error
        heading_error_rate
        ref_heading
        heading
        curvature
        steer_angle
        steer_angle_feedforward
        steer_angle_feedback
        steer_angle_lateral_contribution
        steer_angle_lateral_rate_contribution
        steer_angle_heading_contribution
        steer_angle_heading_rate_contribution
        steering_position
        ref_speed
        steer_angle_limited
        steer_targe_position_error
        steering_torque
    SimpleLongtitudinalDebug: category=STRUCTURE
      17 x element, all with category=TYRE_REFERENCE:
        station_reference: implementation-data-type=Double
        station_error: implementation-data-type=Double
        station_error_limited: implementation-data-type=Double
        preview_station_error: implementation-data-type=Double
        speed_reference: implementation-data-type=Double
        speed_vehicle: implementation-data-type=Double
        speed_error: implementation-data-type=Double
        speed_controller_input_limited: implementation-data-type=Double
        preview_speed_reference: implementation-data-type=Double
        preview_speed_error: implementation-data-type=Double
        preview_acceleration_reference: implementation-data-type=Double
        acceleration_cmd_closeloop: implementation-data-type=Double
        acceleration_cmd: implementation-data-type=Double
        is_full_stop: implementation-data-type=Bool
        slope_offset_compensation: implementation-data-type=Double
        current_station: implementation-data-type=Double
        path_remain: implementation-data-type=Double
    TurnSignal: compu {0=TURN_NONE, 1=TURN_LEFT, 2=TURN_RIGHT}, implementation-data-type=UInt16
package /jmc_auto/lat_controller_conf
  impl type LatControllerConf: category=STRUCTURE
    16 x element, all with category=TYPE_REFERENCE:
      ts: implementation-data-type=Double
      preview_window: implementation-data-type=Int32
      cf: implementation-data-type=Double
      cr: implementation-data-type=Double
      mass_fl: implementation-data-type=Int32
      mass_fr: implementation-data-type=Int32
      mass_rl: implementation-data-type=Int32
      matrix_q: implementation-data-type=VehicleCmdAppDataType
      mass_rr: implementation-data-type=Int32
      eps: implementation-data-type=Double
      cutoff_freq: implementation-data-type=Int32
      mean_filter_window_size: implementation-data-type=Int32
      max_iteration: implementation-data-type=Int32
      lat_err_gain_scheduler
      heading_err_gain_scheduler
      steer_calibration_table
  impl type MatrixQ: category=VECTOR
    element matrix_q: implementation-data-type=Double
package /jmc_auto/pad_msg
  implementation-data-type category=STRUCT:
    element header: implementation-data-type=ComHeader
    element driving_mode: category=TYPE_REFERENCE
    element action: implementation-data-type=DrivingAction
  impl type DrivingAction: compu {0=STOP, 1=START, 2=RESET}, implementation-data-type=UInt16
