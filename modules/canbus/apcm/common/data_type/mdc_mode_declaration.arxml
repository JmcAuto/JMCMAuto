AUTOSAR XML (schema 00046)
package /HuaweiMDC/ModeDeclaration
  4 x mode declaration group:
    ApplicationMode: initial-mode=Idle
      mode Idle
      mode Running
      mode Terminated
    FunctionGroupMode: initial-mode=VehicleInActive
      mode VehicleDriving: value=2
      mode VehicleInActive: value=1
      mode VehicleShutdown: value=0
    LidarMode: initial-mode=LowSpeed
      mode HighSpeed
      mode LowSpeed
      mode MiddleSpeed
    MachineMode: initial-mode=Startup
      mode Restart: value=2
      mode Shutdown: value=1
      mode Startup: value=0
