AUTOSAR XML (schema 00046)
package /HuaweiMDC/Platform/CanMsgDataType
  impl type CanBusDataParam: category=STRUCTURE
    element seq: implementation-data-type=UInt8
    element elementList: implementation-data-type=ElementList
  impl type CanData: category=VECTOR
    element Dim1Element: implementation-data-type=UInt8
  impl type CanSetDataResult: compu {0=OK, 1=ERROR}, implementation-data-type=UInt8
  impl type Element: category=STRUCTURE
    4 x element, all with category=TYPE_REFERENCE:
      timeStamp: implementation-data-type=Systemtime
      canId: implementation-data-type=UInt32
      validLen: implementation-data-type=UInt8
      data: implementation-data-type=CanData
  impl type ElementList: category=VECTOR
    element Dim1Element: implementation-data-type=Element
  impl type Systemtime: category=STRUCTURE
    element second: implementation-data-type=UInt32
    element nsecond: implementation-data-type=UInt32
package /HuaweiMDC/Platform/CanRxServiceInterface
  service interface CanRxServiceInterface: is-service=true
    namespaces:
      symbol props mdc
      symbol props sensor
    events:
      data CanDataRxEvent: type=CanBusDataParam
    methods:
      operation CanDataSetMethod
        arg canData: type=CanBusDataParam, direction=IN
        arg result: type=CanSetDataResult, direction=OUT
  someip service interface deployment CanRxSomeipServiceInterfaceDeployment: service-interface=CanRxServiceInterface, service-interface-id=208, service-interface-version={major-version=1, minor-version=0}
    someip event deployment CanDataRxEvent00: event=CanDataRxEvent, event-id=32769, transport-protocol=UDP
    someip method deployment CanDataSetMethod00: method=CanDataSetMethod, method-id=1, transport-protocol=UDP
    someip event group CanDataRxEventGroup: event-group-id=16, event=CanDataRxEvent00
