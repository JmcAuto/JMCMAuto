AUTOSAR XML (schema 00046)
package /HuaweiMDC/Platform/CanTxServiceInterface
  service interface CanTxServiceInterface: is-service=true
    namespaces:
      symbol props mdc
      symbol props sensor
    events:
      data CanDataTxEvent: type=CanBusDataParam
  someip service interface deployment CanTxSomeipServiceInterfaceDeployment: service-interface=CanTxServiceInterface, service-interface-id=209, service-interface-version={major-version=1, minor-version=1}
    someip event deployment CanDataTxEvent00: event=CanDataTxEvent, event-id=32769, transport-protocol=UDP
    someip event group CanDataTxEventGroup: event-group-id=16, event=CanDataTxEvent00
