AUTOSAR XML (schema 00046)
package /jmc_auto/PlatformServices/CanbusProcess
  process CanbusProcess: executable=CanbusExecutable, mode-dependent-startup-config{function-group-mode=[MachineModeGroupPrototype.VehicleDriving, MachineModeGroupPrototype.VehicleInActive], machine-mode=MachineModeGroupPrototype.Startup, resource-group=Dmini0ResourceLimitationGroup1, startup-config=CanbusStartupConfig}
package /jmc_auto/PlatformServices/CanbusStartupConfig
  startup config set CanbusStartupConfigSet
    startup config CanbusStartupConfig: scheduling-policy=SCHEDULING-POLICY-ROUND-ROBIN, scheduling-priority=12
