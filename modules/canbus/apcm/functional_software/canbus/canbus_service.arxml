AUTOSAR XML (schema 00046)
package /jmc_auto/PlatFormServices/CanbusConsumerToApp
  elements dds-service-instance-to-machine-mapping={communication-connector=Dmini0EthernetCommConnector, service-instance=ControlCommandRequiredDdsServiceInstance}:
    service instance to port prototype mapping CanbusRecvServiceInstanceToPort: port-prototype=CanbusRootSwComponent.ControlCommandRPort, process=CanbusProcess, service-instance=ControlCommandRequiredDdsServiceInstance
package /jmc_auto/PlatFormServices/CanbusProviderToApp
  someip service instance to machine mapping CanbusAbstractServiceInstanceToMachine: communication-connector=Dmini0EthernetCommConnector, service-instance=ChassisProvidedSomeipServiceInstance, udp-port=6000
  service instance to port prototype mapping CanbusAbstractServiceInstanceToPort: port-prototype=CanbusRootSwComponent.ChassisPPort, process=CanbusProcess, service-instance=ChassisProvidedSomeipServiceInstance
package /jmc_auto/PlatFormServices/CanbusServiceConsumer
  dds required service instance ControlCommandRequiredDdsServiceInstance: service-interface=ControlCommandDdsServiceInterfaceDeployment, dds-event-qos-props{qos-profile=/var/eventsqos.xml, event=ControlCommandDdsEventDeployment}, required-service-instance-id=109
package /jmc_auto/PlatFormServices/CanbusServiceProvider
  provided someip service instance ChassisProvidedSomeipServiceInstance: service-interface=ChassisSomeipInterfaceDeployment, someip-event-props=ChassisEventDeployment, service-instance-id=104
