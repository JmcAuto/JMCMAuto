AUTOSAR XML (schema 00046)
package /jmc_auto/Platform/ChassisDateType
  impl type BrkPedalStasus: compu {0=NOT_PRESSED, 1=PRESSED, 2=RESERRVED, 3=ERROR}, implementation-data-type=UInt8
  4 x impl type:
    Chassis: category=STRUCTURE
      87 x element, all with category=TYPE_REFERENCE:
        engine_started: implementation-data-type=Bool
        engine_rpm: implementation-data-type=Float
        speed_mps: implementation-data-type=Float
        odometer_m: implementation-data-type=Float
        fuel_range_m: implementation-data-type=Int32
        throttle_percentage: implementation-data-type=Float
        brake_percentage: implementation-data-type=Float
        steering_percentage: implementation-data-type=Float
        steering_torque_nm: implementation-data-type=Float
        parking_brake: implementation-data-type=Bool
        high_beam_signal: implementation-data-type=Bool
        low_beam_signal: implementation-data-type=Bool
        left_turn_signal: implementation-data-type=Bool
        right_turn_signal: implementation-data-type=Bool
        horn: implementation-data-type=Bool
        wiper: implementation-data-type=Bool
        disengage_status: implementation-data-type=Bool
        driving_mode: implementation-data-type=DrivingMode
        error_code: implementation-data-type=ChassisErrorCode
        gear_location: implementation-data-type=GearPosition
        steering_timestamp: implementation-data-type=Double
        header: implementation-data-type=Header
        chassis_error_mask: implementation-data-type=Int32
        signal: implementation-data-type=VehicleSignal
        chassis_gps: implementation-data-type=ChassisGPS
        engage_advice: implementation-data-type=EngageAdvice
        wheel_speed: implementation-data-type=WheelSpeed
        surround: implementation-data-type=Surround
        license: implementation-data-type=License
        lon_acc: implementation-data-type=Float
        steer_wheel_rot_spd: implementation-data-type=Float
        abs_vehspdlgt_valid: implementation-data-type=Bool
        esp_algtstatus_valid: implementation-data-type=Bool
        sas_sasstssnsr_valid: implementation-data-type=Bool
        steerwheelrotspd_valid: implementation-data-type=Bool
        eps_lkaresponsetorque_valid: implementation-data-type=Bool
        eps_torsionbartorque: implementation-data-type=Float
        eps_tosionbartorquevalid: implementation-data-type=Bool
        abs_whlmilgfrntri: implementation-data-type=Int32
        abs_whlmilgfrntle: implementation-data-type=Int32
        abs_whlmilgrearre: implementation-data-type=Int32
        abs_whlmilgrearle: implementation-data-type=Int32
        esp_wheelpulse_fl: implementation-data-type=Int32
        esp_wheelpulse_fr: implementation-data-type=Int32
        esp_wheelpulse_rl: implementation-data-type=Int32
        esp_wheelpulse_rr: implementation-data-type=Int32
        ems_accpedalratio: implementation-data-type=Double
        brkpedalstasus: implementation-data-type=BrkPedalStasus
        abs_whlspdfrntle: implementation-data-type=Double
        abs_whlspdfrntri: implementation-data-type=Double
        abs_whlspdrele: implementation-data-type=Double
        abs_whlspdreri: implementation-data-type=Double
        acc_x: implementation-data-type=Double
        acc_y: implementation-data-type=Double
        acc_z: implementation-data-type=Double
        gyro_x: implementation-data-type=Double
        gyro_y: implementation-data-type=Double
        gyro_z: implementation-data-type=Double
        ins_pitchangle: implementation-data-type=Double
        ins_rollangle: implementation-data-type=Double
        ins_headingangle: implementation-data-type=Double
        ins_locatheight: implementation-data-type=Double
        ins_time: implementation-data-type=Double
        ins_latitude: implementation-data-type=Double
        ins_longitude: implementation-data-type=Double
        ins_northspd: implementation-data-type=Double
        ins_eastspd: implementation-data-type=Double
        ins_togroundspd: implementation-data-type=Double
        ins_gpsflag_pos: implementation-data-type=Int32
        ins_numsv: implementation-data-type=Int32
        ins_gpsflag_heading: implementation-data-type=Int32
        ins_gps_age: implementation-data-type=Int32
        ins_car_status: implementation-data-type=Int32
        ins_status: implementation-data-type=Int32
        ins_std_lat: implementation-data-type=Double
        ins_std_lon: implementation-data-type=Double
        ins_std_locat_height: implementation-data-type=Double
        ins_std_heading: implementation-data-type=Double
        eps_lkacontrolstatus: implementation-data-type=Int32
        esp_vlc_active: implementation-data-type=Int32
        esp_vlc_available: implementation-data-type=Int32
        esp_apa_gearboxenable: implementation-data-type=Int32
        esp_vlc_apactive: implementation-data-type=Int32
        esp_vlcapa_available: implementation-data-type=Int32
        eps_epspamsts: implementation-data-type=Int32
        eps_epspaminh: implementation-data-type=Int32
        esp_epbstatus: implementation-data-type=Int32
    ChassisErrorCode: compu {0=NO_ERROR, 1=CMD_NOT_IN_PERIOD, 2=CHASSIS_ERROR, 3=MANUAL_INTERVENTION, 4=CHASSIS_CAN_NOT_IN_PERIOD, 5=UNKNOWN_ERROR}, implementation-data-type=UInt8
    ChassisGPS: category=STRUCTURE
      20 x element, all with category=TYPE_REFERENCE:
        latitude: implementation-data-type=Double
        longitude: implementation-data-type=Double
        gps_valid: implementation-data-type=Bool
        year: implementation-data-type=Int32
        month: implementation-data-type=Int32
        day: implementation-data-type=Int32
        hours: implementation-data-type=Int32
        minutes: implementation-data-type=Int32
        seconds: implementation-data-type=Int32
        compass_direction: implementation-data-type=Double
        pdop: implementation-data-type=Double
        is_gps_fault: implementation-data-type=Bool
        is_inferred: implementation-data-type=Bool
        altitude: implementation-data-type=Double
        heading: implementation-data-type=Double
        hdop: implementation-data-type=Double
        vdop: implementation-data-type=Double
        quality: implementation-data-type=GpsQuality
        num_satellites: implementation-data-type=Int32
        gps_speed: implementation-data-type=Double
    DrivingMode: compu {0=COMPLETE_MANUAL, 1=COMPLETE_AUTO_DRIVE, 2=AUTO_STEER_ONLY, 3=AUTO_SPEED_ONLY, 4=EMERGENCY_MODE, 5=REMOTE_MODE, 6=APA_MODE}, implementation-data-type=UInt8
  impl type GearPosition: compu {0=GEAR_NEUTRAL, 1=GEAR_DRIVE, 2=GEAR_REVERSE, 3=GEAR_PARKING, 4=GEAR_LOW, 5=GEAR_INVALID, 6=GEAR_NONE}, implementation-data-type=UInt8
  impl type GpsQuality: compu {0=FIX_NO, 1=FIX_2D, 2=FIX_3D, 3=FIX_INVALID}, implementation-data-type=UInt8
  impl type INS_Car_Status: compu {0=INS_Status_NONE, 1=NO_RECEIVE}, implementation-data-type=UInt8
  impl type INS_GpsFlag: compu {0=NONE, 1=FIXEDPOS, 2=FIXEDHEIGHT, 8=DOPPLER_VELOCITY, 16=SINGLE, 17=PSRDIFF, 18=SBAS, 32=L1_FLOAT, 33=IONOFREE_FLOAT, 34=NARROW_FLOAT, 48=L1_INT, 49=WIDE_INT, 50=NARROW_INT}, implementation-data-type=UInt8
  impl type INS_Status: compu {0=INS_Status_NONE, 1=ATTITUDE_INITI_ALIZATION, 2=INS_STATUS_NAVIGATION}, implementation-data-type=UInt8
  6 x impl type:
    License: category=STRUCTURE
      element vin: implementation-data-type=String
    Signal: category=STRUCTURE
      5 x element, all with category=TYPE_REFERENCE:
        turn_signal: implementation-data-type=TurnSignal
        high_beam: implementation-data-type=Bool
        low_beam: implementation-data-type=Bool
        horn: implementation-data-type=Bool
        emergency_light: implementation-data-type=Bool
    Sonar: category=STRUCTURE
      element range: implementation-data-type=Double
      element translation: implementation-data-type=Point3D
      element rotation: implementation-data-type=Quaternion
    Surround: category=STRUCTURE
      24 x element:
        cross_traffic_alert_left: implementation-data-type=Bool
        cross_traffic_alert_left_enabled: implementation-data-type=Bool
        blind_spot_left_alert: implementation-data-type=Bool
        blind_spot_left_alert_enabled: implementation-data-type=Bool
        cross_traffic_alert_right: implementation-data-type=Bool
        cross_traffic_alert_right_enabled: implementation-data-type=Bool
        blind_spot_right_alert: implementation-data-type=Bool
        blind_spot_right_alert_enabled: implementation-data-type=Bool
        sonar{00..11}: implementation-data-type=Double
        sonar_enabled: implementation-data-type=Bool
        sonar_fault: implementation-data-type=Bool
        sonar_range: category=VECTOR, implementation-data-type=Double
        sonar: category=VECTOR, implementation-data-type=Sonar
    WheelSpeed: category=STRUCTURE
      12 x element, all with category=TYPE_REFERENCE:
        is_wheel_spd_rr_valid: implementation-data-type=Bool
        wheel_direction_rr: implementation-data-type=WheelSpeedType
        wheel_spd_rr: implementation-data-type=Double
        is_wheel_spd_rl_valid: implementation-data-type=Bool
        wheel_direction_rl: implementation-data-type=WheelSpeedType
        wheel_spd_rl: implementation-data-type=Double
        is_wheel_spd_fr_valid: implementation-data-type=Bool
        wheel_direction_fr: implementation-data-type=WheelSpeedType
        wheel_spd_fr: implementation-data-type=Double
        is_wheel_spd_fl_valid: implementation-data-type=Bool
        wheel_direction_fl: implementation-data-type=WheelSpeedType
        wheel_spd_fl: implementation-data-type=Double
    WheelSpeedType: compu {0=FORWARD, 1=BACKWARD, 2=STANDSTILL, 3=INVALID}, implementation-data-type=UInt8
package /jmc_auto/Platform/ChassisServiceInterface
  service interface ChassisServiceInterface: is-service=true
    namespaces:
      symbol props jmc_auto
    events:
      data ChassisEvent: type=Chassis
  someip service interface deployment ChassisSomeipInterfaceDeployment: service-interface=ChassisServiceInterface, service-interface-id=1004, service-interface-version={major-version=1, minor-version=0}
    someip event deployment ChassisEventDeployment: event=ChassisEvent, event-id=32769, transport-protocol=UDP
