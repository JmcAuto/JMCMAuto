AUTOSAR XML (schema 00046)
package /jmc_auto/Functional/ControlCommandDataType
  7 x impl type:
    ControlCommand: category=STRUCTURE
      30 x element, all with category=TYPE_REFERENCE:
        header: implementation-data-type=Header
        steering_target: implementation-data-type=Double
        parking_brake: implementation-data-type=Bool
        speed: implementation-data-type=Double
        acceleration: implementation-data-type=Double
        reset_model: implementation-data-type=Bool
        engine_on_off: implementation-data-type=Bool
        trajectory_fraction: implementation-data-type=Double
        driving_mode: implementation-data-type=DrivingMode
        gear_location: implementation-data-type=GearPosition
        debug: implementation-data-type=Debug
        signal: implementation-data-type=VehicleSignal
        latency_stats: implementation-data-type=LatencyStats
        pad_msg: implementation-data-type=PadMessage
        engage_advice: implementation-data-type=EngageAdvice
        is_in_safe_mode: implementation-data-type=Bool
        steering_torque: implementation-data-type=Double
        PAM_ESP_Target_Gear_Request: implementation-data-type=Int32
        ACC_StandstillReq: implementation-data-type=Bool
        turnsignal: implementation-data-type=TurnSignal
        throttle: implementation-data-type=Double
        brake: implementation-data-type=Double
        steering_rate: implementation-data-type=Double
        left_turn: implementation-data-type=Bool
        right_turn: implementation-data-type=Bool
        high_beam: implementation-data-type=Bool
        low_beam: implementation-data-type=Bool
        horn: implementation-data-type=Bool
        steering_angle: implementation-data-type=Double
        pam_esp_stop_distance: implementation-data-type=Int32
    Debug: category=STRUCTURE
      element simple_lon_debug: implementation-data-type=SimpleLongtitudinalDebug
      element simple_lat_debug: implementation-data-type=SimpleLateralDebug
      element input_debug: implementation-data-type=InputDebug
    InputDebug: category=STRUCTURE
      element localization_header: implementation-data-type=Header
      element canbus_header: implementation-data-type=Header
      element trajectory_header: implementation-data-type=Header
    LatencyStats: category=STRUCTURE
      element total_time_ms: implementation-data-type=Double
      element controller_time_ms: category=VECTOR, implementation-data-type=Double
      element total_time_exceeded: implementation-data-type=Bool
    SimpleLateralDebug: category=STRUCTURE
      23 x element, all with category=TYPE_REFERENCE, implementation-data-type=Double:
        lateral_error
        lateral_error_rate
        heading_error
        heading_error_rate
        ref_heading
        heading
        curvature
        steer_angle
        steer_angle_feedforward
        steer_angle_feedback
        steer_angle_lateral_contribution
        steer_angle_lateral_rate_contribution
        steer_angle_heading_contribution
        steer_angle_heading_rate_contribution
        steering_position
        ref_speed
        steer_angle_limited
        steer_targe_position_error
        steering_torque
        lateral_acceleration
        lateral_jerk
        ref_heading_rate
        heading_rate
    SimpleLongtitudinalDebug: category=STRUCTURE
      23 x element:
        station_reference: category=TYRE_REFERENCE, implementation-data-type=Double
        station_error: category=TYRE_REFERENCE, implementation-data-type=Double
        station_error_limited: category=TYRE_REFERENCE, implementation-data-type=Double
        preview_station_error: category=TYRE_REFERENCE, implementation-data-type=Double
        speed_reference: category=TYRE_REFERENCE, implementation-data-type=Double
        speed_real: category=TYRE_REFERENCE, implementation-data-type=Double
        speed_error: category=TYRE_REFERENCE, implementation-data-type=Double
        speed_controller_input_limited: category=TYRE_REFERENCE, implementation-data-type=Double
        preview_speed_reference: category=TYRE_REFERENCE, implementation-data-type=Double
        preview_speed_error: category=TYRE_REFERENCE, implementation-data-type=Double
        preview_acceleration_reference: category=TYRE_REFERENCE, implementation-data-type=Double
        acceleration_cmd_closeloop: category=TYRE_REFERENCE, implementation-data-type=Double
        acceleration_cmd: category=TYRE_REFERENCE, implementation-data-type=Double
        is_full_stop: category=TYRE_REFERENCE, implementation-data-type=Bool
        slope_offset_compensation: category=TYRE_REFERENCE, implementation-data-type=Double
        current_station: category=TYRE_REFERENCE, implementation-data-type=Double
        path_remain: category=TYRE_REFERENCE, implementation-data-type=Double
        acceleration_lookup: category=TYRE_REFERENCE, implementation-data-type=Double
        calibration_value: category=TYRE_REFERENCE, implementation-data-type=Double
        prew_kappa: category=TYRE_REFERENCE, implementation-data-type=Double
        match_acceleration_reference: category=TYRE_REFERENCE, implementation-data-type=Double
        speed_offset: category=TYRE_REFERENCE, implementation-data-type=Double
        gear_location: implementation-data-type=GearPosition
    TurnSignal: compu {0=TURN_NONE, 1=TURN_LEFT, 2=TURN_RIGHT}, implementation-data-type=UInt16
  impl type DrivingAction: compu {0=STOP, 1=START, 2=RESET}, implementation-data-type=UInt16
  impl type PadMessage: category=STRUCTURE
    element header: implementation-data-type=Header
    element driving_mode: implementation-data-type=DrivingMode
    element action: implementation-data-type=DrivingAction
package /jmc_auto/Functional/ControlCommandServiceInterface
  dds service interface deployment ControlCommandDdsServiceInterfaceDeployment: service-interface=ControlCommandServiceInterface, service-interface-id=1009
    dds event deployment ControlCommandDdsEventDeployment: event=ControlCommandEvent, topic-name=ControlCommandDdsEvent
  service interface ControlCommandServiceInterface: is-service=true
    namespaces:
      symbol props jmc_auto
    events:
      data ControlCommandEvent: type=ControlCommand
