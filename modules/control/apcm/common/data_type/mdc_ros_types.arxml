AUTOSAR XML (schema 00046)
package /HuaweiMDC/LidarRosTypes
  impl type PointCloud2: category=VECTOR
    element ImplementationDataType: implementation-data-type=SinglePoint
  impl type SinglePoint: category=STRUCTURE
    5 x element, all with category=TYPE_REFERENCE:
      x: implementation-data-type=Float
      y: implementation-data-type=Float
      z: implementation-data-type=Float
      intensity: implementation-data-type=Float
      ring: implementation-data-type=UInt32
