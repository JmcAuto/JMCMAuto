AUTOSAR XML (schema 00046)
package /jmc_auto/ModuleServices/CanbusServiceConsumerMapping
  dds service instance to machine mapping ControlCommandRequiredDdsServiceInstanceToMachine: communication-connector=Dmini0EthernetCommConnector, service-instance=ControlCommandRequiredDdsServiceInstance
  service instance to port prototype mapping ControlCommandRequiredServiceInstanceToPort: port-prototype=CanbusRootSwComponent.ControlCommandRPort, process=CanbusProcess, service-instance=ControlCommandRequiredDdsServiceInstance
package /jmc_auto/ModuleServices/CanbusServiceProviderMapping
  someip service instance to machine mapping ChassisProvidedSomeipServiceInstanceToMachine: communication-connector=Dmini0EthernetCommConnector, service-instance=ChassisProvidedSomeipServiceInstance, udp-port=7004
  service instance to port prototype mapping ChassisProvidedServiceInstanceToPort: port-prototype=CanbusRootSwComponent.ChassisPPort, process=CanbusProcess, service-instance=ChassisProvidedSomeipServiceInstance
package /jmc_auto/ModuleServices/CanbusServiceConsumer
  dds required service instance ControlCommandRequiredDdsServiceInstance: service-interface=ControlCommandDdsServiceInterfaceDeployment, dds-event-qos-props{qos-profile=/var/eventsqos.xml, event=ControlCommandDdsEventDeployment}, required-service-instance-id=109
package /jmc_auto/ModuleServices/CanbusServiceProvider
  provided someip service instance ChassisProvidedSomeipServiceInstance: service-interface=ChassisSomeipInterfaceDeployment, someip-event-props=ChassisEventDeployment, service-instance-id=104
package /jmc_auto/ModuleServices/CanRxConsumerToApp
  service instance to port prototype mapping Can00RxServiceInstanceToPort: port-prototype=CanbusRootSwComponent.CanRxPort, process=CanbusProcess, service-instance=CanBus00RxSomeipServiceInstance
  someip service instance to machine mapping Can00RxSomeipServiceInstanceToMachine: communication-connector=Dmini0EthernetCommConnector, service-instance=CanBus00RxSomeipServiceInstance, udp-port=5000
  service instance to port prototype mapping Can01RxServiceInstanceToPort: port-prototype=CanbusRootSwComponent.CanRxPort, process=CanbusProcess, service-instance=CanBus01RxSomeipServiceInstance
  someip service instance to machine mapping Can01RxSomeipServiceInstanceToMachine: communication-connector=Dmini0EthernetCommConnector, service-instance=CanBus01RxSomeipServiceInstance, udp-port=5001
  service instance to port prototype mapping Can02RxServiceInstanceToPort: port-prototype=CanbusRootSwComponent.CanRxPort, process=CanbusProcess, service-instance=CanBus02RxSomeipServiceInstance
  someip service instance to machine mapping Can02RxSomeipServiceInstanceToMachine: communication-connector=Dmini0EthernetCommConnector, service-instance=CanBus02RxSomeipServiceInstance, udp-port=5002
  service instance to port prototype mapping Can03RxServiceInstanceToPort: port-prototype=CanbusRootSwComponent.CanRxPort, process=CanbusProcess, service-instance=CanBus03RxSomeipServiceInstance
  someip service instance to machine mapping Can03RxSomeipServiceInstanceToMachine: communication-connector=Dmini0EthernetCommConnector, service-instance=CanBus03RxSomeipServiceInstance, udp-port=5003
  service instance to port prototype mapping Can04RxServiceInstanceToPort: port-prototype=CanbusRootSwComponent.CanRxPort, process=CanbusProcess, service-instance=CanBus04RxSomeipServiceInstance
  someip service instance to machine mapping Can04RxSomeipServiceInstanceToMachine: communication-connector=Dmini0EthernetCommConnector, service-instance=CanBus04RxSomeipServiceInstance, udp-port=5004
  service instance to port prototype mapping Can05RxServiceInstanceToPort: port-prototype=CanbusRootSwComponent.CanRxPort, process=CanbusProcess, service-instance=CanBus05RxSomeipServiceInstance
  someip service instance to machine mapping Can05RxSomeipServiceInstanceToMachine: communication-connector=Dmini0EthernetCommConnector, service-instance=CanBus05RxSomeipServiceInstance, udp-port=5005
  service instance to port prototype mapping Can06RxServiceInstanceToPort: port-prototype=CanbusRootSwComponent.CanRxPort, process=CanbusProcess, service-instance=CanBus06RxSomeipServiceInstance
  someip service instance to machine mapping Can06RxSomeipServiceInstanceToMachine: communication-connector=Dmini0EthernetCommConnector, service-instance=CanBus06RxSomeipServiceInstance, udp-port=5006
  service instance to port prototype mapping Can07RxServiceInstanceToPort: port-prototype=CanbusRootSwComponent.CanRxPort, process=CanbusProcess, service-instance=CanBus07RxSomeipServiceInstance
  someip service instance to machine mapping Can07RxSomeipServiceInstanceToMachine: communication-connector=Dmini0EthernetCommConnector, service-instance=CanBus07RxSomeipServiceInstance, udp-port=5007
  service instance to port prototype mapping Can08RxServiceInstanceToPort: port-prototype=CanbusRootSwComponent.CanRxPort, process=CanbusProcess, service-instance=CanBus08RxSomeipServiceInstance
  someip service instance to machine mapping Can08RxSomeipServiceInstanceToMachine: communication-connector=Dmini0EthernetCommConnector, service-instance=CanBus08RxSomeipServiceInstance, udp-port=5008
  service instance to port prototype mapping Can09RxServiceInstanceToPort: port-prototype=CanbusRootSwComponent.CanRxPort, process=CanbusProcess, service-instance=CanBus09RxSomeipServiceInstance
  someip service instance to machine mapping Can09RxSomeipServiceInstanceToMachine: communication-connector=Dmini0EthernetCommConnector, service-instance=CanBus09RxSomeipServiceInstance, udp-port=5009
  service instance to port prototype mapping Can10RxServiceInstanceToPort: port-prototype=CanbusRootSwComponent.CanRxPort, process=CanbusProcess, service-instance=CanBus10RxSomeipServiceInstance
  someip service instance to machine mapping Can10RxSomeipServiceInstanceToMachine: communication-connector=Dmini0EthernetCommConnector, service-instance=CanBus10RxSomeipServiceInstance, udp-port=5010
  service instance to port prototype mapping Can11RxServiceInstanceToPort: port-prototype=CanbusRootSwComponent.CanRxPort, process=CanbusProcess, service-instance=CanBus11RxSomeipServiceInstance
  someip service instance to machine mapping Can11RxSomeipServiceInstanceToMachine: communication-connector=Dmini0EthernetCommConnector, service-instance=CanBus11RxSomeipServiceInstance, udp-port=5011
  someip service instance to machine mapping CanANYRxSomeipServiceInstanceToMachine: communication-connector=Dmini0EthernetCommConnector, service-instance=CanBusANYRxSomeipServiceInstance, udp-port=5011
package /jmc_auto/ModuleServices/CanRxServiceConsumer
  13 x required someip service instance, all with service-interface=CanRxSomeipServiceInterfaceDeployment:
    CanBus00RxSomeipServiceInstance: required-service-instance-id=1
      someip required event group CanBus00RxEventgroup1: event-group=CanDataRxEventGroup
    CanBus01RxSomeipServiceInstance: required-service-instance-id=2
      someip required event group CanBus00RxEventgroup1: event-group=CanDataRxEventGroup
    CanBus02RxSomeipServiceInstance: required-service-instance-id=3
      someip required event group CanBus00RxEventgroup1: event-group=CanDataRxEventGroup
    CanBus03RxSomeipServiceInstance: required-service-instance-id=4
      someip required event group CanBus00RxEventgroup1: event-group=CanDataRxEventGroup
    CanBus04RxSomeipServiceInstance: required-service-instance-id=5
      someip required event group CanBus00RxEventgroup1: event-group=CanDataRxEventGroup
    CanBus05RxSomeipServiceInstance: required-service-instance-id=6
      someip required event group CanBus00RxEventgroup1: event-group=CanDataRxEventGroup
    CanBus06RxSomeipServiceInstance: required-service-instance-id=7
      someip required event group CanBus00RxEventgroup1: event-group=CanDataRxEventGroup
    CanBus07RxSomeipServiceInstance: required-service-instance-id=8
      someip required event group CanBus00RxEventgroup1: event-group=CanDataRxEventGroup
    CanBus08RxSomeipServiceInstance: required-service-instance-id=9
      someip required event group CanBus00RxEventgroup1: event-group=CanDataRxEventGroup
    CanBus09RxSomeipServiceInstance: required-service-instance-id=10
      someip required event group CanBus00RxEventgroup1: event-group=CanDataRxEventGroup
    CanBus10RxSomeipServiceInstance: required-service-instance-id=11
      someip required event group CanBus00RxEventgroup1: event-group=CanDataRxEventGroup
    CanBus11RxSomeipServiceInstance: required-service-instance-id=12
      someip required event group CanBus00RxEventgroup1: event-group=CanDataRxEventGroup
    CanBusANYRxSomeipServiceInstance: required-service-instance-id=ANY
      someip required event group CanBus00RxEventgroup1: event-group=CanDataRxEventGroup
package /jmc_auto/ModuleServices/CanTxProviderToApp
  service instance to port prototype mapping Can00TxServiceInstanceToPort: port-prototype=CanbusRootSwComponent.CanTxPort, process=CanbusProcess, service-instance=CanBus00TxSomeipServiceInstance
  someip service instance to machine mapping Can00TxSomeipServiceInstanceToMachine: communication-connector=Dmini0EthernetCommConnector, service-instance=CanBus00TxSomeipServiceInstance, udp-port=6000
  service instance to port prototype mapping Can01TxServiceInstanceToPort: port-prototype=CanbusRootSwComponent.CanTxPort, process=CanbusProcess, service-instance=CanBus01TxSomeipServiceInstance
  someip service instance to machine mapping Can01TxSomeipServiceInstanceToMachine: communication-connector=Dmini0EthernetCommConnector, service-instance=CanBus01TxSomeipServiceInstance, udp-port=6001
  service instance to port prototype mapping Can02TxServiceInstanceToPort: port-prototype=CanbusRootSwComponent.CanTxPort, process=CanbusProcess, service-instance=CanBus02TxSomeipServiceInstance
  someip service instance to machine mapping Can02TxSomeipServiceInstanceToMachine: communication-connector=Dmini0EthernetCommConnector, service-instance=CanBus02TxSomeipServiceInstance, udp-port=6002
  service instance to port prototype mapping Can03TxServiceInstanceToPort: port-prototype=CanbusRootSwComponent.CanTxPort, process=CanbusProcess, service-instance=CanBus03TxSomeipServiceInstance
  someip service instance to machine mapping Can03TxSomeipServiceInstanceToMachine: communication-connector=Dmini0EthernetCommConnector, service-instance=CanBus03TxSomeipServiceInstance, udp-port=6003
  service instance to port prototype mapping Can04TxServiceInstanceToPort: port-prototype=CanbusRootSwComponent.CanTxPort, process=CanbusProcess, service-instance=CanBus04TxSomeipServiceInstance
  someip service instance to machine mapping Can04TxSomeipServiceInstanceToMachine: communication-connector=Dmini0EthernetCommConnector, service-instance=CanBus04TxSomeipServiceInstance, udp-port=6004
  service instance to port prototype mapping Can05TxServiceInstanceToPort: port-prototype=CanbusRootSwComponent.CanTxPort, process=CanbusProcess, service-instance=CanBus05TxSomeipServiceInstance
  someip service instance to machine mapping Can05TxSomeipServiceInstanceToMachine: communication-connector=Dmini0EthernetCommConnector, service-instance=CanBus05TxSomeipServiceInstance, udp-port=6005
  service instance to port prototype mapping Can06TxServiceInstanceToPort: port-prototype=CanbusRootSwComponent.CanTxPort, process=CanbusProcess, service-instance=CanBus06TxSomeipServiceInstance
  someip service instance to machine mapping Can06TxSomeipServiceInstanceToMachine: communication-connector=Dmini0EthernetCommConnector, service-instance=CanBus06TxSomeipServiceInstance, udp-port=6006
  service instance to port prototype mapping Can07TxServiceInstanceToPort: port-prototype=CanbusRootSwComponent.CanTxPort, process=CanbusProcess, service-instance=CanBus07TxSomeipServiceInstance
  someip service instance to machine mapping Can07TxSomeipServiceInstanceToMachine: communication-connector=Dmini0EthernetCommConnector, service-instance=CanBus07TxSomeipServiceInstance, udp-port=6007
  service instance to port prototype mapping Can08TxServiceInstanceToPort: port-prototype=CanbusRootSwComponent.CanTxPort, process=CanbusProcess, service-instance=CanBus08TxSomeipServiceInstance
  someip service instance to machine mapping Can08TxSomeipServiceInstanceToMachine: communication-connector=Dmini0EthernetCommConnector, service-instance=CanBus08TxSomeipServiceInstance, udp-port=6008
  service instance to port prototype mapping Can09TxServiceInstanceToPort: port-prototype=CanbusRootSwComponent.CanTxPort, process=CanbusProcess, service-instance=CanBus09TxSomeipServiceInstance
  someip service instance to machine mapping Can09TxSomeipServiceInstanceToMachine: communication-connector=Dmini0EthernetCommConnector, service-instance=CanBus09TxSomeipServiceInstance, udp-port=6009
  someip service instance to machine mapping Can10TxSomeipServiceInstanceToMachine: communication-connector=Dmini0EthernetCommConnector, service-instance=CanBus10TxSomeipServiceInstance, udp-port=6010
  service instance to port prototype mapping Can11TxServiceInstanceToPort: port-prototype=CanbusRootSwComponent.CanTxPort, process=CanbusProcess, service-instance=CanBus11TxSomeipServiceInstance
  someip service instance to machine mapping Can11TxSomeipServiceInstanceToMachine: communication-connector=Dmini0EthernetCommConnector, service-instance=CanBus11TxSomeipServiceInstance, udp-port=6011
  service instance to port prototype mapping CanTx10ServiceInstanceToPort: port-prototype=CanbusRootSwComponent.CanTxPort, process=CanbusProcess, service-instance=CanBus10TxSomeipServiceInstance
package /jmc_auto/ModuleServices/CanTxServiceProvider
  12 x provided someip service instance, all with service-interface=CanTxSomeipServiceInterfaceDeployment:
    CanBus00TxSomeipServiceInstance: service-instance-id=1
      someip provided event group CanBus00TxEventgroup1: event-group=CanDataTxEventGroup, multicast-threshold=0
    CanBus01TxSomeipServiceInstance: service-instance-id=2
      someip provided event group CanBus01TxEventgroup1: event-group=CanDataTxEventGroup, multicast-threshold=0
    CanBus02TxSomeipServiceInstance: service-instance-id=3
      someip provided event group CanBus01TxEventgroup1: event-group=CanDataTxEventGroup, multicast-threshold=0
    CanBus03TxSomeipServiceInstance: service-instance-id=4
      someip provided event group CanBus01TxEventgroup1: event-group=CanDataTxEventGroup, multicast-threshold=0
    CanBus04TxSomeipServiceInstance: service-instance-id=5
      someip provided event group CanBus01TxEventgroup1: event-group=CanDataTxEventGroup, multicast-threshold=0
    CanBus05TxSomeipServiceInstance: service-instance-id=6
      someip provided event group CanBus01TxEventgroup1: event-group=CanDataTxEventGroup, multicast-threshold=0
    CanBus06TxSomeipServiceInstance: service-instance-id=7
      someip provided event group CanBus01TxEventgroup1: event-group=CanDataTxEventGroup, multicast-threshold=0
    CanBus07TxSomeipServiceInstance: service-instance-id=8
      someip provided event group CanBus01TxEventgroup1: event-group=CanDataTxEventGroup, multicast-threshold=0
    CanBus08TxSomeipServiceInstance: service-instance-id=9
      someip provided event group CanBus01TxEventgroup1: event-group=CanDataTxEventGroup, multicast-threshold=0
    CanBus09TxSomeipServiceInstance: service-instance-id=10
      someip provided event group CanBus01TxEventgroup1: event-group=CanDataTxEventGroup, multicast-threshold=0
    CanBus10TxSomeipServiceInstance: service-instance-id=11
      someip provided event group CanBus01TxEventgroup1: event-group=CanDataTxEventGroup, multicast-threshold=0
    CanBus11TxSomeipServiceInstance: service-instance-id=12
      someip provided event group CanBus01TxEventgroup1: event-group=CanDataTxEventGroup, multicast-threshold=0
