AUTOSAR XML (schema 00046)
package /jmc_auto/ModuleServices/CanbusServiceConsumerMapping
  dds service instance to machine mapping ControlCommandRequiredDdsServiceInstanceToMachine: communication-connector=Dmini0EthernetCommConnector, service-instance=ControlCommandRequiredDdsServiceInstance
  service instance to port prototype mapping ControlCommandRequiredServiceInstanceToPort: port-prototype=CanbusRootSwComponent.ControlCommandRPort, process=CanbusProcess, service-instance=ControlCommandRequiredDdsServiceInstance
package /jmc_auto/ModuleServices/CanbusServiceProviderMapping
  someip service instance to machine mapping ChassisProvidedSomeipServiceInstanceToMachine: communication-connector=Dmini0EthernetCommConnector, service-instance=ChassisProvidedSomeipServiceInstance, udp-port=7004
  service instance to port prototype mapping ChassisProvidedServiceInstanceToPort: port-prototype=CanbusRootSwComponent.ChassisPPort, process=CanbusProcess, service-instance=ChassisProvidedSomeipServiceInstance
package /jmc_auto/ModuleServices/CanbusServiceConsumer
  dds required service instance ControlCommandRequiredDdsServiceInstance: service-interface=ControlCommandDdsServiceInterfaceDeployment, dds-event-qos-props{qos-profile=/var/eventsqos.xml, event=ControlCommandDdsEventDeployment}, required-service-instance-id=109
package /jmc_auto/ModuleServices/CanbusServiceProvider
  provided someip service instance ChassisProvidedSomeipServiceInstance: service-interface=ChassisSomeipInterfaceDeployment, someip-event-props=ChassisEventDeployment, service-instance-id=104
package /jmc_auto/ModuleServices/CanRxConsumerToApp
  service instance to port prototype mapping Can00RxServiceInstanceToPort: port-prototype=CanbusRootSwComponent.CanRxPort, process=CanbusProcess, service-instance=CanBus00RxSomeipServiceInstance
  someip service instance to machine mapping Can00RxSomeipServiceInstanceToMachine: communication-connector=Dmini0EthernetCommConnector, service-instance=CanBus00RxSomeipServiceInstance, udp-port=5000
  service instance to port prototype mapping Can01RxServiceInstanceToPort: port-prototype=CanbusRootSwComponent.CanRxPort, process=CanbusProcess, service-instance=CanBus01RxSomeipServiceInstance
  someip service instance to machine mapping Can01RxSomeipServiceInstanceToMachine: communication-connector=Dmini0EthernetCommConnector, service-instance=CanBus01RxSomeipServiceInstance, udp-port=5001
  service instance to port prototype mapping Can02RxServiceInstanceToPort: port-prototype=CanbusRootSwComponent.CanRxPort, process=CanbusProcess, service-instance=CanBus02RxSomeipServiceInstance
  someip service instance to machine mapping Can02RxSomeipServiceInstanceToMachine: communication-connector=Dmini0EthernetCommConnector, service-instance=CanBus02RxSomeipServiceInstance, udp-port=5002
  service instance to port prototype mapping Can03RxServiceInstanceToPort: port-prototype=CanbusRootSwComponent.CanRxPort, process=CanbusProcess, service-instance=CanBus03RxSomeipServiceInstance
  someip service instance to machine mapping Can03RxSomeipServiceInstanceToMachine: communication-connector=Dmini0EthernetCommConnector, service-instance=CanBus03RxSomeipServiceInstance, udp-port=5003
package /jmc_auto/ModuleServices/CanRxServiceConsumer
  4 x required someip service instance, all with service-interface=CanRxSomeipServiceInterfaceDeployment:
    CanBus00RxSomeipServiceInstance: required-service-instance-id=1
      someip required event group CanBus00RxEventgroup1: event-group=CanDataRxEventGroup
    CanBus01RxSomeipServiceInstance: required-service-instance-id=2
      someip required event group CanBus00RxEventgroup1: event-group=CanDataRxEventGroup
    CanBus02RxSomeipServiceInstance: required-service-instance-id=3
      someip required event group CanBus00RxEventgroup1: event-group=CanDataRxEventGroup
    CanBus03RxSomeipServiceInstance: required-service-instance-id=4
      someip required event group CanBus00RxEventgroup1: event-group=CanDataRxEventGroup
package /jmc_auto/ModuleServices/CanTxProviderToApp
  service instance to port prototype mapping Can00TxServiceInstanceToPort: port-prototype=CanbusRootSwComponent.CanTxPort, process=CanbusProcess, service-instance=CanBus00TxSomeipServiceInstance
  someip service instance to machine mapping Can00TxSomeipServiceInstanceToMachine: communication-connector=Dmini0EthernetCommConnector, service-instance=CanBus00TxSomeipServiceInstance, udp-port=6000
  service instance to port prototype mapping Can01TxServiceInstanceToPort: port-prototype=CanbusRootSwComponent.CanTxPort, process=CanbusProcess, service-instance=CanBus01TxSomeipServiceInstance
  someip service instance to machine mapping Can01TxSomeipServiceInstanceToMachine: communication-connector=Dmini0EthernetCommConnector, service-instance=CanBus01TxSomeipServiceInstance, udp-port=6001
  service instance to port prototype mapping Can02TxServiceInstanceToPort: port-prototype=CanbusRootSwComponent.CanTxPort, process=CanbusProcess, service-instance=CanBus02TxSomeipServiceInstance
  someip service instance to machine mapping Can02TxSomeipServiceInstanceToMachine: communication-connector=Dmini0EthernetCommConnector, service-instance=CanBus02TxSomeipServiceInstance, udp-port=6002
  service instance to port prototype mapping Can03TxServiceInstanceToPort: port-prototype=CanbusRootSwComponent.CanTxPort, process=CanbusProcess, service-instance=CanBus03TxSomeipServiceInstance
  someip service instance to machine mapping Can03TxSomeipServiceInstanceToMachine: communication-connector=Dmini0EthernetCommConnector, service-instance=CanBus03TxSomeipServiceInstance, udp-port=6003
package /jmc_auto/ModuleServices/CanTxServiceProvider
  4 x provided someip service instance, all with service-interface=CanTxSomeipServiceInterfaceDeployment:
    CanBus00TxSomeipServiceInstance: service-instance-id=1
      someip provided event group CanBus00TxEventgroup1: event-group=CanDataTxEventGroup, multicast-threshold=0
    CanBus01TxSomeipServiceInstance: service-instance-id=2
      someip provided event group CanBus01TxEventgroup1: event-group=CanDataTxEventGroup, multicast-threshold=0
    CanBus02TxSomeipServiceInstance: service-instance-id=3
      someip provided event group CanBus01TxEventgroup1: event-group=CanDataTxEventGroup, multicast-threshold=0
    CanBus03TxSomeipServiceInstance: service-instance-id=4
      someip provided event group CanBus01TxEventgroup1: event-group=CanDataTxEventGroup, multicast-threshold=0
