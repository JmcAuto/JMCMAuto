AUTOSAR XML (schema 00046)
package /jmc_auto/PlatformServices/LocalizationProcess
  process LocalizationProcess: executable=LocalizationExecutable, mode-dependent-startup-config{function-group-mode=[MachineModeGroupPrototype.VehicleDriving, MachineModeGroupPrototype.VehicleInActive], machine-mode=MachineModeGroupPrototype.Startup, resource-group=Dmini0ResourceLimitationGroup1, startup-config=LocalizationStartupConfig}
package /jmc_auto/PlatformServices/LocalizationStartupConfig
  startup config set LocalizationStartupConfigSet
    startup config LocalizationStartupConfig: scheduling-policy=SCHEDULING-POLICY-ROUND-ROBIN, scheduling-priority=12
