AUTOSAR XML (schema 00046)
package /jmc_auto/PlatformServices/LocalizationApplication
  adaptive application sw component type LocalizationSwComponent
    require port ChassisRPort: required-interface=ChassisServiceInterface
    provide port LocalizationPPort: provided-interface=LocalizationServiceInterface
package /jmc_auto/PlatformServices/LocalizationExecutable
  executable LocalizationExecutable
    root sw component prototype LocalizationRootSwComponent: application-type=LocalizationSwComponent
