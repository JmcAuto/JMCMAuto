AUTOSAR XML (schema 00046)
package /jmc_auto/PlatFormServices/LocalizationConsumerToApp
  service instance to port prototype mapping LocalizationRecvServiceInstanceToPort: port-prototype=LocalizationRootSwComponent.ChassisRPort, process=LocalizationProcess, service-instance=ChassisRequiredSomeipServiceInstance
  someip service instance to machine mapping LocalizationServiceInstanceToMachine: communication-connector=Dmini0EthernetCommConnector, service-instance=ChassisRequiredSomeipServiceInstance, udp-port=7002
package /jmc_auto/PlatFormServices/LocalizationProviderToApp
  someip service instance to machine mapping LocalizationServiceInstanceToMachine: communication-connector=Dmini0EthernetCommConnector, service-instance=LocalizationProvidedSomeipServiceInstance, udp-port=7010
  service instance to port prototype mapping LocalizationServiceInstanceToPort: port-prototype=LocalizationRootSwComponent.LocalizationPPort, process=LocalizationProcess, service-instance=LocalizationProvidedSomeipServiceInstance
package /jmc_auto/PlatFormServices/LocalizationServiceConsumer
  required someip service instance ChassisRequiredSomeipServiceInstance: service-interface=ChassisSomeipInterfaceDeployment, required-service-instance-id=104
package /jmc_auto/PlatFormServices/LocalizationServiceProvider
  provided someip service instance LocalizationProvidedSomeipServiceInstance: service-interface=LocalizationSomeipInterfaceDeployment, someip-event-props=LocalizationEventDeployment, service-instance-id=105
