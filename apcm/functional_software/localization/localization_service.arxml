AUTOSAR XML (schema 00046)
package /jmc_auto/ModuleServices/LocalizationServiceConsumer
  required someip service instance ChassisRequiredSomeipServiceInstance: service-interface=ChassisSomeipInterfaceDeployment, required-service-instance-id=104
package /jmc_auto/ModuleServices/LocalizationServiceProvider
  provided someip service instance LocalizationProvidedSomeipServiceInstance: service-interface=LocalizationSomeipInterfaceDeployment, someip-event-props=LocalizationEventDeployment, service-instance-id=105
package /jmc_auto/ModuleServices/LocalizationServiceConsumerMapping
  service instance to port prototype mapping ChassisRequiredServiceInstanceToPort: port-prototype=LocalizationRootSwComponent.ChassisRPort, process=LocalizationProcess, service-instance=ChassisRequiredSomeipServiceInstance
  someip service instance to machine mapping ChassisRequiredSomeipServiceInstanceToMachine: communication-connector=Dmini0EthernetCommConnector, service-instance=ChassisRequiredSomeipServiceInstance, udp-port=7004
package /jmc_auto/ModuleServices/LocalizationServiceProviderMapping
  service instance to port prototype mapping LocalizationProvidedServiceInstanceToPort: port-prototype=LocalizationRootSwComponent.LocalizationPPort, process=LocalizationProcess, service-instance=LocalizationProvidedSomeipServiceInstance
  someip service instance to machine mapping LocalizationProvidedSomeipServiceInstanceToMachine: communication-connector=Dmini0EthernetCommConnector, service-instance=LocalizationProvidedSomeipServiceInstance, udp-port=7005
