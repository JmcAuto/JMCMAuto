AUTOSAR XML (schema 00046)
package /HuaweiMDC/PlatformServices/McuSensorsAbstractProcess
  process McuSensorsAbstractProcess: executable=McuSensorsAbstractExecutable, mode-dependent-startup-config{function-group-mode=[MachineModeGroupPrototype, MachineModeGroupPrototype.VehicleInActive], machine-mode=MachineModeGroupPrototype.Startup, resource-group=Dmini0ResourceLimitationGroup1, startup-config=McuSensorsAbstractStartupConfig}
package /HuaweiMDC/PlatformServices/McuSensorsAbstractStartupConfig
  startup config set McuSensorsAbstractStartupConfigSet
    startup config McuSensorsAbstractStartupConfig: scheduling-policy=SCHEDULING-POLICY-ROUND-ROBIN, scheduling-priority=12
