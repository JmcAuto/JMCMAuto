AUTOSAR XML (schema 00046)
package /jmc_auto/Functional/ControlApplication
  adaptive application sw component type ControlApplicationSwComponent
    require port ChassisRPort: required-interface=ChassisServiceInterface
    provide port ControlCommandPPort: provided-interface=ControlCommandServiceInterface
    require port LocalizationRPort: required-interface=LocalizationServiceInterface
package /jmc_auto/Functional/ControlExecutable
  executable ControlExecutable
    root sw component prototype ControlRootSwComponent: application-type=ControlApplicationSwComponent
