AUTOSAR XML (schema 00046)
package /jmc_auto/ModuleServices/ControlServiceConsumer
  required someip service instance ChassisRequiredSomeipServiceInstance: service-interface=ChassisSomeipInterfaceDeployment, required-service-instance-id=104
  required someip service instance LocalizationRequiredSomeipServiceInstance: service-interface=LocalizationSomeipInterfaceDeployment, required-service-instance-id=105
package /jmc_auto/ModuleServices/ControlServiceProvider
  dds provided service instance ControlCommandProvidedDdsServiceInstance: service-interface=ControlCommandDdsServiceInterfaceDeployment, qos-profile=/var/domainqos.xml, domain-id=0, transport-plugins=SHM, dds-event-qos-props{qos-profile=/var/eventsqos.xml, event=ControlCommandDdsEventDeployment}, service-instance-id=109
package /jmc_auto/ModuleServices/ControlServiceConsumerMapping
  service instance to port prototype mapping ChassisRequiredServiceInstanceToPort: port-prototype=ControlRootSwComponent.ChassisRPort, process=ControlProcess, service-instance=ChassisRequiredSomeipServiceInstance
  someip service instance to machine mapping ChassisRequiredSomeipServiceInstanceToMachine: communication-connector=Dmini0EthernetCommConnector, service-instance=ChassisRequiredSomeipServiceInstance, udp-port=7004
  service instance to port prototype mapping LocalizationRequiredServiceInstanceToPort: port-prototype=ControlRootSwComponent.LocalizationRPort, process=ControlProcess, service-instance=LocalizationRequiredSomeipServiceInstance
  someip service instance to machine mapping LocalizationRequiredSomeipServiceInstanceToMachine: communication-connector=Dmini0EthernetCommConnector, service-instance=LocalizationRequiredSomeipServiceInstance, udp-port=7005
package /jmc_auto/ModuleServices/ControlServiceProviderMapping
  dds service instance to machine mapping ControlCommandProvidedDdsServiceInstanceToMachine: communication-connector=Dmini0EthernetCommConnector, service-instance=ControlCommandProvidedDdsServiceInstance
  service instance to port prototype mapping ControlCommandProvidedServiceInstanceToPort: port-prototype=ControlRootSwComponent.ControlCommandPPort, process=ControlProcess, service-instance=ControlCommandProvidedDdsServiceInstance
