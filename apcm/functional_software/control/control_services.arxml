AUTOSAR XML (schema 00046)
package /jmc_auto/Functional/ControlServiceConsumer
  required someip service instance ChassisRequiredSomeipServiceInstance: service-interface=ChassisSomeipInterfaceDeployment, required-service-instance-id=104
  required someip service instance LocalizationRequiredSomeipServiceInstance: service-interface=LocalizationSomeipInterfaceDeployment, required-service-instance-id=105
package /jmc_auto/Functional/ControlServiceProvider
  dds provided service instance ControlCommandProvidedDdsServiceInstance: service-interface=ControlCommandDdsServiceInterfaceDeployment, qos-profile=/var/domainqos.xml, domain-id=0, transport-plugins=SHM, dds-event-qos-props{qos-profile=/var/eventsqos.xml, event=ControlCommandDdsEventDeployment}, service-instance-id=109
package /jmc_auto/Functional/ControlServiceConsumerMapping
  service instance to port prototype mapping ControlRecvServiceInstanceToPort: port-prototype=ControlRootSwComponent.ChassisRPort, process=ControlProcess, service-instance=ChassisRequiredSomeipServiceInstance
  someip service instance to machine mapping ControlServiceInstanceToMachine: communication-connector=Dmini0EthernetCommConnector, service-instance=[ChassisRequiredSomeipServiceInstance, LocalizationRequiredSomeipServiceInstance], udp-port=7004
  service instance to port prototype mapping ControlRecvServiceInstanceToPort: port-prototype=ControlRootSwComponent.LocalizationRPort, process=ControlProcess, service-instance=LocalizationRequiredSomeipServiceInstance
package /jmc_auto/Functional/ControlServiceProviderMapping
  dds service instance to machine mapping ControlProvidedDdsServiceInstanceToMachine: communication-connector=Dmini0EthernetCommConnector, service-instance=ControlCommandProvidedDdsServiceInstance
  service instance to port prototype mapping ControlProvidedServiceInstanceToPort: port-prototype=ControlRootSwComponent.ControlCommandPPort, process=ControlProcess, service-instance=ControlCommandProvidedDdsServiceInstance
