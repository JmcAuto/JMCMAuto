AUTOSAR XML (schema 00046)
package /jmc_auto/ModuleServices/ControlProcess
  process ControlProcess: executable=ControlExecutable, mode-dependent-startup-config{function-group-mode=[MachineModeGroupPrototype.VehicleDriving, MachineModeGroupPrototype.VehicleInActive], machine-mode=MachineModeGroupPrototype.Startup, resource-group=Dmini0ResourceLimitationGroup1, startup-config=ControlStartupConfig}
package /jmc_auto/ModuleServices/ControlProcessStartupConfig
  startup config set ControlStartupConfigSet
    startup config ControlStartupConfig: scheduling-policy=SCHEDULING-POLICY-ROUND-ROBIN, scheduling-priority=12
