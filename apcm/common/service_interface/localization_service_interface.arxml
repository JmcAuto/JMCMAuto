AUTOSAR XML (schema 00046)
package /jmc_auto/Modules/LocalizationDataType
  impl type Localization: category=STRUCTURE
    5 x element, all with category=TYPE_REFERENCE:
      header
      pose: implementation-data-type=Pose
      uncertainty: implementation-data-type=Uncertainty
      measurement_time
      trajectory_point
  impl type Uncertainty: category=STRUCTURE
    5 x element, all with category=TYPE_REFERENCE:
      position_std_dev
      orientation_std_dev
      linear_velocity_std_dev
      linear_acceleration_std_dev
      angular_velocity_std_dev
  impl type Pose: category=STRUCTURE
    9 x element, all with category=TYPE_REFERENCE:
      position
      orientation
      linear_velocity
      linear_acceleration
      angular_velocity
      heading
      linear_acceleration_vrf
      angular_velocity_vrf
      euler_angles
package /jmc_auto/Modules/LocalizationServiceInterface
  service interface LocalizationServiceInterface: is-service=true
    namespaces:
      symbol props jmc_auto
    events:
      data LocalizationEvent: type=Localization
  someip service interface deployment LocalizationSomeipInterfaceDeployment: service-interface=LocalizationServiceInterface, service-interface-id=12805, service-interface-version={major-version=1, minor-version=0}
    someip event deployment LocalizationEventDeployment: event=LocalizationEvent, event-id=1005, transport-protocol=UDP
