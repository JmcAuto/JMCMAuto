AUTOSAR XML (schema 00046)
package /jmc_auto/Platform/LocalizationDateType
  impl type LocalizationEstimate: category=STRUCTURE
    5 x element, all with category=TYPE_REFERENCE:
      header: implementation-data-type=Header
      pose: implementation-data-type=Pose
      uncertainty: implementation-data-type=Uncertainty
      measurement_time: implementation-data-type=Double
      trajectory_point: implementation-data-type=TrajectoryPoint
  impl type Uncertainty: category=STRUCTURE
    5 x element, all with category=TYPE_REFERENCE, implementation-data-type=Point3D:
      position_std_dev
      orientation_std_dev
      linear_velocity_std_dev
      linear_acceleration_std_dev
      angular_velocity_std_dev
  impl type Pose: category=STRUCTURE
    9 x element, all with category=TYPE_REFERENCE:
      position: implementation-data-type=PointENU
      orientation: implementation-data-type=Quaternion
      linear_velocity: implementation-data-type=Point3D
      linear_acceleration: implementation-data-type=Point3D
      angular_velocity: implementation-data-type=Point3D
      heading: implementation-data-type=Double
      linear_acceleration_vrf: implementation-data-type=Point3D
      angular_velocity_vrf: implementation-data-type=Point3D
      euler_angles: implementation-data-type=Point3D
package /jmc_auto/Platform/LocalizationServiceInterface
  service interface LocalizationServiceInterface: is-service=true
    namespaces:
      symbol props jmc_auto
    events:
      data LocalizationEvent: type=LocalizationEstimate
  someip service interface deployment LocalizationSomeipInterfaceDeployment: service-interface=LocalizationServiceInterface, service-interface-id=1005, service-interface-version={major-version=1, minor-version=0}
    someip event deployment LocalizationEventDeployment: event=LocalizationEvent, event-id=32771, transport-protocol=UDP
