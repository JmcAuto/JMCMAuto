AUTOSAR XML (schema 00046)
package /jmc_auto/Modules/ControlCommandDataType
  7 x impl type:
    ControlCommand: category=STRUCTURE
      30 x element, all with category=TYPE_REFERENCE:
        header: implementation-data-type=Header
        throttle: implementation-data-type=Double
        brake: implementation-data-type=Double
        steering_rate: implementation-data-type=Double
        steering_target: implementation-data-type=Double
        speed: implementation-data-type=Double
        acceleration: implementation-data-type=Double
        left_turn: implementation-data-type=Bool
        right_turn: implementation-data-type=Bool
        high_beam: implementation-data-type=Bool
        low_beam: implementation-data-type=Bool
        horn: implementation-data-type=Bool
        turnsignal: implementation-data-type=TurnSignal
        reset_model: implementation-data-type=Bool
        engine_on_off: implementation-data-type=Bool
        trajectory_fraction: implementation-data-type=Double
        driving_mode: implementation-data-type=DrivingMode
        gear_location: implementation-data-type=GearPosition
        debug: implementation-data-type=Debug
        signal: implementation-data-type=VehicleSignal
        latency_stats: implementation-data-type=LatencyStats
        pad_msg: implementation-data-type=PadMessage
        engage_advice: implementation-data-type=EngageAdvice
        is_in_safe_mode: implementation-data-type=Bool
        steering_torque: implementation-data-type=Double
        pam_esp_stop_distance: implementation-data-type=Int32
        ACC_StandstillReq: implementation-data-type=Bool
        steering_angle: implementation-data-type=Double
        parking_brake: implementation-data-type=Bool
        PAM_ESP_Target_Gear_Request: implementation-data-type=Int32
    Debug: category=STRUCTURE
      element simple_lon_debug: implementation-data-type=SimpleLongtitudinalDebug
      element simple_lat_debug: implementation-data-type=SimpleLateralDebug
      element input_debug: implementation-data-type=InputDebug
    InputDebug: category=STRUCTURE
      element localization_header: implementation-data-type=Header
      element canbus_header: implementation-data-type=Header
      element trajectory_header: implementation-data-type=Header
    LatencyStats: category=STRUCTURE
      element total_time_ms: implementation-data-type=Double
      element controller_time_ms: category=VECTOR, implementation-data-type=ControllerTimeMs
      element total_time_exceeded: implementation-data-type=Bool
    SimpleLateralDebug: category=STRUCTURE
      32 x element, all with category=TYPE_REFERENCE, implementation-data-type=Double:
        lateral_error
        ref_heading
        heading
        heading_error
        heading_error_rate
        lateral_error_rate
        curvature
        steer_angle
        steer_angle_feedforward
        steer_angle_lateral_contribution
        steer_angle_lateral_rate_contribution
        steer_angle_heading_contribution
        steer_angle_heading_rate_contribution
        steer_angle_feedback
        steering_position
        ref_speed
        steer_angle_limited
        steer_targe_position_error
        steering_torque
        lateral_acceleration
        lateral_jerk
        ref_heading_rate
        heading_rate
        ref_heading_acceleration
        heading_acceleration
        heading_error_acceleration
        ref_heading_jerk
        heading_jerk
        heading_error_jerk
        lateral_error_feedback
        heading_error_feedback
        steer_angle_feedback_augment
    SimpleLongtitudinalDebug: category=STRUCTURE
      23 x element, all with category=TYRE_REFERENCE:
        station_reference: implementation-data-type=Double
        station_error: implementation-data-type=Double
        station_error_limited: implementation-data-type=Double
        preview_station_error: implementation-data-type=Double
        speed_reference: implementation-data-type=Double
        speed_error: implementation-data-type=Double
        speed_controller_input_limited: implementation-data-type=Double
        preview_speed_reference: implementation-data-type=Double
        preview_speed_error: implementation-data-type=Double
        preview_acceleration_reference: implementation-data-type=Double
        acceleration_cmd: implementation-data-type=Double
        acceleration_cmd_closeloop: implementation-data-type=Double
        acceleration_lookup: implementation-data-type=Double
        speed_real: implementation-data-type=Double
        calibration_value: implementation-data-type=Double
        is_full_stop: implementation-data-type=Bool
        slope_offset_compensation: implementation-data-type=Double
        current_station: implementation-data-type=Double
        path_remain: implementation-data-type=Double
        prew_kappa: implementation-data-type=Double
        match_acceleration_reference: implementation-data-type=Double
        speed_offset: implementation-data-type=Double
        gear_location: implementation-data-type=GearPosition
    DrivingAction: compu {0=INVALID, 1=STOP, 2=START, 3=RESET}, implementation-data-type=UInt8
  impl type PadMessage: category=STRUCTURE
    element header: implementation-data-type=Header
    element driving_mode: implementation-data-type=DrivingMode
    element action: implementation-data-type=DrivingAction
  impl type ControllerTimeMs: category=VECTOR
    element Dim1Element: implementation-data-type=Double
package /jmc_auto/Modules/ControlCommandServiceInterface
  dds service interface deployment ControlCommandDdsServiceInterfaceDeployment: service-interface=ControlCommandServiceInterface, service-interface-id=12809
    dds event deployment ControlCommandDdsEventDeployment: event=ControlCommandEvent, topic-name=ControlCommandDdsEvent
  service interface ControlCommandServiceInterface: is-service=true
    namespaces:
      symbol props jmc_auto
    events:
      data ControlCommandEvent: type=ControlCommand
