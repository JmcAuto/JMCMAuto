AUTOSAR XML (schema 00046)
package /HuaweiMDC/Ethernet
  ethernet cluster Dmini0EthernetCluster
    ethernet physical channel Dmini0EthernetPhysicalChannel: comm-connectors=Dmini0EthernetCommConnector
      network endpoint Dmini0NetworkEndpoint: network-endpoint-addresses=ipv-4-configuration={default-gateway=127.0.0.1, ipv-4-address=192.168.1.6, network-mask=255.255.255.0}
      network endpoint Dmini0ServiceDiscoveryNetworkEndpoint: network-endpoint-addresses=ipv-4-configuration=ipv-4-address=239.192.255.251
package /HuaweiMDC/Machine
  machine Dmini0Machine: default-application-timeout={enter-timeout-value=1000001.0, exit-timeout-value=1000002.0}, machine-design=Dmini0MachineDesign
    function-groups:
      mode declaration group prototype LidarModeGroupPrototype: type=LidarMode
    machine-mode-machines:
      mode declaration group prototype MachineModeGroupPrototype: type=MachineMode
    os module instantiation Dmini0_OS
      resource group Dmini0ResourceLimitationGroup1: cpu-usage=80, mem-usage=67108864
    processor Dmini0_CPU
      processor core MainCore: core-id=1
  machine design Dmini0MachineDesign: service-discover-configs=someip-service-discovery={multicast-sd-ip-address=Dmini0ServiceDiscoveryNetworkEndpoint, someip-service-discovery-port=30491}
    ethernet communication connector Dmini0EthernetCommConnector: unicast-network-endpoint=Dmini0NetworkEndpoint
package /HuaweiMDC/SomeipSdConfig
  someip sd client service instance config Dmini0SdClientServiceInstanceConfig: initial-find-behavior={initial-delay-max-value=0.1, initial-delay-min-value=0.01, initial-repetitions-base-delay=0.2, initial-repetitions-max=3}, service-find-time-to-live=10
  someip sd server service instance config Dmini0SdServerServiceInstanceConfig: initial-offer-behavior={initial-delay-max-value=0.1, initial-delay-min-value=0.01, initial-repetitions-base-delay=0.2, initial-repetitions-max=3}, offer-cyclic-delay=2.0, request-response-delay={max-value=1.5, min-value=1.5}, service-offer-time-to-live=10
  someip sd client event group timing config Dmini0SomeipSdClientEventGroupTimingConfig: request-response-delay={max-value=1.5, min-value=1.5}, time-to-live=10
